[part 2 of 3: package /ActiveEcuC]
AUTOSAR XML (schema 3.0.2)
package /ActiveEcuC  (continued)
  module config PICurrCntrl: implementation-config-variant=VARIANT-PRE-COMPILE  # Configuration of the Nexteer PICurrCntrl module.
    PICurrCntrlGeneral
    CommonPublishedInformation: ArMajorVersion=3, ArMinorVersion=2, ArPatchVersion=0, SwMajorVersion=0, SwMinorVersion=0, SwPatchVersion=0, ModuleId=0, VendorId=0
  module config Port: implementation-config-variant=VARIANT-POST-BUILD, module-description=Port_Impl  # Configuration of the Port module.
    Port_Runtime (PortConfigSet)
      GIOA (PortContainer):
        PortNumberOfPortPins = 8
        PortUse = false
        PortName = GIO A
        PortRegPostfix = GIOA
        PortAvailablePackage0 = false
        PortAvailablePackage1 = true
        PortAvailablePackage2 = true
        PortAvailablePackage3 = false
        PortAvailablePackage4 = false
        PortRegBaseAddr = 4294425648
        PortRegStructure = PORT_REG_STRUCT_REGULAR_NO_FUNC
        PortContainsPrivReg = false
        8 x PortPin, all with PortPinDirection=PORT_PIN_IN, PortPinDirectionChangeable=false, PortPinInitialMode=PORT_PIN_MODE_DIO, PortPinLevelValue=PORT_PIN_LEVEL_LOW, PortPinMode=PORT_PIN_MODE_DIO, PortPinOpenDrain=PORT_PUSH_PULL, PortPinPullSelect=PORT_PULL_DOWN, PortPinRefresh=false, PortPinAvailablePackage0=false, PortPinAvailablePackage1=true, PortPinAvailablePackage2=true, PortPinAvailablePackage3=false, PortPinAvailablePackage4=false, PortPinSlewRate=PORT_PIN_SLEW_RATE_NA:
          PortPinGioA_{0..4}: PortPinId={0..4}, PortPinChannelName=(unset), PortPinName=GIOA{0..4}
          PortPinGioA_5: PortPinId=5, PortPinChannelName=GA_UPPER, PortPinName=GIOA5
          PortPinGioA_6: PortPinId=6, PortPinChannelName=GA_LOWER, PortPinName=GIOA6
          PortPinGioA_7: PortPinId=7, PortPinChannelName=GB_UPPER, PortPinName=GIOA7
      PortDefaultSettings:
        PortUseDefaultSettings = false
        PortDefaultDirection = PORT_PIN_IN
        PortDefaultLevelValue = PORT_PIN_LEVEL_LOW
        PortDefaultOpenDrain = PORT_PUSH_PULL
        PortDefaultPullSelect = PORT_PULL_UP
        PortDefaultSlewRate = PORT_PIN_SLEW_RATE_NORMAL
      Multiplexing (PortMux):
        PortMuxName = Port Pin Multiplexing
        PortMuxNumberOfPins = 9
        PortMuxNumberOfRegs = 31
        PortMuxRegPostfix = PINMUX
        PortMuxRegBaseAddr = 4294961936
        PortUseMux = true
        PortMuxEmifClkOutput = false
        PortMuxDisableNhet2OutputByGiob2 = false
        PortMuxSelMiiOrRmii = PORT_MUX_SEL_RMII
        PortMuxSelAdcTriggerTable = PORT_MUX_SEL_ADC_TRIG_TABLE_2
        109 x PortMuxPin, all with PortMuxPinId=0, PortMuxPinNumberPackage0=-, PortMuxPinNumberPackage3=-, PortMuxPinNumberPackage4=-:
          Pin_N19_86: PortMuxPinName=AD1EVT, MII_RX_ER, RMII_RX_ER, PortMuxPinFunc=PORT_PIN_MUX_AD1EVT, PortMuxPinRegId=10, PortMuxPinRegPos=0, PortMuxPinNumberPackage1=N19, PortMuxPinNumberPackage2=86, PortMuxPinDirection=PORT_MUX_PIN_DIR_OUTPUT
          Pin_D4: PortMuxPinName=EMIF_ADDR[0], NHET2[1], PortMuxPinFunc=PORT_PIN_MUX_EMIF_ADDR_0, PortMuxPinRegId=22, PortMuxPinRegPos=0, PortMuxPinNumberPackage1=D4, PortMuxPinNumberPackage2=-, PortMuxPinDirection=PORT_MUX_PIN_DIR_OUTPUT
          Pin_D5: PortMuxPinName=EMIF_ADDR[1], NHET2[3], PortMuxPinFunc=PORT_PIN_MUX_EMIF_ADDR_1, PortMuxPinRegId=21, PortMuxPinRegPos=0, PortMuxPinNumberPackage1=D5, PortMuxPinNumberPackage2=-, PortMuxPinDirection=PORT_MUX_PIN_DIR_OUTPUT
          Pin_C8: PortMuxPinName=EMIF_ADDR[10], RTP_DATA[09], PortMuxPinFunc=PORT_PIN_MUX_EMIF_ADDR_10, PortMuxPinRegId=21, PortMuxPinRegPos=16, PortMuxPinNumberPackage1=C8, PortMuxPinNumberPackage2=-, PortMuxPinDirection=PORT_MUX_PIN_DIR_OUTPUT
          Pin_C9: PortMuxPinName=EMIF_ADDR[11], RTP_DATA[08], PortMuxPinFunc=PORT_PIN_MUX_EMIF_ADDR_11, PortMuxPinRegId=20, PortMuxPinRegPos=24, PortMuxPinNumberPackage1=C9, PortMuxPinNumberPackage2=-, PortMuxPinDirection=PORT_MUX_PIN_DIR_OUTPUT
          Pin_C10: PortMuxPinName=EMIF_ADDR[12], RTP_DATA[06], PortMuxPinFunc=PORT_PIN_MUX_EMIF_ADDR_12, PortMuxPinRegId=20, PortMuxPinRegPos=8, PortMuxPinNumberPackage1=C10, PortMuxPinNumberPackage2=-, PortMuxPinDirection=PORT_MUX_PIN_DIR_OUTPUT
          Pin_C11: PortMuxPinName=EMIF_ADDR[13], RTP_DATA[05], PortMuxPinFunc=PORT_PIN_MUX_EMIF_ADDR_13, PortMuxPinRegId=20, PortMuxPinRegPos=0, PortMuxPinNumberPackage1=C11, PortMuxPinNumberPackage2=-, PortMuxPinDirection=PORT_MUX_PIN_DIR_OUTPUT
          Pin_C12: PortMuxPinName=EMIF_ADDR[14], RTP_DATA[04], PortMuxPinFunc=PORT_PIN_MUX_EMIF_ADDR_14, PortMuxPinRegId=18, PortMuxPinRegPos=16, PortMuxPinNumberPackage1=C12, PortMuxPinNumberPackage2=-, PortMuxPinDirection=PORT_MUX_PIN_DIR_OUTPUT
          Pin_C13: PortMuxPinName=EMIF_ADDR[15], RTP_DATA[03], PortMuxPinFunc=PORT_PIN_MUX_EMIF_ADDR_15, PortMuxPinRegId=18, PortMuxPinRegPos=0, PortMuxPinNumberPackage1=C13, PortMuxPinNumberPackage2=-, PortMuxPinDirection=PORT_MUX_PIN_DIR_OUTPUT
          Pin_D14: PortMuxPinName=EMIF_ADDR[16], RTP_DATA[02], PortMuxPinFunc=PORT_PIN_MUX_EMIF_ADDR_16, PortMuxPinRegId=16, PortMuxPinRegPos=16, PortMuxPinNumberPackage1=D14, PortMuxPinNumberPackage2=-, PortMuxPinDirection=PORT_MUX_PIN_DIR_OUTPUT
          Pin_C14: PortMuxPinName=EMIF_ADDR[17], RTP_DATA[01], PortMuxPinFunc=PORT_PIN_MUX_EMIF_ADDR_17, PortMuxPinRegId=16, PortMuxPinRegPos=8, PortMuxPinNumberPackage1=C14, PortMuxPinNumberPackage2=-, PortMuxPinDirection=PORT_MUX_PIN_DIR_OUTPUT
          Pin_D15: PortMuxPinName=EMIF_ADDR[18], RTP_DATA[0], PortMuxPinFunc=PORT_PIN_MUX_EMIF_ADDR_18, PortMuxPinRegId=15, PortMuxPinRegPos=24, PortMuxPinNumberPackage1=D15, PortMuxPinNumberPackage2=-, PortMuxPinDirection=PORT_MUX_PIN_DIR_OUTPUT
          Pin_C15: PortMuxPinName=EMIF_ADDR[19], RTP_nENA, PortMuxPinFunc=PORT_PIN_MUX_EMIF_ADDR_19, PortMuxPinRegId=15, PortMuxPinRegPos=16, PortMuxPinNumberPackage1=C15, PortMuxPinNumberPackage2=-, PortMuxPinDirection=PORT_MUX_PIN_DIR_OUTPUT
          Pin_C16: PortMuxPinName=EMIF_ADDR[20], RTP_nSYNC, PortMuxPinFunc=PORT_PIN_MUX_EMIF_ADDR_20, PortMuxPinRegId=15, PortMuxPinRegPos=8, PortMuxPinNumberPackage1=C16, PortMuxPinNumberPackage2=-, PortMuxPinDirection=PORT_MUX_PIN_DIR_OUTPUT
          Pin_C17: PortMuxPinName=EMIF_ADDR[21], RTP_CLK, PortMuxPinFunc=PORT_PIN_MUX_EMIF_ADDR_21, PortMuxPinRegId=15, PortMuxPinRegPos=0, PortMuxPinNumberPackage1=C17, PortMuxPinNumberPackage2=-, PortMuxPinDirection=PORT_MUX_PIN_DIR_OUTPUT
          Pin_C4: PortMuxPinName=EMIF_ADDR[6], RTP_DATA[13], NHET2[11], PortMuxPinFunc=PORT_PIN_MUX_EMIF_ADDR_6, PortMuxPinRegId=22, PortMuxPinRegPos=16, PortMuxPinNumberPackage1=C4, PortMuxPinNumberPackage2=-, PortMuxPinDirection=PORT_MUX_PIN_DIR_OUTPUT
          Pin_C5: PortMuxPinName=EMIF_ADDR[7], RTP_DATA[12], NHET2[13], PortMuxPinFunc=PORT_PIN_MUX_EMIF_ADDR_7, PortMuxPinRegId=22, PortMuxPinRegPos=8, PortMuxPinNumberPackage1=C5, PortMuxPinNumberPackage2=-, PortMuxPinDirection=PORT_MUX_PIN_DIR_OUTPUT
          Pin_C6: PortMuxPinName=EMIF_ADDR[8], RTP_DATA[11], NHET2[15], PortMuxPinFunc=PORT_PIN_MUX_EMIF_ADDR_8, PortMuxPinRegId=23, PortMuxPinRegPos=0, PortMuxPinNumberPackage1=C6, PortMuxPinNumberPackage2=-, PortMuxPinDirection=PORT_MUX_PIN_DIR_OUTPUT
          Pin_C7: PortMuxPinName=EMIF_ADDR[9], RTP_DATA[10], PortMuxPinFunc=PORT_PIN_MUX_EMIF_ADDR_9, PortMuxPinRegId=21, PortMuxPinRegPos=24, PortMuxPinNumberPackage1=C7, PortMuxPinNumberPackage2=-, PortMuxPinDirection=PORT_MUX_PIN_DIR_OUTPUT
          Pin_D16: PortMuxPinName=EMIF_BA[1], NHET2[5], PortMuxPinFunc=PORT_PIN_MUX_EMIF_BA_1, PortMuxPinRegId=14, PortMuxPinRegPos=24, PortMuxPinNumberPackage1=D16, PortMuxPinNumberPackage2=-, PortMuxPinDirection=PORT_MUX_PIN_DIR_OUTPUT
          Pin_N17: PortMuxPinName=EMIF_nCS[0], RTP_DATA[15], NHET2[7], PortMuxPinFunc=PORT_PIN_MUX_EMIF_nCS_0, PortMuxPinRegId=10, PortMuxPinRegPos=16, PortMuxPinNumberPackage1=N17, PortMuxPinNumberPackage2=-, PortMuxPinDirection=PORT_MUX_PIN_DIR_OUTPUT
          Pin_K17: PortMuxPinName=EMIF_nCS[3], RTP_DATA[14], NHET2[9], PortMuxPinFunc=PORT_PIN_MUX_EMIF_nCS_3, PortMuxPinRegId=11, PortMuxPinRegPos=0, PortMuxPinNumberPackage1=K17, PortMuxPinNumberPackage2=-, PortMuxPinDirection=PORT_MUX_PIN_DIR_OUTPUT
          Pin_M17: PortMuxPinName=EMIF_nCS[4], RTP_DATA[07], PortMuxPinFunc=PORT_PIN_MUX_EMIF_nCS_4, PortMuxPinRegId=11, PortMuxPinRegPos=8, PortMuxPinNumberPackage1=M17, PortMuxPinNumberPackage2=-, PortMuxPinDirection=PORT_MUX_PIN_DIR_OUTPUT
          Pin_D17: PortMuxPinName=EMIF_nWE, EMIF_RNW, PortMuxPinFunc=PORT_PIN_MUX_EMIF_nWE, PortMuxPinRegId=14, PortMuxPinRegPos=16, PortMuxPinNumberPackage1=D17, PortMuxPinNumberPackage2=-, PortMuxPinDirection=PORT_MUX_PIN_DIR_OUTPUT
          Pin_D9: PortMuxPinName=ETMDATA[08], EMIF_ADDR[5], PortMuxPinFunc=PORT_PIN_MUX_ETMDATA_08, PortMuxPinRegId=17, PortMuxPinRegPos=24, PortMuxPinNumberPackage1=D9, PortMuxPinNumberPackage2=-, PortMuxPinDirection=PORT_MUX_PIN_DIR_OUTPUT
          Pin_D8: PortMuxPinName=ETMDATA[09], EMIF_ADDR[4], PortMuxPinFunc=PORT_PIN_MUX_ETMDATA_09, PortMuxPinRegId=19, PortMuxPinRegPos=0, PortMuxPinNumberPackage1=D8, PortMuxPinNumberPackage2=-, PortMuxPinDirection=PORT_MUX_PIN_DIR_OUTPUT
          Pin_D7: PortMuxPinName=ETMDATA[10], EMIF_ADDR[3], PortMuxPinFunc=PORT_PIN_MUX_ETMDATA_10, PortMuxPinRegId=19, PortMuxPinRegPos=24, PortMuxPinNumberPackage1=D7, PortMuxPinNumberPackage2=-, PortMuxPinDirection=PORT_MUX_PIN_DIR_OUTPUT
          Pin_D6: PortMuxPinName=ETMDATA[11], EMIF_ADDR[2], PortMuxPinFunc=PORT_PIN_MUX_ETMDATA_11, PortMuxPinRegId=22, PortMuxPinRegPos=24, PortMuxPinNumberPackage1=D6, PortMuxPinNumberPackage2=-, PortMuxPinDirection=PORT_MUX_PIN_DIR_OUTPUT
          Pin_D13: PortMuxPinName=ETMDATA[12], EMIF_BA[0], PortMuxPinFunc=PORT_PIN_MUX_ETMDATA_12, PortMuxPinRegId=16, PortMuxPinRegPos=0, PortMuxPinNumberPackage1=D13, PortMuxPinNumberPackage2=-, PortMuxPinDirection=PORT_MUX_PIN_DIR_OUTPUT
          Pin_D12: PortMuxPinName=ETMDATA[13], EMIF_nOE, PortMuxPinFunc=PORT_PIN_MUX_ETMDATA_13, PortMuxPinRegId=16, PortMuxPinRegPos=24, PortMuxPinNumberPackage1=D12, PortMuxPinNumberPackage2=-, PortMuxPinDirection=PORT_MUX_PIN_DIR_OUTPUT
          Pin_D11: PortMuxPinName=ETMDATA[14], EMIF_nDQM[1], PortMuxPinFunc=PORT_PIN_MUX_ETMDATA_14, PortMuxPinRegId=17, PortMuxPinRegPos=8, PortMuxPinNumberPackage1=D11, PortMuxPinNumberPackage2=-, PortMuxPinDirection=PORT_MUX_PIN_DIR_OUTPUT
          Pin_D10: PortMuxPinName=ETMDATA[15], EMIF_nDQM[0], PortMuxPinFunc=PORT_PIN_MUX_ETMDATA_15, PortMuxPinRegId=19, PortMuxPinRegPos=16, PortMuxPinNumberPackage1=D10, PortMuxPinNumberPackage2=-, PortMuxPinDirection=PORT_MUX_PIN_DIR_OUTPUT
          Pin_K15: PortMuxPinName=ETMDATA[16], EMIF_DATA[0], PortMuxPinFunc=PORT_PIN_MUX_ETMDATA_16, PortMuxPinRegId=12, PortMuxPinRegPos=8, PortMuxPinNumberPackage1=K15, PortMuxPinNumberPackage2=-, PortMuxPinDirection=PORT_MUX_PIN_DIR_OUTPUT
          Pin_L15: PortMuxPinName=ETMDATA[17], EMIF_DATA[1], PortMuxPinFunc=PORT_PIN_MUX_ETMDATA_17, PortMuxPinRegId=11, PortMuxPinRegPos=16, PortMuxPinNumberPackage1=L15, PortMuxPinNumberPackage2=-, PortMuxPinDirection=PORT_MUX_PIN_DIR_OUTPUT
          Pin_M15: PortMuxPinName=ETMDATA[18], EMIF_DATA[2], PortMuxPinFunc=PORT_PIN_MUX_ETMDATA_18, PortMuxPinRegId=10, PortMuxPinRegPos=24, PortMuxPinNumberPackage1=M15, PortMuxPinNumberPackage2=-, PortMuxPinDirection=PORT_MUX_PIN_DIR_OUTPUT
          Pin_N15: PortMuxPinName=ETMDATA[19], EMIF_DATA[3], PortMuxPinFunc=PORT_PIN_MUX_ETMDATA_19, PortMuxPinRegId=10, PortMuxPinRegPos=8, PortMuxPinNumberPackage1=N15, PortMuxPinNumberPackage2=-, PortMuxPinDirection=PORT_MUX_PIN_DIR_OUTPUT
          Pin_E4: PortMuxPinName=ETMDATA[20], EMIF_DATA[4], PortMuxPinFunc=PORT_PIN_MUX_ETMDATA_20, PortMuxPinRegId=1, PortMuxPinRegPos=16, PortMuxPinNumberPackage1=E4, PortMuxPinNumberPackage2=-, PortMuxPinDirection=PORT_MUX_PIN_DIR_OUTPUT
          Pin_F4: PortMuxPinName=ETMDATA[21], EMIF_DATA[5], PortMuxPinFunc=PORT_PIN_MUX_ETMDATA_21, PortMuxPinRegId=1, PortMuxPinRegPos=24, PortMuxPinNumberPackage1=F4, PortMuxPinNumberPackage2=-, PortMuxPinDirection=PORT_MUX_PIN_DIR_OUTPUT
          Pin_G4: PortMuxPinName=ETMDATA[22], EMIF_DATA[6], PortMuxPinFunc=PORT_PIN_MUX_ETMDATA_22, PortMuxPinRegId=2, PortMuxPinRegPos=8, PortMuxPinNumberPackage1=G4, PortMuxPinNumberPackage2=-, PortMuxPinDirection=PORT_MUX_PIN_DIR_OUTPUT
          Pin_K4: PortMuxPinName=ETMDATA[23], EMIF_DATA[7], PortMuxPinFunc=PORT_PIN_MUX_ETMDATA_23, PortMuxPinRegId=3, PortMuxPinRegPos=0, PortMuxPinNumberPackage1=K4, PortMuxPinNumberPackage2=-, PortMuxPinDirection=PORT_MUX_PIN_DIR_OUTPUT
          Pin_L4: PortMuxPinName=ETMDATA[24], EMIF_DATA[8], PortMuxPinFunc=PORT_PIN_MUX_ETMDATA_24, PortMuxPinRegId=3, PortMuxPinRegPos=24, PortMuxPinNumberPackage1=L4, PortMuxPinNumberPackage2=-, PortMuxPinDirection=PORT_MUX_PIN_DIR_OUTPUT
          Pin_M4: PortMuxPinName=ETMDATA[25], EMIF_DATA[9], PortMuxPinFunc=PORT_PIN_MUX_ETMDATA_25, PortMuxPinRegId=4, PortMuxPinRegPos=8, PortMuxPinNumberPackage1=M4, PortMuxPinNumberPackage2=-, PortMuxPinDirection=PORT_MUX_PIN_DIR_OUTPUT
          Pin_N4: PortMuxPinName=ETMDATA[26], EMIF_DATA[10], PortMuxPinFunc=PORT_PIN_MUX_ETMDATA_26, PortMuxPinRegId=5, PortMuxPinRegPos=24, PortMuxPinNumberPackage1=N4, PortMuxPinNumberPackage2=-, PortMuxPinDirection=PORT_MUX_PIN_DIR_OUTPUT
          Pin_P4: PortMuxPinName=ETMDATA[27], EMIF_DATA[11], PortMuxPinFunc=PORT_PIN_MUX_ETMDATA_27, PortMuxPinRegId=6, PortMuxPinRegPos=8, PortMuxPinNumberPackage1=P4, PortMuxPinNumberPackage2=-, PortMuxPinDirection=PORT_MUX_PIN_DIR_OUTPUT
          Pin_R5: PortMuxPinName=ETMDATA[28], EMIF_DATA[12], PortMuxPinFunc=PORT_PIN_MUX_ETMDATA_28, PortMuxPinRegId=6, PortMuxPinRegPos=24, PortMuxPinNumberPackage1=R5, PortMuxPinNumberPackage2=-, PortMuxPinDirection=PORT_MUX_PIN_DIR_OUTPUT
          Pin_R6: PortMuxPinName=ETMDATA[29], EMIF_DATA[13], PortMuxPinFunc=PORT_PIN_MUX_ETMDATA_29, PortMuxPinRegId=7, PortMuxPinRegPos=0, PortMuxPinNumberPackage1=R6, PortMuxPinNumberPackage2=-, PortMuxPinDirection=PORT_MUX_PIN_DIR_OUTPUT
          Pin_R7: PortMuxPinName=ETMDATA[30], EMIF_DATA[14], PortMuxPinFunc=PORT_PIN_MUX_ETMDATA_30, PortMuxPinRegId=7, PortMuxPinRegPos=24, PortMuxPinNumberPackage1=R7, PortMuxPinNumberPackage2=-, PortMuxPinDirection=PORT_MUX_PIN_DIR_OUTPUT
          Pin_R8: PortMuxPinName=ETMDATA[31], EMIF_DATA[15], PortMuxPinFunc=PORT_PIN_MUX_ETMDATA_31, PortMuxPinRegId=8, PortMuxPinRegPos=24, PortMuxPinNumberPackage1=R8, PortMuxPinNumberPackage2=-, PortMuxPinDirection=PORT_MUX_PIN_DIR_OUTPUT
          Pin_R9: PortMuxPinName=ETMTRACECLKIN, EXTCLKIN2, PortMuxPinFunc=PORT_PIN_MUX_ETMTRACECLKIN, PortMuxPinRegId=9, PortMuxPinRegPos=0, PortMuxPinNumberPackage1=R9, PortMuxPinNumberPackage2=-, PortMuxPinDirection=PORT_MUX_PIN_DIR_OUTPUT
          Pin_C1_9: PortMuxPinName=GIOA[2], Reserved, Reserved, NHET2[0], PortMuxPinFunc=PORT_PIN_MUX_GIOA_2, PortMuxPinRegId=2, PortMuxPinRegPos=0, PortMuxPinNumberPackage1=C1, PortMuxPinNumberPackage2=9, PortMuxPinDirection=PORT_MUX_PIN_DIR_OUTPUT
          Pin_E1: PortMuxPinName=GIOA[3], NHET2[2], PortMuxPinFunc=PORT_PIN_MUX_GIOA_3, PortMuxPinRegId=2, PortMuxPinRegPos=16, PortMuxPinNumberPackage1=E1, PortMuxPinNumberPackage2=-, PortMuxPinDirection=PORT_MUX_PIN_DIR_OUTPUT
          Pin_B5_14: PortMuxPinName=GIOA[5], EXTCLKIN, PortMuxPinFunc=PORT_PIN_MUX_GIOA_5, PortMuxPinRegId=2, PortMuxPinRegPos=24, PortMuxPinNumberPackage1=B5, PortMuxPinNumberPackage2=14, PortMuxPinDirection=PORT_MUX_PIN_DIR_OUTPUT
          Pin_H3_16: PortMuxPinName=GIOA[6], NHET2[4], PortMuxPinFunc=PORT_PIN_MUX_NHET2_4, PortMuxPinRegId=3, PortMuxPinRegPos=16, PortMuxPinNumberPackage1=H3, PortMuxPinNumberPackage2=16, PortMuxPinDirection=PORT_MUX_PIN_DIR_OUTPUT
          Pin_M1_22: PortMuxPinName=GIOA[7], NHET2[6], PortMuxPinFunc=PORT_PIN_MUX_GIOA_7, PortMuxPinRegId=4, PortMuxPinRegPos=0, PortMuxPinNumberPackage1=M1, PortMuxPinNumberPackage2=22, PortMuxPinDirection=PORT_MUX_PIN_DIR_OUTPUT
          Pin_R2_105: PortMuxPinName=MIBSPI1NCS[0], MIBSPI1SOMI[1], MII_TXD[2], PortMuxPinFunc=PORT_PIN_MUX_MIBSPI1NCS_0, PortMuxPinRegId=13, PortMuxPinRegPos=24, PortMuxPinNumberPackage1=R2, PortMuxPinNumberPackage2=105, PortMuxPinDirection=PORT_MUX_PIN_DIR_OUTPUT
          Pin_F3_130: PortMuxPinName=MIBSPI1NCS[1], NHET1[17], MII_COL, PortMuxPinFunc=PORT_PIN_MUX_MIBSPI1NCS_1, PortMuxPinRegId=20, PortMuxPinRegPos=16, PortMuxPinNumberPackage1=F3, PortMuxPinNumberPackage2=130, PortMuxPinDirection=PORT_MUX_PIN_DIR_OUTPUT
          Pin_F3_130_IN: PortMuxPinName=MIBSPI1NCS[1], NHET1[17], PortMuxPinFunc=PORT_PIN_MUX_MIBSPI1NCS_1, PortMuxPinRegId=24, PortMuxPinRegPos=16, PortMuxPinNumberPackage1=F3, PortMuxPinNumberPackage2=130, PortMuxPinDirection=PORT_MUX_PIN_DIR_INPUT
          Pin_G3_40: PortMuxPinName=MIBSPI1NCS[2], NHET1[19], MDIO, PortMuxPinFunc=PORT_PIN_MUX_MIBSPI1NCS_2, PortMuxPinRegId=8, PortMuxPinRegPos=8, PortMuxPinNumberPackage1=G3, PortMuxPinNumberPackage2=40, PortMuxPinDirection=PORT_MUX_PIN_DIR_OUTPUT
          Pin_G3_40_IN: PortMuxPinName=MIBSPI1NCS[2], NHET1[19], PortMuxPinFunc=PORT_PIN_MUX_MIBSPI1NCS_2, PortMuxPinRegId=24, PortMuxPinRegPos=24, PortMuxPinNumberPackage1=G3, PortMuxPinNumberPackage2=40, PortMuxPinDirection=PORT_MUX_PIN_DIR_INPUT
          Pin_J3: PortMuxPinName=MIBSPI1NCS[3], NHET1[21], PortMuxPinFunc=PORT_PIN_MUX_MIBSPI1NCS_3, PortMuxPinRegId=9, PortMuxPinRegPos=24, PortMuxPinNumberPackage1=J3, PortMuxPinNumberPackage2=-, PortMuxPinDirection=PORT_MUX_PIN_DIR_OUTPUT
          Pin_J3_IN: PortMuxPinName=MIBSPI1NCS[3], NHET1[21], PortMuxPinFunc=PORT_PIN_MUX_MIBSPI1NCS_3, PortMuxPinRegId=25, PortMuxPinRegPos=0, PortMuxPinNumberPackage1=J3, PortMuxPinNumberPackage2=-, PortMuxPinDirection=PORT_MUX_PIN_DIR_INPUT
          Pin_G19_96: PortMuxPinName=MIBSPI1NENA, NHET1[23], MII_RXD[2], PortMuxPinFunc=PORT_PIN_MUX_MIBSPI1NENA, PortMuxPinRegId=12, PortMuxPinRegPos=16, PortMuxPinNumberPackage1=G19, PortMuxPinNumberPackage2=96, PortMuxPinDirection=PORT_MUX_PIN_DIR_OUTPUT
          Pin_G19_96_IN: PortMuxPinName=MIBSPI1NENA, NHET1[23], PortMuxPinFunc=PORT_PIN_MUX_MIBSPI1NENA, PortMuxPinRegId=25, PortMuxPinRegPos=8, PortMuxPinNumberPackage1=G19, PortMuxPinNumberPackage2=96, PortMuxPinDirection=PORT_MUX_PIN_DIR_INPUT
          Pin_V10_55: PortMuxPinName=MIBSPI3NCS[0], AD2EVT, GIOB[2], PortMuxPinFunc=PORT_PIN_MUX_MIBSPI3NCS_0, PortMuxPinRegId=9, PortMuxPinRegPos=16, PortMuxPinNumberPackage1=V10, PortMuxPinNumberPackage2=55, PortMuxPinDirection=PORT_MUX_PIN_DIR_OUTPUT
          Pin_V10_55_IN: PortMuxPinName=MIBSPI3NCS[0], GIOB[2], PortMuxPinFunc=PORT_PIN_MUX_MIBSPI3NCS_0, PortMuxPinRegId=29, PortMuxPinRegPos=16, PortMuxPinNumberPackage1=V10, PortMuxPinNumberPackage2=55, PortMuxPinDirection=PORT_MUX_PIN_DIR_INPUT
          Pin_V5_37: PortMuxPinName=MIBSPI3NCS[1], NHET1[25], MDCLK, PortMuxPinFunc=PORT_PIN_MUX_MIBSPI3NCS_1, PortMuxPinRegId=7, PortMuxPinRegPos=8, PortMuxPinNumberPackage1=V5, PortMuxPinNumberPackage2=37, PortMuxPinDirection=PORT_MUX_PIN_DIR_OUTPUT
          Pin_V5_37_IN: PortMuxPinName=MIBSPI3NCS[1], NHET1[25], PortMuxPinFunc=PORT_PIN_MUX_MIBSPI3NCS_1, PortMuxPinRegId=25, PortMuxPinRegPos=16, PortMuxPinNumberPackage1=V5, PortMuxPinNumberPackage2=37, PortMuxPinDirection=PORT_MUX_PIN_DIR_INPUT
          Pin_B2_4: PortMuxPinName=MIBSPI3NCS[2], I2C_SDA, NHET1[27], PortMuxPinFunc=PORT_PIN_MUX_I2C_SDA, PortMuxPinRegId=0, PortMuxPinRegPos=24, PortMuxPinNumberPackage1=B2, PortMuxPinNumberPackage2=4, PortMuxPinDirection=PORT_MUX_PIN_DIR_OUTPUT
          Pin_B2_4_IN: PortMuxPinName=MIBSPI3NCS[2], NHET1[27], PortMuxPinFunc=PORT_PIN_MUX_MIBSPI3NCS_2, PortMuxPinRegId=25, PortMuxPinRegPos=24, PortMuxPinNumberPackage1=B2, PortMuxPinNumberPackage2=4, PortMuxPinDirection=PORT_MUX_PIN_DIR_INPUT
          Pin_C3_3: PortMuxPinName=MIBSPI3NCS[3], I2C_SCL, NHET1[29], PortMuxPinFunc=PORT_PIN_MUX_I2C_SCL, PortMuxPinRegId=0, PortMuxPinRegPos=16, PortMuxPinNumberPackage1=C3, PortMuxPinNumberPackage2=3, PortMuxPinDirection=PORT_MUX_PIN_DIR_OUTPUT
          Pin_C3_3_IN: PortMuxPinName=MIBSPI3NCS[3], NHET1[29], PortMuxPinFunc=PORT_PIN_MUX_MIBSPI3NCS_3, PortMuxPinRegId=26, PortMuxPinRegPos=0, PortMuxPinNumberPackage1=C3, PortMuxPinNumberPackage2=3, PortMuxPinDirection=PORT_MUX_PIN_DIR_INPUT
          Pin_W9_54: PortMuxPinName=MIBSPI3NENA, MIBSPI3NCS[5], NHET1[31], PortMuxPinFunc=PORT_PIN_MUX_MIBSPI3NENA, PortMuxPinRegId=9, PortMuxPinRegPos=8, PortMuxPinNumberPackage1=W9, PortMuxPinNumberPackage2=54, PortMuxPinDirection=PORT_MUX_PIN_DIR_OUTPUT
          Pin_W9_54_IN: PortMuxPinName=MIBSPI3NENA, NHET1[31], PortMuxPinFunc=PORT_PIN_MUX_MIBSPI3NENA, PortMuxPinRegId=26, PortMuxPinRegPos=8, PortMuxPinNumberPackage1=W9, PortMuxPinNumberPackage2=54, PortMuxPinDirection=PORT_MUX_PIN_DIR_INPUT
          Pin_H19_100: PortMuxPinName=MIBSPI5CLK, DMM_DATA[4], MII_TXEN, RMII_TXEN, PortMuxPinFunc=PORT_PIN_MUX_MIBSPI5CLK, PortMuxPinRegId=13, PortMuxPinRegPos=16, PortMuxPinNumberPackage1=H19, PortMuxPinNumberPackage2=100, PortMuxPinDirection=PORT_MUX_PIN_DIR_OUTPUT
          Pin_E19_32: PortMuxPinName=MIBSPI5NCS[0], DMM_DATA[5], PortMuxPinFunc=PORT_PIN_MUX_MIBSPI5NCS_0, PortMuxPinRegId=27, PortMuxPinRegPos=0, PortMuxPinNumberPackage1=E19, PortMuxPinNumberPackage2=32, PortMuxPinDirection=PORT_MUX_PIN_DIR_OUTPUT
          Pin_B6: PortMuxPinName=MIBSPI5NCS[1], DMM_DATA[6], PortMuxPinFunc=PORT_PIN_MUX_MIBSPI5NCS_1, PortMuxPinRegId=27, PortMuxPinRegPos=8, PortMuxPinNumberPackage1=B6, PortMuxPinNumberPackage2=-, PortMuxPinDirection=PORT_MUX_PIN_DIR_OUTPUT
          Pin_W6: PortMuxPinName=MIBSPI5NCS[2], DMM_DATA[2], PortMuxPinFunc=PORT_PIN_MUX_MIBSPI5NCS_2, PortMuxPinRegId=26, PortMuxPinRegPos=16, PortMuxPinNumberPackage1=W6, PortMuxPinNumberPackage2=-, PortMuxPinDirection=PORT_MUX_PIN_DIR_OUTPUT
          Pin_T12: PortMuxPinName=MIBSPI5NCS[3], DMM_DATA[3], PortMuxPinFunc=PORT_PIN_MUX_MIBSPI5NCS_3, PortMuxPinRegId=26, PortMuxPinRegPos=24, PortMuxPinNumberPackage1=T12, PortMuxPinNumberPackage2=-, PortMuxPinDirection=PORT_MUX_PIN_DIR_OUTPUT
          Pin_H18_97: PortMuxPinName=MIBSPI5NENA, DMM_DATA[7], MII_RXD[3], PortMuxPinFunc=PORT_PIN_MUX_MIBSPI5NENA, PortMuxPinRegId=12, PortMuxPinRegPos=24, PortMuxPinNumberPackage1=H18, PortMuxPinNumberPackage2=97, PortMuxPinDirection=PORT_MUX_PIN_DIR_OUTPUT
          Pin_J19_99: PortMuxPinName=MIBSPI5SIMO[0], DMM_DATA[8], MII_TXD[1], RMII_TXD[1], PortMuxPinFunc=PORT_PIN_MUX_MIBSPI5SIMO_0, PortMuxPinRegId=13, PortMuxPinRegPos=8, PortMuxPinNumberPackage1=J19, PortMuxPinNumberPackage2=99, PortMuxPinDirection=PORT_MUX_PIN_DIR_OUTPUT
          Pin_E16: PortMuxPinName=MIBSPI5SIMO[1], DMM_DATA[9], PortMuxPinFunc=PORT_PIN_MUX_MIBSPI5SIMO_1, PortMuxPinRegId=27, PortMuxPinRegPos=16, PortMuxPinNumberPackage1=E16, PortMuxPinNumberPackage2=-, PortMuxPinDirection=PORT_MUX_PIN_DIR_OUTPUT
          Pin_H17: PortMuxPinName=MIBSPI5SIMO[2], DMM_DATA[10], PortMuxPinFunc=PORT_PIN_MUX_MIBSPI5SIMO_2, PortMuxPinRegId=27, PortMuxPinRegPos=24, PortMuxPinNumberPackage1=H17, PortMuxPinNumberPackage2=-, PortMuxPinDirection=PORT_MUX_PIN_DIR_OUTPUT
          Pin_G17: PortMuxPinName=MIBSPI5SIMO[3], DMM_DATA[11], PortMuxPinFunc=PORT_PIN_MUX_MIBSPI5SIMO_3, PortMuxPinRegId=28, PortMuxPinRegPos=0, PortMuxPinNumberPackage1=G17, PortMuxPinNumberPackage2=-, PortMuxPinDirection=PORT_MUX_PIN_DIR_OUTPUT
          Pin_J18_98: PortMuxPinName=MIBSPI5SOMI[0], DMM_DATA[12], MII_TXD[0], RMII_TXD[0], PortMuxPinFunc=PORT_PIN_MUX_MIBSPI5SOMI_0, PortMuxPinRegId=13, PortMuxPinRegPos=0, PortMuxPinNumberPackage1=J18, PortMuxPinNumberPackage2=98, PortMuxPinDirection=PORT_MUX_PIN_DIR_OUTPUT
          Pin_E17: PortMuxPinName=MIBSPI5SOMI[1], DMM_DATA[13], PortMuxPinFunc=PORT_PIN_MUX_MIBSPI5SOMI_1, PortMuxPinRegId=28, PortMuxPinRegPos=8, PortMuxPinNumberPackage1=E17, PortMuxPinNumberPackage2=-, PortMuxPinDirection=PORT_MUX_PIN_DIR_OUTPUT
          Pin_H16: PortMuxPinName=MIBSPI5SOMI[2], DMM_DATA[14], PortMuxPinFunc=PORT_PIN_MUX_MIBSPI5SOMI_2, PortMuxPinRegId=28, PortMuxPinRegPos=16, PortMuxPinNumberPackage1=H16, PortMuxPinNumberPackage2=-, PortMuxPinDirection=PORT_MUX_PIN_DIR_OUTPUT
          Pin_G16: PortMuxPinName=MIBSPI5SOMI[3], DMM_DATA[15], PortMuxPinFunc=PORT_PIN_MUX_MIBSPI5SOMI_3, PortMuxPinRegId=28, PortMuxPinRegPos=24, PortMuxPinNumberPackage1=G16, PortMuxPinNumberPackage2=-, PortMuxPinDirection=PORT_MUX_PIN_DIR_OUTPUT
          Pin_K18_25: PortMuxPinName=NHET1[0], SPI4CLK, PortMuxPinFunc=PORT_PIN_MUX_NHET1_0, PortMuxPinRegId=5, PortMuxPinRegPos=0, PortMuxPinNumberPackage1=K18, PortMuxPinNumberPackage2=25, PortMuxPinDirection=PORT_MUX_PIN_DIR_OUTPUT
          Pin_K18_25_IN: PortMuxPinName=NHET1[0], SPI4CLK, PortMuxPinFunc=PORT_PIN_MUX_NHET1_0, PortMuxPinRegId=23, PortMuxPinRegPos=8, PortMuxPinNumberPackage1=K18, PortMuxPinNumberPackage2=25, PortMuxPinDirection=PORT_MUX_PIN_DIR_INPUT
          Pin_V2_23: PortMuxPinName=NHET1[01], SPI4NENA, NHET2[8], PortMuxPinFunc=PORT_PIN_MUX_NHET2_8, PortMuxPinRegId=4, PortMuxPinRegPos=16, PortMuxPinNumberPackage1=V2, PortMuxPinNumberPackage2=23, PortMuxPinDirection=PORT_MUX_PIN_DIR_OUTPUT
          Pin_W5_30: PortMuxPinName=NHET1[02], SPI4SIMO, PortMuxPinFunc=PORT_PIN_MUX_NHET1_02, PortMuxPinRegId=5, PortMuxPinRegPos=8, PortMuxPinNumberPackage1=W5, PortMuxPinNumberPackage2=30, PortMuxPinDirection=PORT_MUX_PIN_DIR_OUTPUT
          Pin_W5_30_IN: PortMuxPinName=NHET1[02], SPI4SIMO, PortMuxPinFunc=PORT_PIN_MUX_NHET1_02, PortMuxPinRegId=23, PortMuxPinRegPos=16, PortMuxPinNumberPackage1=W5, PortMuxPinNumberPackage2=30, PortMuxPinDirection=PORT_MUX_PIN_DIR_INPUT
          Pin_U1_24: PortMuxPinName=NHET1[03], SPI4NCS[0], NHET2[10], PortMuxPinFunc=PORT_PIN_MUX_NHET2_10, PortMuxPinRegId=4, PortMuxPinRegPos=24, PortMuxPinNumberPackage1=U1, PortMuxPinNumberPackage2=24, PortMuxPinDirection=PORT_MUX_PIN_DIR_OUTPUT
          Pin_V6_31: PortMuxPinName=NHET1[05], SPI4SOMI, NHET2[12], PortMuxPinFunc=PORT_PIN_MUX_NHET2_12, PortMuxPinRegId=5, PortMuxPinRegPos=16, PortMuxPinNumberPackage1=V6, PortMuxPinNumberPackage2=31, PortMuxPinDirection=PORT_MUX_PIN_DIR_OUTPUT
          Pin_V6_31_IN: PortMuxPinName=NHET1[05], SPI4SOMI, PortMuxPinFunc=PORT_PIN_MUX_NHET1_05, PortMuxPinRegId=23, PortMuxPinRegPos=24, PortMuxPinNumberPackage1=V6, PortMuxPinNumberPackage2=31, PortMuxPinDirection=PORT_MUX_PIN_DIR_INPUT
          Pin_W3_38: PortMuxPinName=NHET1[06], SCIRX, PortMuxPinFunc=PORT_PIN_MUX_NHET1_06, PortMuxPinRegId=7, PortMuxPinRegPos=16, PortMuxPinNumberPackage1=W3, PortMuxPinNumberPackage2=38, PortMuxPinDirection=PORT_MUX_PIN_DIR_OUTPUT
          Pin_T1_33: PortMuxPinName=NHET1[07], Reserved, Reserved, NHET2[14], PortMuxPinFunc=PORT_PIN_MUX_NHET2_14, PortMuxPinRegId=6, PortMuxPinRegPos=0, PortMuxPinNumberPackage1=T1, PortMuxPinNumberPackage2=33, PortMuxPinDirection=PORT_MUX_PIN_DIR_OUTPUT
          Pin_E18_106: PortMuxPinName=NHET1[08], MIBSPI1SIMO[1], MII_TXD[3], PortMuxPinFunc=PORT_PIN_MUX_NHET1_08, PortMuxPinRegId=14, PortMuxPinRegPos=0, PortMuxPinNumberPackage1=E18, PortMuxPinNumberPackage2=106, PortMuxPinDirection=PORT_MUX_PIN_DIR_OUTPUT
          Pin_V7_35: PortMuxPinName=NHET1[09], NHET2[16], PortMuxPinFunc=PORT_PIN_MUX_NHET1_09, PortMuxPinRegId=6, PortMuxPinRegPos=16, PortMuxPinNumberPackage1=V7, PortMuxPinNumberPackage2=35, PortMuxPinDirection=PORT_MUX_PIN_DIR_OUTPUT
          Pin_D19_118: PortMuxPinName=NHET1[10], MII_TX_CLK, Reserved, MII_TX_AVCLK4, PortMuxPinFunc=PORT_PIN_MUX_NHET1_10, PortMuxPinRegId=17, PortMuxPinRegPos=0, PortMuxPinNumberPackage1=D19, PortMuxPinNumberPackage2=118, PortMuxPinDirection=PORT_MUX_PIN_DIR_OUTPUT
          Pin_E3_6: PortMuxPinName=NHET1[11], MIBSPI3NCS[4], NHET2[18], PortMuxPinFunc=PORT_PIN_MUX_NHET2_18, PortMuxPinRegId=1, PortMuxPinRegPos=8, PortMuxPinNumberPackage1=E3, PortMuxPinNumberPackage2=6, PortMuxPinDirection=PORT_MUX_PIN_DIR_OUTPUT
          Pin_B4_124: PortMuxPinName=NHET1[12], MII_CRS, RMII_CRS_DV, PortMuxPinFunc=PORT_PIN_MUX_NHET1_12, PortMuxPinRegId=17, PortMuxPinRegPos=16, PortMuxPinNumberPackage1=B4, PortMuxPinNumberPackage2=124, PortMuxPinDirection=PORT_MUX_PIN_DIR_OUTPUT
          Pin_N2_39: PortMuxPinName=NHET1[13], SCITX, PortMuxPinFunc=PORT_PIN_MUX_NHET1_13, PortMuxPinRegId=8, PortMuxPinRegPos=0, PortMuxPinNumberPackage1=N2, PortMuxPinNumberPackage2=39, PortMuxPinDirection=PORT_MUX_PIN_DIR_OUTPUT
          Pin_N1_41: PortMuxPinName=NHET1[15], MIBSPI1NCS[4], PortMuxPinFunc=PORT_PIN_MUX_NHET1_15, PortMuxPinRegId=8, PortMuxPinRegPos=16, PortMuxPinNumberPackage1=N1, PortMuxPinNumberPackage2=41, PortMuxPinDirection=PORT_MUX_PIN_DIR_OUTPUT
          Pin_P1_91: PortMuxPinName=NHET1[24], MIBSPI1NCS[5], MII_RXD[0], RMII_RXD[0], PortMuxPinFunc=PORT_PIN_MUX_NHET1_24, PortMuxPinRegId=11, PortMuxPinRegPos=24, PortMuxPinNumberPackage1=P1, PortMuxPinNumberPackage2=91, PortMuxPinDirection=PORT_MUX_PIN_DIR_OUTPUT
          Pin_A14_92: PortMuxPinName=NHET1[26], MII_RXD[1], RMII_RXD[1], PortMuxPinFunc=PORT_PIN_MUX_NHET1_26, PortMuxPinRegId=12, PortMuxPinRegPos=0, PortMuxPinNumberPackage1=A14, PortMuxPinNumberPackage2=92, PortMuxPinDirection=PORT_MUX_PIN_DIR_OUTPUT
          Pin_K19_107: PortMuxPinName=NHET1[28], MII_RXCLK, RMII_REFCLK, MII_RX_AVCLK4, PortMuxPinFunc=PORT_PIN_MUX_NHET1_28, PortMuxPinRegId=14, PortMuxPinRegPos=8, PortMuxPinNumberPackage1=K19, PortMuxPinNumberPackage2=107, PortMuxPinDirection=PORT_MUX_PIN_DIR_OUTPUT
          Pin_B11_127: PortMuxPinName=NHET1[30], MII_RX_DV, PortMuxPinFunc=PORT_PIN_MUX_NHET1_30, PortMuxPinRegId=19, PortMuxPinRegPos=8, PortMuxPinNumberPackage1=B11, PortMuxPinNumberPackage2=127, PortMuxPinDirection=PORT_MUX_PIN_DIR_OUTPUT
          Pin_D3_54: PortMuxPinName=SPI2NENA, SPI2NCS[1], PortMuxPinFunc=PORT_PIN_MUX_SPI2NENA, PortMuxPinRegId=29, PortMuxPinRegPos=0, PortMuxPinNumberPackage1=D3, PortMuxPinNumberPackage2=54, PortMuxPinDirection=PORT_MUX_PIN_DIR_OUTPUT
      19 x PortContainer, all with PortAvailablePackage1=true:
        GIOB: PortNumberOfPortPins=8, PortUse=false, PortName=GIO B, PortRegPostfix=GIOB, PortAvailablePackage0=true, PortAvailablePackage2=true, PortAvailablePackage3=false, PortAvailablePackage4=false, PortRegBaseAddr=4294425680, PortRegStructure=PORT_REG_STRUCT_REGULAR_NO_FUNC, PortContainsPrivReg=false
          8 x PortPin, all with PortPinDirection=PORT_PIN_IN, PortPinDirectionChangeable=false, PortPinInitialMode=PORT_PIN_MODE_DIO, PortPinLevelValue=PORT_PIN_LEVEL_LOW, PortPinMode=PORT_PIN_MODE_DIO, PortPinOpenDrain=PORT_PUSH_PULL, PortPinPullSelect=PORT_PULL_UP, PortPinRefresh=false, PortPinChannelName=(unset), PortPinAvailablePackage0=true, PortPinAvailablePackage1=true, PortPinAvailablePackage2=true, PortPinAvailablePackage3=false, PortPinAvailablePackage4=false, PortPinSlewRate=PORT_PIN_SLEW_RATE_NA:
            PortPinGioB_{0..7}: PortPinId={0..7}, PortPinName=GIOB{0..7}
        CAN1: PortNumberOfPortPins=2, PortUse=false, PortName=CAN 1, PortRegPostfix=CAN1, PortAvailablePackage0=false, PortAvailablePackage2=true, PortAvailablePackage3=false, PortAvailablePackage4=false, PortRegBaseAddr=4294434272, PortRegStructure=PORT_REG_STRUCT_SHORT, PortContainsPrivReg=true
          PortPinCan1_0 (PortPin):
            PortPinDirection = PORT_PIN_IN
            PortPinDirectionChangeable = false
            PortPinId = 0
            PortPinInitialMode = PORT_PIN_MODE_CAN
            PortPinLevelValue = PORT_PIN_LEVEL_LOW
            PortPinMode = PORT_PIN_MODE_DIO
            PortPinOpenDrain = PORT_PUSH_PULL
            PortPinPullSelect = PORT_PULL_UP
            PortPinRefresh = true
            PortPinChannelName = (unset)
            PortPinAvailablePackage0 = false
            PortPinAvailablePackage1 = true
            PortPinAvailablePackage2 = true
            PortPinAvailablePackage3 = false
            PortPinAvailablePackage4 = false
            PortPinSlewRate = PORT_PIN_SLEW_RATE_NA
            PortPinName = CAN1TX
          PortPinCan1_1 (PortPin):
            PortPinDirection = PORT_PIN_IN
            PortPinDirectionChangeable = false
            PortPinId = 1
            PortPinInitialMode = PORT_PIN_MODE_CAN
            PortPinLevelValue = PORT_PIN_LEVEL_LOW
            PortPinMode = PORT_PIN_MODE_DIO
            PortPinOpenDrain = PORT_PUSH_PULL
            PortPinPullSelect = PORT_PULL_UP
            PortPinRefresh = false
            PortPinChannelName = (unset)
            PortPinAvailablePackage0 = false
            PortPinAvailablePackage1 = true
            PortPinAvailablePackage2 = true
            PortPinAvailablePackage3 = false
            PortPinAvailablePackage4 = false
            PortPinSlewRate = PORT_PIN_SLEW_RATE_NA
            PortPinName = CAN1RX
        CAN2: PortNumberOfPortPins=2, PortUse=false, PortName=CAN 2, PortRegPostfix=CAN2, PortAvailablePackage0=false, PortAvailablePackage2=true, PortAvailablePackage3=false, PortAvailablePackage4=false, PortRegBaseAddr=4294434784, PortRegStructure=PORT_REG_STRUCT_SHORT, PortContainsPrivReg=true
          PortPinCan2_0 (PortPin):
            PortPinDirection = PORT_PIN_IN
            PortPinDirectionChangeable = false
            PortPinId = 0
            PortPinInitialMode = PORT_PIN_MODE_CAN
            PortPinLevelValue = PORT_PIN_LEVEL_LOW
            PortPinMode = PORT_PIN_MODE_DIO
            PortPinOpenDrain = PORT_PUSH_PULL
            PortPinPullSelect = PORT_PULL_UP
            PortPinRefresh = false
            PortPinChannelName = (unset)
            PortPinAvailablePackage0 = false
            PortPinAvailablePackage1 = true
            PortPinAvailablePackage2 = true
            PortPinAvailablePackage3 = false
            PortPinAvailablePackage4 = false
            PortPinSlewRate = PORT_PIN_SLEW_RATE_NA
            PortPinName = CAN2TX
          PortPinCan2_1 (PortPin):
            PortPinDirection = PORT_PIN_IN
            PortPinDirectionChangeable = false
            PortPinId = 1
            PortPinInitialMode = PORT_PIN_MODE_CAN
            PortPinLevelValue = PORT_PIN_LEVEL_LOW
            PortPinMode = PORT_PIN_MODE_DIO
            PortPinOpenDrain = PORT_PUSH_PULL
            PortPinPullSelect = PORT_PULL_UP
            PortPinRefresh = false
            PortPinChannelName = (unset)
            PortPinAvailablePackage0 = false
            PortPinAvailablePackage1 = true
            PortPinAvailablePackage2 = true
            PortPinAvailablePackage3 = false
            PortPinAvailablePackage4 = false
            PortPinSlewRate = PORT_PIN_SLEW_RATE_NA
            PortPinName = CAN2RX
        CAN3: PortNumberOfPortPins=2, PortUse=true, PortName=CAN 3, PortRegPostfix=CAN3, PortAvailablePackage0=false, PortAvailablePackage2=true, PortAvailablePackage3=false, PortAvailablePackage4=false, PortRegBaseAddr=4294435296, PortRegStructure=PORT_REG_STRUCT_SHORT, PortContainsPrivReg=true
          PortPinCan3_0 (PortPin):
            PortPinDirection = PORT_PIN_OUT
            PortPinDirectionChangeable = false
            PortPinId = 0
            PortPinInitialMode = PORT_PIN_MODE_DIO
            PortPinLevelValue = PORT_PIN_LEVEL_LOW
            PortPinMode = PORT_PIN_MODE_DIO
            PortPinOpenDrain = PORT_PUSH_PULL
            PortPinPullSelect = PORT_PULL_UP
            PortPinRefresh = false
            PortPinChannelName = WdReset
            PortPinAvailablePackage0 = false
            PortPinAvailablePackage1 = true
            PortPinAvailablePackage2 = true
            PortPinAvailablePackage3 = false
            PortPinAvailablePackage4 = false
            PortPinSlewRate = PORT_PIN_SLEW_RATE_NA
            PortPinName = CAN3TX
          PortPinCan3_1 (PortPin):
            PortPinDirection = PORT_PIN_OUT
            PortPinDirectionChangeable = false
            PortPinId = 1
            PortPinInitialMode = PORT_PIN_MODE_DIO
            PortPinLevelValue = PORT_PIN_LEVEL_LOW
            PortPinMode = PORT_PIN_MODE_DIO
            PortPinOpenDrain = PORT_PUSH_PULL
            PortPinPullSelect = PORT_PULL_UP
            PortPinRefresh = false
            PortPinChannelName = WdMonitor
            PortPinAvailablePackage0 = false
            PortPinAvailablePackage1 = true
            PortPinAvailablePackage2 = true
            PortPinAvailablePackage3 = false
            PortPinAvailablePackage4 = false
            PortPinSlewRate = PORT_PIN_SLEW_RATE_NA
            PortPinName = CAN3RX
        LIN: PortNumberOfPortPins=2, PortUse=false, PortName=LIN, PortRegPostfix=LIN, PortAvailablePackage0=false, PortAvailablePackage2=true, PortAvailablePackage3=false, PortAvailablePackage4=false, PortRegBaseAddr=4294435900, PortRegStructure=PORT_REG_STRUCT_REGULAR_SLEW_1, PortContainsPrivReg=false
          PortPinLin1_0 (PortPin):
            PortPinDirection = PORT_PIN_IN
            PortPinDirectionChangeable = false
            PortPinId = 1
            PortPinInitialMode = PORT_PIN_MODE_DIO
            PortPinLevelValue = PORT_PIN_LEVEL_LOW
            PortPinMode = PORT_PIN_MODE_DIO
            PortPinOpenDrain = PORT_PUSH_PULL
            PortPinPullSelect = PORT_PULL_UP
            PortPinRefresh = false
            PortPinChannelName = (unset)
            PortPinAvailablePackage0 = false
            PortPinAvailablePackage1 = true
            PortPinAvailablePackage2 = true
            PortPinAvailablePackage3 = false
            PortPinAvailablePackage4 = false
            PortPinSlewRate = PORT_PIN_SLEW_RATE_NA
            PortPinName = LINRX
          PortPinLin1_1 (PortPin):
            PortPinDirection = PORT_PIN_IN
            PortPinDirectionChangeable = false
            PortPinId = 2
            PortPinInitialMode = PORT_PIN_MODE_DIO
            PortPinLevelValue = PORT_PIN_LEVEL_LOW
            PortPinMode = PORT_PIN_MODE_DIO
            PortPinOpenDrain = PORT_PUSH_PULL
            PortPinPullSelect = PORT_PULL_UP
            PortPinRefresh = false
            PortPinChannelName = (unset)
            PortPinAvailablePackage0 = false
            PortPinAvailablePackage1 = true
            PortPinAvailablePackage2 = true
            PortPinAvailablePackage3 = false
            PortPinAvailablePackage4 = false
            PortPinSlewRate = PORT_PIN_SLEW_RATE_NA
            PortPinName = LINTX
        SCI: PortNumberOfPortPins=2, PortUse=false, PortName=SCI, PortRegPostfix=SCI, PortAvailablePackage0=false, PortAvailablePackage2=true, PortAvailablePackage3=false, PortAvailablePackage4=false, PortRegBaseAddr=4294436156, PortRegStructure=PORT_REG_STRUCT_REGULAR_SLEW_1, PortContainsPrivReg=false
          PortPinSci1_0 (PortPin):
            PortPinDirection = PORT_PIN_IN
            PortPinDirectionChangeable = false
            PortPinId = 1
            PortPinInitialMode = PORT_PIN_MODE_DIO
            PortPinLevelValue = PORT_PIN_LEVEL_LOW
            PortPinMode = PORT_PIN_MODE_DIO
            PortPinOpenDrain = PORT_PUSH_PULL
            PortPinPullSelect = PORT_PULL_UP
            PortPinRefresh = false
            PortPinChannelName = (unset)
            PortPinAvailablePackage0 = false
            PortPinAvailablePackage1 = true
            PortPinAvailablePackage2 = true
            PortPinAvailablePackage3 = false
            PortPinAvailablePackage4 = false
            PortPinSlewRate = PORT_PIN_SLEW_RATE_NA
            PortPinName = SCIRX
          PortPinSci1_1 (PortPin):
            PortPinDirection = PORT_PIN_IN
            PortPinDirectionChangeable = false
            PortPinId = 2
            PortPinInitialMode = PORT_PIN_MODE_DIO
            PortPinLevelValue = PORT_PIN_LEVEL_LOW
            PortPinMode = PORT_PIN_MODE_DIO
            PortPinOpenDrain = PORT_PUSH_PULL
            PortPinPullSelect = PORT_PULL_UP
            PortPinRefresh = false
            PortPinChannelName = (unset)
            PortPinAvailablePackage0 = false
            PortPinAvailablePackage1 = true
            PortPinAvailablePackage2 = true
            PortPinAvailablePackage3 = false
            PortPinAvailablePackage4 = false
            PortPinSlewRate = PORT_PIN_SLEW_RATE_NA
            PortPinName = SCITX
        I2C: PortNumberOfPortPins=2, PortUse=false, PortName=I2C, PortRegPostfix=IIC, PortAvailablePackage0=false, PortAvailablePackage2=true, PortAvailablePackage3=false, PortAvailablePackage4=false, PortRegBaseAddr=4294431816, PortRegStructure=PORT_REG_STRUCT_REGULAR_SLEW_1, PortContainsPrivReg=false
          PortPinIic_0 (PortPin):
            PortPinDirection = PORT_PIN_OUT
            PortPinDirectionChangeable = false
            PortPinId = 1
            PortPinInitialMode = PORT_PIN_MODE_DIO
            PortPinLevelValue = PORT_PIN_LEVEL_LOW
            PortPinMode = PORT_PIN_MODE_DIO
            PortPinOpenDrain = PORT_OPEN_DRAIN
            PortPinPullSelect = PORT_PULL_UP
            PortPinRefresh = false
            PortPinChannelName = (unset)
            PortPinAvailablePackage0 = false
            PortPinAvailablePackage1 = true
            PortPinAvailablePackage2 = true
            PortPinAvailablePackage3 = false
            PortPinAvailablePackage4 = false
            PortPinSlewRate = PORT_PIN_SLEW_RATE_NA
            PortPinName = I2C_SCL
          PortPinIic_1 (PortPin):
            PortPinDirection = PORT_PIN_OUT
            PortPinDirectionChangeable = false
            PortPinId = 2
            PortPinInitialMode = PORT_PIN_MODE_DIO
            PortPinLevelValue = PORT_PIN_LEVEL_LOW
            PortPinMode = PORT_PIN_MODE_DIO
            PortPinOpenDrain = PORT_OPEN_DRAIN
            PortPinPullSelect = PORT_PULL_UP
            PortPinRefresh = false
            PortPinChannelName = (unset)
            PortPinAvailablePackage0 = false
            PortPinAvailablePackage1 = true
            PortPinAvailablePackage2 = true
            PortPinAvailablePackage3 = false
            PortPinAvailablePackage4 = false
            PortPinSlewRate = PORT_PIN_SLEW_RATE_NA
            PortPinName = I2C_SDA
        SPI1: PortNumberOfPortPins=16, PortUse=false, PortName=MBSPI 1, PortRegPostfix=SPI1, PortAvailablePackage0=true, PortAvailablePackage2=true, PortAvailablePackage3=true, PortAvailablePackage4=true, PortRegBaseAddr=4294439956, PortRegStructure=PORT_REG_STRUCT_REGULAR_SLEW_2, PortContainsPrivReg=false
          12 x PortPin, all with PortPinDirection=PORT_PIN_IN, PortPinDirectionChangeable=false, PortPinInitialMode=PORT_PIN_MODE_SPI, PortPinLevelValue=PORT_PIN_LEVEL_LOW, PortPinMode=PORT_PIN_MODE_DIO, PortPinOpenDrain=PORT_PUSH_PULL, PortPinPullSelect=PORT_PULL_UP, PortPinRefresh=false, PortPinChannelName=(unset), PortPinAvailablePackage0=true, PortPinAvailablePackage1=true, PortPinAvailablePackage2=true, PortPinAvailablePackage3=true, PortPinSlewRate=PORT_PIN_SLEW_RATE_NA:
            PortPinSpi1_0: PortPinId=9, PortPinAvailablePackage4=true, PortPinName=SPI1CLK
            PortPinSpi1_1: PortPinId=0, PortPinAvailablePackage4=true, PortPinName=SPI1NCS0
            PortPinSpi1_2: PortPinId=1, PortPinAvailablePackage4=true, PortPinName=SPI1NCS1
            PortPinSpi1_3: PortPinId=2, PortPinAvailablePackage4=false, PortPinName=SPI1NCS2
            PortPinSpi1_4: PortPinId=3, PortPinAvailablePackage4=false, PortPinName=SPI1NCS3
            PortPinSpi1_5: PortPinId=4, PortPinAvailablePackage4=false, PortPinName=SPI1NCS4
            PortPinSpi1_6: PortPinId=5, PortPinAvailablePackage4=false, PortPinName=SPI1NCS5
            PortPinSpi1_7: PortPinId=8, PortPinAvailablePackage4=true, PortPinName=SPI1NENA
            PortPinSpi1_8: PortPinId=10, PortPinAvailablePackage4=true, PortPinName=SPI1SIMO0
            PortPinSpi1_9: PortPinId=17, PortPinAvailablePackage4=true, PortPinName=SPI1SIMO1
            PortPinSpi1_10: PortPinId=11, PortPinAvailablePackage4=true, PortPinName=SPI1SOMI0
            PortPinSpi1_11: PortPinId=25, PortPinAvailablePackage4=true, PortPinName=SPI1SOMI1
        SPI2: PortNumberOfPortPins=8, PortUse=false, PortName=SPI 2, PortRegPostfix=SPI2, PortAvailablePackage0=false, PortAvailablePackage2=true, PortAvailablePackage3=false, PortAvailablePackage4=false, PortRegBaseAddr=4294440468, PortRegStructure=PORT_REG_STRUCT_REGULAR_SLEW_2, PortContainsPrivReg=false
          6 x PortPin, all with PortPinDirection=PORT_PIN_IN, PortPinDirectionChangeable=false, PortPinInitialMode=PORT_PIN_MODE_DIO, PortPinLevelValue=PORT_PIN_LEVEL_LOW, PortPinMode=PORT_PIN_MODE_DIO, PortPinOpenDrain=PORT_PUSH_PULL, PortPinPullSelect=PORT_PULL_UP, PortPinRefresh=false, PortPinChannelName=(unset), PortPinAvailablePackage0=false, PortPinAvailablePackage1=true, PortPinAvailablePackage2=true, PortPinAvailablePackage3=false, PortPinAvailablePackage4=false, PortPinSlewRate=PORT_PIN_SLEW_RATE_NA:
            PortPinSpi2_0: PortPinId=9, PortPinName=SPI2CLK
            PortPinSpi2_1: PortPinId=0, PortPinName=SPI2NCS0
            PortPinSpi2_2: PortPinId=1, PortPinName=SPI2NCS1
            PortPinSpi2_5: PortPinId=8, PortPinName=SPI2NENA
            PortPinSpi2_6: PortPinId=10, PortPinName=SPI2SIMO
            PortPinSpi2_7: PortPinId=11, PortPinName=SPI2SOMI
        SPI3: PortNumberOfPortPins=16, PortUse=true, PortName=MBSPI 3, PortRegPostfix=SPI3, PortAvailablePackage0=true, PortAvailablePackage2=true, PortAvailablePackage3=true, PortAvailablePackage4=true, PortRegBaseAddr=4294440980, PortRegStructure=PORT_REG_STRUCT_REGULAR_SLEW_2, PortContainsPrivReg=false
          10 x PortPin, all with PortPinDirectionChangeable=false, PortPinLevelValue=PORT_PIN_LEVEL_LOW, PortPinMode=PORT_PIN_MODE_DIO, PortPinOpenDrain=PORT_PUSH_PULL, PortPinPullSelect=PORT_PULL_UP, PortPinRefresh=false, PortPinAvailablePackage0=true, PortPinAvailablePackage1=true, PortPinAvailablePackage2=true, PortPinAvailablePackage3=true, PortPinSlewRate=PORT_PIN_SLEW_RATE_NA:
            PortPinSpi3_0: PortPinDirection=PORT_PIN_OUT, PortPinId=9, PortPinInitialMode=PORT_PIN_MODE_SPI, PortPinChannelName=MS_SCLK1, PortPinAvailablePackage4=true, PortPinName=SPI3CLK
            PortPinSpi3_1: PortPinDirection=PORT_PIN_OUT, PortPinId=0, PortPinInitialMode=PORT_PIN_MODE_SPI, PortPinChannelName=MS_CSN1, PortPinAvailablePackage4=true, PortPinName=SPI3NCS0
            PortPinSpi3_2: PortPinDirection=PORT_PIN_OUT, PortPinId=1, PortPinInitialMode=PORT_PIN_MODE_DIO, PortPinChannelName=FetDrvReset, PortPinAvailablePackage4=true, PortPinName=SPI3NCS1
            PortPinSpi3_3: PortPinDirection=PORT_PIN_IN, PortPinId=2, PortPinInitialMode=PORT_PIN_MODE_SPI, PortPinChannelName=(unset), PortPinAvailablePackage4=false, PortPinName=SPI3NCS2
            PortPinSpi3_4: PortPinDirection=PORT_PIN_IN, PortPinId=3, PortPinInitialMode=PORT_PIN_MODE_SPI, PortPinChannelName=(unset), PortPinAvailablePackage4=false, PortPinName=SPI3NCS3
            PortPinSpi3_7: PortPinDirection=PORT_PIN_IN, PortPinId=8, PortPinInitialMode=PORT_PIN_MODE_SPI, PortPinChannelName=(unset), PortPinAvailablePackage4=true, PortPinName=SPI3NENA
            PortPinSpi3_8: PortPinDirection=PORT_PIN_OUT, PortPinId=10, PortPinInitialMode=PORT_PIN_MODE_SPI, PortPinChannelName=MS_MOSI1, PortPinAvailablePackage4=true, PortPinName=SPI3SIMO
            PortPinSpi3_10: PortPinDirection=PORT_PIN_IN, PortPinId=11, PortPinInitialMode=PORT_PIN_MODE_SPI, PortPinChannelName=MS_MISO1, PortPinAvailablePackage4=true, PortPinName=SPI3SOMI
            PortPinSpi3_5: PortPinDirection=PORT_PIN_IN, PortPinId=4, PortPinInitialMode=PORT_PIN_MODE_SPI, PortPinChannelName=(unset), PortPinAvailablePackage4=true, PortPinName=SPI3NCS4
            PortPinSpi3_6: PortPinDirection=PORT_PIN_IN, PortPinId=5, PortPinInitialMode=PORT_PIN_MODE_SPI, PortPinChannelName=(unset), PortPinAvailablePackage4=true, PortPinName=SPI3NCS5
        SPI4: PortNumberOfPortPins=8, PortUse=false, PortName=SPI 4, PortRegPostfix=SPI4, PortAvailablePackage0=false, PortAvailablePackage2=true, PortAvailablePackage3=false, PortAvailablePackage4=false, PortRegBaseAddr=4294441492, PortRegStructure=PORT_REG_STRUCT_REGULAR_SLEW_2, PortContainsPrivReg=false
          5 x PortPin, all with PortPinDirection=PORT_PIN_IN, PortPinDirectionChangeable=false, PortPinInitialMode=PORT_PIN_MODE_DIO, PortPinLevelValue=PORT_PIN_LEVEL_LOW, PortPinMode=PORT_PIN_MODE_DIO, PortPinOpenDrain=PORT_PUSH_PULL, PortPinPullSelect=PORT_PULL_UP, PortPinRefresh=false, PortPinChannelName=(unset), PortPinAvailablePackage0=false, PortPinAvailablePackage1=true, PortPinAvailablePackage2=true, PortPinAvailablePackage3=false, PortPinAvailablePackage4=false, PortPinSlewRate=PORT_PIN_SLEW_RATE_NA:
            PortPinSpi4_0: PortPinId=9, PortPinName=SPI4CLK
            PortPinSpi4_1: PortPinId=0, PortPinName=SPI4NCS0
            PortPinSpi4_5: PortPinId=8, PortPinName=SPI4NENA
            PortPinSpi4_6: PortPinId=10, PortPinName=SPI4SIMO
            PortPinSpi4_7: PortPinId=11, PortPinName=SPI4SOMI
        SPI5: PortNumberOfPortPins=16, PortUse=true, PortName=MBSPI 5, PortRegPostfix=SPI5, PortAvailablePackage0=true, PortAvailablePackage2=true, PortAvailablePackage3=true, PortAvailablePackage4=true, PortRegBaseAddr=4294442004, PortRegStructure=PORT_REG_STRUCT_REGULAR_SLEW_2, PortContainsPrivReg=false
          14 x PortPin, all with PortPinDirectionChangeable=false, PortPinInitialMode=PORT_PIN_MODE_SPI, PortPinLevelValue=PORT_PIN_LEVEL_LOW, PortPinMode=PORT_PIN_MODE_DIO, PortPinOpenDrain=PORT_PUSH_PULL, PortPinRefresh=false, PortPinAvailablePackage0=true, PortPinAvailablePackage1=true, PortPinAvailablePackage2=true, PortPinAvailablePackage3=true, PortPinSlewRate=PORT_PIN_SLEW_RATE_NA:
            PortPinSpi5_0: PortPinDirection=PORT_PIN_OUT, PortPinId=9, PortPinPullSelect=PORT_PULL_UP, PortPinChannelName=MS_SCLK2, PortPinAvailablePackage4=true, PortPinName=SPI5CLK
            PortPinSpi5_1: PortPinDirection=PORT_PIN_OUT, PortPinId=0, PortPinPullSelect=PORT_PULL_UP, PortPinChannelName=MS_CSN2, PortPinAvailablePackage4=true, PortPinName=SPI5NCS0
            PortPinSpi5_2: PortPinDirection=PORT_PIN_IN, PortPinId=1, PortPinPullSelect=PORT_PULL_UP, PortPinChannelName=(unset), PortPinAvailablePackage4=true, PortPinName=SPI5NCS1
            PortPinSpi5_3: PortPinDirection=PORT_PIN_IN, PortPinId=2, PortPinPullSelect=PORT_PULL_UP, PortPinChannelName=(unset), PortPinAvailablePackage4=false, PortPinName=SPI5NCS2
            PortPinSpi5_4: PortPinDirection=PORT_PIN_IN, PortPinId=3, PortPinPullSelect=PORT_PULL_UP, PortPinChannelName=(unset), PortPinAvailablePackage4=false, PortPinName=SPI5NCS3
            PortPinSpi5_5: PortPinDirection=PORT_PIN_IN, PortPinId=8, PortPinPullSelect=PORT_PULL_DOWN, PortPinChannelName=(unset), PortPinAvailablePackage4=true, PortPinName=SPI5NENA
            PortPinSpi5_6: PortPinDirection=PORT_PIN_OUT, PortPinId=10, PortPinPullSelect=PORT_PULL_UP, PortPinChannelName=MS_MOSI2, PortPinAvailablePackage4=true, PortPinName=SPI5SIMO0
            PortPinSpi5_7: PortPinDirection=PORT_PIN_IN, PortPinId=17, PortPinPullSelect=PORT_PULL_UP, PortPinChannelName=(unset), PortPinAvailablePackage4=true, PortPinName=SPI5SIMO1
            PortPinSpi5_8: PortPinDirection=PORT_PIN_IN, PortPinId=18, PortPinPullSelect=PORT_PULL_UP, PortPinChannelName=(unset), PortPinAvailablePackage4=true, PortPinName=SPI5SIMO2
            PortPinSpi5_9: PortPinDirection=PORT_PIN_IN, PortPinId=19, PortPinPullSelect=PORT_PULL_UP, PortPinChannelName=(unset), PortPinAvailablePackage4=true, PortPinName=SPI5SIMO3
            PortPinSpi5_10: PortPinDirection=PORT_PIN_IN, PortPinId=11, PortPinPullSelect=PORT_PULL_UP, PortPinChannelName=MS_MISO2, PortPinAvailablePackage4=true, PortPinName=SPI5SOMI0
            PortPinSpi5_11: PortPinDirection=PORT_PIN_IN, PortPinId=25, PortPinPullSelect=PORT_PULL_UP, PortPinChannelName=(unset), PortPinAvailablePackage4=true, PortPinName=SPI5SOMI1
            PortPinSpi5_12: PortPinDirection=PORT_PIN_IN, PortPinId=26, PortPinPullSelect=PORT_PULL_UP, PortPinChannelName=(unset), PortPinAvailablePackage4=true, PortPinName=SPI5SOMI2
            PortPinSpi5_13: PortPinDirection=PORT_PIN_IN, PortPinId=27, PortPinPullSelect=PORT_PULL_UP, PortPinChannelName=(unset), PortPinAvailablePackage4=true, PortPinName=SPI5SOMI3
        NHET1: PortNumberOfPortPins=32, PortUse=true, PortName=NHET1, PortRegPostfix=NHET1, PortAvailablePackage0=false, PortAvailablePackage2=true, PortAvailablePackage3=false, PortAvailablePackage4=false, PortRegBaseAddr=4294424648, PortRegStructure=PORT_REG_STRUCT_REGULAR_NO_FUNC, PortContainsPrivReg=false
          32 x PortPin, all with PortPinDirectionChangeable=false, PortPinInitialMode=PORT_PIN_MODE_DIO, PortPinMode=PORT_PIN_MODE_DIO, PortPinPullSelect=PORT_PULL_DOWN, PortPinRefresh=false, PortPinAvailablePackage0=false, PortPinAvailablePackage1=true, PortPinAvailablePackage2=true, PortPinAvailablePackage3=false, PortPinAvailablePackage4=false, PortPinSlewRate=PORT_PIN_SLEW_RATE_NA:
            PortPinNHet1_0: PortPinDirection=PORT_PIN_IN, PortPinId=0, PortPinLevelValue=PORT_PIN_LEVEL_LOW, PortPinOpenDrain=PORT_PUSH_PULL, PortPinChannelName=GB_LOWER, PortPinName=NHET1_0
            PortPinNHet1_1: PortPinDirection=PORT_PIN_IN, PortPinId=1, PortPinLevelValue=PORT_PIN_LEVEL_LOW, PortPinOpenDrain=PORT_PUSH_PULL, PortPinChannelName=(unset), PortPinName=NHET1_1
            PortPinNHet1_2: PortPinDirection=PORT_PIN_IN, PortPinId=2, PortPinLevelValue=PORT_PIN_LEVEL_LOW, PortPinOpenDrain=PORT_PUSH_PULL, PortPinChannelName=GC_UPPER, PortPinName=NHET1_2
            PortPinNHet1_3: PortPinDirection=PORT_PIN_IN, PortPinId=3, PortPinLevelValue=PORT_PIN_LEVEL_LOW, PortPinOpenDrain=PORT_PUSH_PULL, PortPinChannelName=(unset), PortPinName=NHET1_3
            PortPinNHet1_4: PortPinDirection=PORT_PIN_IN, PortPinId=4, PortPinLevelValue=PORT_PIN_LEVEL_LOW, PortPinOpenDrain=PORT_PUSH_PULL, PortPinChannelName=FetDrvCntl, PortPinName=NHET1_4
            PortPinNHet1_5: PortPinDirection=PORT_PIN_IN, PortPinId=5, PortPinLevelValue=PORT_PIN_LEVEL_LOW, PortPinOpenDrain=PORT_PUSH_PULL, PortPinChannelName=GC_LOWER, PortPinName=NHET1_5
            PortPinNHet1_6: PortPinDirection=PORT_PIN_IN, PortPinId=6, PortPinLevelValue=PORT_PIN_LEVEL_LOW, PortPinOpenDrain=PORT_PUSH_PULL, PortPinChannelName=(unset), PortPinName=NHET1_6
            PortPinNHet1_7: PortPinDirection=PORT_PIN_IN, PortPinId=7, PortPinLevelValue=PORT_PIN_LEVEL_LOW, PortPinOpenDrain=PORT_PUSH_PULL, PortPinChannelName=(unset), PortPinName=NHET1_7
            PortPinNHet1_8: PortPinDirection=PORT_PIN_IN, PortPinId=8, PortPinLevelValue=PORT_PIN_LEVEL_LOW, PortPinOpenDrain=PORT_PUSH_PULL, PortPinChannelName=PwrSwitchEn, PortPinName=NHET1_8
            PortPinNHet1_9: PortPinDirection=PORT_PIN_IN, PortPinId=9, PortPinLevelValue=PORT_PIN_LEVEL_LOW, PortPinOpenDrain=PORT_PUSH_PULL, PortPinChannelName=(unset), PortPinName=NHET1_9
            PortPinNHet1_10: PortPinDirection=PORT_PIN_IN, PortPinId=10, PortPinLevelValue=PORT_PIN_LEVEL_LOW, PortPinOpenDrain=PORT_PUSH_PULL, PortPinChannelName=T1_SENT, PortPinName=NHET1_10
            PortPinNHet1_11: PortPinDirection=PORT_PIN_IN, PortPinId=11, PortPinLevelValue=PORT_PIN_LEVEL_LOW, PortPinOpenDrain=PORT_PUSH_PULL, PortPinChannelName=(unset), PortPinName=NHET1_11
            PortPinNHet1_12: PortPinDirection=PORT_PIN_OUT, PortPinId=12, PortPinLevelValue=PORT_PIN_LEVEL_LOW, PortPinOpenDrain=PORT_OPEN_DRAIN, PortPinChannelName=T1_SENT_Sync, PortPinName=NHET1_12
            PortPinNHet1_13: PortPinDirection=PORT_PIN_IN, PortPinId=13, PortPinLevelValue=PORT_PIN_LEVEL_LOW, PortPinOpenDrain=PORT_PUSH_PULL, PortPinChannelName=(unset), PortPinName=NHET1_13
            PortPinNHet1_14: PortPinDirection=PORT_PIN_OUT, PortPinId=14, PortPinLevelValue=PORT_PIN_LEVEL_LOW, PortPinOpenDrain=PORT_PUSH_PULL, PortPinChannelName=SPI_50us_Trigger, PortPinName=NHET1_14
            PortPinNHet1_15: PortPinDirection=PORT_PIN_OUT, PortPinId=15, PortPinLevelValue=PORT_PIN_LEVEL_LOW, PortPinOpenDrain=PORT_PUSH_PULL, PortPinChannelName=SysFault2, PortPinName=NHET1_15
            PortPinNHet1_16: PortPinDirection=PORT_PIN_OUT, PortPinId=16, PortPinLevelValue=PORT_PIN_LEVEL_LOW, PortPinOpenDrain=PORT_PUSH_PULL, PortPinChannelName=ePWM_Sync, PortPinName=NHET1_16
            PortPinNHet1_17: PortPinDirection=PORT_PIN_IN, PortPinId=17, PortPinLevelValue=PORT_PIN_LEVEL_LOW, PortPinOpenDrain=PORT_PUSH_PULL, PortPinChannelName=(unset), PortPinName=NHET1_17
            PortPinNHet1_18: PortPinDirection=PORT_PIN_OUT, PortPinId=18, PortPinLevelValue=PORT_PIN_LEVEL_LOW, PortPinOpenDrain=PORT_PUSH_PULL, PortPinChannelName=SPI_2m_Trigger, PortPinName=NHET1_18
            PortPinNHet1_19: PortPinDirection=PORT_PIN_IN, PortPinId=19, PortPinLevelValue=PORT_PIN_LEVEL_LOW, PortPinOpenDrain=PORT_PUSH_PULL, PortPinChannelName=(unset), PortPinName=NHET1_19
            PortPinNHet1_20: PortPinDirection=PORT_PIN_OUT, PortPinId=20, PortPinLevelValue=PORT_PIN_LEVEL_HIGH, PortPinOpenDrain=PORT_PUSH_PULL, PortPinChannelName=TODReset, PortPinName=NHET1_20
            PortPinNHet1_21: PortPinDirection=PORT_PIN_IN, PortPinId=21, PortPinLevelValue=PORT_PIN_LEVEL_LOW, PortPinOpenDrain=PORT_PUSH_PULL, PortPinChannelName=(unset), PortPinName=NHET1_21
            PortPinNHet1_22: PortPinDirection=PORT_PIN_IN, PortPinId=22, PortPinLevelValue=PORT_PIN_LEVEL_LOW, PortPinOpenDrain=PORT_PUSH_PULL, PortPinChannelName=OvrVoltFdbk, PortPinName=NHET1_22
            PortPinNHet1_23: PortPinDirection=PORT_PIN_IN, PortPinId=23, PortPinLevelValue=PORT_PIN_LEVEL_LOW, PortPinOpenDrain=PORT_PUSH_PULL, PortPinChannelName=(unset), PortPinName=NHET1_23
            PortPinNHet1_24: PortPinDirection=PORT_PIN_IN, PortPinId=24, PortPinLevelValue=PORT_PIN_LEVEL_LOW, PortPinOpenDrain=PORT_PUSH_PULL, PortPinChannelName=FetFlt1Data, PortPinName=NHET1_24
            PortPinNHet1_25: PortPinDirection=PORT_PIN_IN, PortPinId=25, PortPinLevelValue=PORT_PIN_LEVEL_LOW, PortPinOpenDrain=PORT_PUSH_PULL, PortPinChannelName=(unset), PortPinName=NHET1_25
            PortPinNHet1_26: PortPinDirection=PORT_PIN_IN, PortPinId=26, PortPinLevelValue=PORT_PIN_LEVEL_LOW, PortPinOpenDrain=PORT_PUSH_PULL, PortPinChannelName=FetFlt2Clk, PortPinName=NHET1_26
            PortPinNHet1_27: PortPinDirection=PORT_PIN_IN, PortPinId=27, PortPinLevelValue=PORT_PIN_LEVEL_LOW, PortPinOpenDrain=PORT_PUSH_PULL, PortPinChannelName=(unset), PortPinName=NHET1_27
            PortPinNHet1_28: PortPinDirection=PORT_PIN_IN, PortPinId=28, PortPinLevelValue=PORT_PIN_LEVEL_LOW, PortPinOpenDrain=PORT_PUSH_PULL, PortPinChannelName=T2_SENT, PortPinName=NHET1_28
            PortPinNHet1_29: PortPinDirection=PORT_PIN_IN, PortPinId=29, PortPinLevelValue=PORT_PIN_LEVEL_LOW, PortPinOpenDrain=PORT_PUSH_PULL, PortPinChannelName=(unset), PortPinName=NHET1_29
            PortPinNHet1_30: PortPinDirection=PORT_PIN_OUT, PortPinId=30, PortPinLevelValue=PORT_PIN_LEVEL_LOW, PortPinOpenDrain=PORT_OPEN_DRAIN, PortPinChannelName=T2_SENT_Sync, PortPinName=NHET1_30
            PortPinNHet1_31: PortPinDirection=PORT_PIN_IN, PortPinId=31, PortPinLevelValue=PORT_PIN_LEVEL_LOW, PortPinOpenDrain=PORT_PUSH_PULL, PortPinChannelName=(unset), PortPinName=NHET1_31
        NHET2: PortNumberOfPortPins=32, PortUse=true, PortName=NHET2, PortRegPostfix=NHET2, PortAvailablePackage0=false, PortAvailablePackage2=true, PortAvailablePackage3=false, PortAvailablePackage4=false, PortRegBaseAddr=4294424904, PortRegStructure=PORT_REG_STRUCT_REGULAR_NO_FUNC, PortContainsPrivReg=false
          18 x PortPin, all with PortPinDirection=PORT_PIN_IN, PortPinDirectionChangeable=false, PortPinInitialMode=PORT_PIN_MODE_DIO, PortPinLevelValue=PORT_PIN_LEVEL_LOW, PortPinMode=PORT_PIN_MODE_DIO, PortPinOpenDrain=PORT_PUSH_PULL, PortPinRefresh=false, PortPinAvailablePackage0=false, PortPinAvailablePackage1=true, PortPinAvailablePackage2=true, PortPinAvailablePackage3=false, PortPinAvailablePackage4=false, PortPinSlewRate=PORT_PIN_SLEW_RATE_NA:
            PortPinNHet2_{0..7}: PortPinId={0..7}, PortPinPullSelect=PORT_PULL_DOWN, PortPinChannelName=(unset), PortPinName=NHET2_{0..7}
            PortPinNHet2_8: PortPinId=8, PortPinPullSelect=PORT_PULL_DOWN, PortPinChannelName=PhaseC, PortPinName=NHET2_8
            PortPinNHet2_9: PortPinId=9, PortPinPullSelect=PORT_PULL_DOWN, PortPinChannelName=(unset), PortPinName=NHET2_9
            PortPinNHet2_10: PortPinId=10, PortPinPullSelect=PORT_PULL_DOWN, PortPinChannelName=PhaseA, PortPinName=NHET2_10
            PortPinNHet2_{11..15}: PortPinId={11..15}, PortPinPullSelect=PORT_PULL_DOWN, PortPinChannelName=(unset), PortPinName=NHET2_{11..15}
            PortPinNHet2_16: PortPinId=16, PortPinPullSelect=PORT_PULL_UP, PortPinChannelName=(unset), PortPinName=NHET2_16
            PortPinNHet2_18: PortPinId=18, PortPinPullSelect=PORT_PULL_DOWN, PortPinChannelName=PhaseB, PortPinName=NHET2_18
        SYS: PortNumberOfPortPins=1, PortUse=false, PortName=ECLK, PortRegPostfix=SYS, PortAvailablePackage0=false, PortAvailablePackage2=true, PortAvailablePackage3=false, PortAvailablePackage4=false, PortRegBaseAddr=4294967040, PortRegStructure=PORT_REG_STRUCT_REGULAR_SLEW_1, PortContainsPrivReg=false
          PortPinEcp_0 (PortPin):
            PortPinDirection = PORT_PIN_IN
            PortPinDirectionChangeable = false
            PortPinId = 0
            PortPinInitialMode = PORT_PIN_MODE_DIO
            PortPinLevelValue = PORT_PIN_LEVEL_LOW
            PortPinMode = PORT_PIN_MODE_DIO
            PortPinOpenDrain = PORT_PUSH_PULL
            PortPinPullSelect = PORT_PULL_DOWN
            PortPinRefresh = false
            PortPinChannelName = (unset)
            PortPinAvailablePackage0 = false
            PortPinAvailablePackage1 = true
            PortPinAvailablePackage2 = true
            PortPinAvailablePackage3 = false
            PortPinAvailablePackage4 = false
            PortPinSlewRate = PORT_PIN_SLEW_RATE_SLOW
            PortPinName = ECLK
        ADC1: PortNumberOfPortPins=1, PortUse=true, PortName=MibADC 1, PortRegPostfix=ADC1, PortAvailablePackage0=false, PortAvailablePackage2=true, PortAvailablePackage3=false, PortAvailablePackage4=false, PortRegBaseAddr=4294426872, PortRegStructure=PORT_REG_STRUCT_REGULAR_PERMUTED, PortContainsPrivReg=false
          PortPinADC1_0 (PortPin):
            PortPinDirection = PORT_PIN_IN
            PortPinDirectionChangeable = false
            PortPinId = 0
            PortPinInitialMode = PORT_PIN_MODE_DIO
            PortPinLevelValue = PORT_PIN_LEVEL_LOW
            PortPinMode = PORT_PIN_MODE_DIO
            PortPinOpenDrain = PORT_PUSH_PULL
            PortPinPullSelect = PORT_PULL_DOWN
            PortPinRefresh = false
            PortPinChannelName = EpsEn
            PortPinAvailablePackage0 = false
            PortPinAvailablePackage1 = true
            PortPinAvailablePackage2 = true
            PortPinAvailablePackage3 = false
            PortPinAvailablePackage4 = false
            PortPinSlewRate = PORT_PIN_SLEW_RATE_NA
            PortPinName = AD1EVT
        ADC2: PortNumberOfPortPins=1, PortUse=false, PortName=MibADC 2, PortRegPostfix=ADC2, PortAvailablePackage0=false, PortAvailablePackage2=true, PortAvailablePackage3=false, PortAvailablePackage4=false, PortRegBaseAddr=4294427384, PortRegStructure=PORT_REG_STRUCT_REGULAR_PERMUTED, PortContainsPrivReg=false
          PortPinADC2_0 (PortPin):
            PortPinDirection = PORT_PIN_IN
            PortPinDirectionChangeable = false
            PortPinId = 0
            PortPinInitialMode = PORT_PIN_MODE_DIO
            PortPinLevelValue = PORT_PIN_LEVEL_LOW
            PortPinMode = PORT_PIN_MODE_DIO
            PortPinOpenDrain = PORT_PUSH_PULL
            PortPinPullSelect = PORT_PULL_DOWN
            PortPinRefresh = false
            PortPinChannelName = (unset)
            PortPinAvailablePackage0 = false
            PortPinAvailablePackage1 = true
            PortPinAvailablePackage2 = true
            PortPinAvailablePackage3 = false
            PortPinAvailablePackage4 = false
            PortPinSlewRate = PORT_PIN_SLEW_RATE_NA
            PortPinName = AD2EVT
        RTP: PortNumberOfPortPins=19, PortUse=false, PortName=RTP, PortRegPostfix=RTP, PortAvailablePackage0=false, PortAvailablePackage2=true, PortAvailablePackage3=false, PortAvailablePackage4=false, PortRegBaseAddr=4294965812, PortRegStructure=PORT_REG_STRUCT_REGULAR_NO_SLEW, PortContainsPrivReg=false
          19 x PortPin, all with PortPinDirection=PORT_PIN_IN, PortPinDirectionChangeable=false, PortPinInitialMode=PORT_PIN_MODE_DIO, PortPinLevelValue=PORT_PIN_LEVEL_LOW, PortPinMode=PORT_PIN_MODE_DIO, PortPinOpenDrain=PORT_PUSH_PULL, PortPinPullSelect=PORT_PULL_UP, PortPinRefresh=false, PortPinChannelName=(unset), PortPinAvailablePackage0=false, PortPinAvailablePackage1=true, PortPinAvailablePackage2=true, PortPinAvailablePackage3=false, PortPinAvailablePackage4=false, PortPinSlewRate=PORT_PIN_SLEW_RATE_NA:
            PortPinRtp_{0..15}: PortPinId={0..15}, PortPinName=RPTDATA{0..15}
            PortPinRtp_16: PortPinId=16, PortPinName=RPTSYNC
            PortPinRtp_17: PortPinId=17, PortPinName=RPTCLK
            PortPinRtp_18: PortPinId=18, PortPinName=RPTENA
        DMM: PortNumberOfPortPins=19, PortUse=false, PortName=DMM, PortRegPostfix=DMM, PortAvailablePackage0=true, PortAvailablePackage2=false, PortAvailablePackage3=false, PortAvailablePackage4=false, PortRegBaseAddr=4294965100, PortRegStructure=PORT_REG_STRUCT_REGULAR_NO_SLEW, PortContainsPrivReg=false
          19 x PortPin, all with PortPinDirection=PORT_PIN_IN, PortPinDirectionChangeable=false, PortPinInitialMode=PORT_PIN_MODE_DIO, PortPinLevelValue=PORT_PIN_LEVEL_LOW, PortPinMode=PORT_PIN_MODE_DIO, PortPinOpenDrain=PORT_PUSH_PULL, PortPinPullSelect=PORT_PULL_UP, PortPinRefresh=false, PortPinChannelName=(unset), PortPinAvailablePackage0=true, PortPinAvailablePackage1=true, PortPinAvailablePackage2=false, PortPinAvailablePackage3=false, PortPinAvailablePackage4=false, PortPinSlewRate=PORT_PIN_SLEW_RATE_NA:
            PortPinDmm_0: PortPinId=0, PortPinName=DMMSYNC
            PortPinDmm_1: PortPinId=1, PortPinName=DMMCLK
            PortPinDmm_2: PortPinId=2, PortPinName=DMMDATA0
            PortPinDmm_3: PortPinId=3, PortPinName=DMMDATA1
            PortPinDmm_4: PortPinId=4, PortPinName=DMMDATA2
            PortPinDmm_5: PortPinId=5, PortPinName=DMMDATA3
            PortPinDmm_6: PortPinId=6, PortPinName=DMMDATA4
            PortPinDmm_7: PortPinId=7, PortPinName=DMMDATA5
            PortPinDmm_8: PortPinId=8, PortPinName=DMMDATA6
            PortPinDmm_9: PortPinId=9, PortPinName=DMMDATA7
            PortPinDmm_10: PortPinId=10, PortPinName=DMMDATA8
            PortPinDmm_11: PortPinId=11, PortPinName=DMMDATA9
            PortPinDmm_12: PortPinId=12, PortPinName=DMMDATA10
            PortPinDmm_13: PortPinId=13, PortPinName=DMMDATA11
            PortPinDmm_14: PortPinId=14, PortPinName=DMMDATA12
            PortPinDmm_15: PortPinId=15, PortPinName=DMMDATA13
            PortPinDmm_16: PortPinId=16, PortPinName=DMMDATA14
            PortPinDmm_17: PortPinId=17, PortPinName=DMMDATA15
            PortPinDmm_18: PortPinId=18, PortPinName=DMMnENA
    PortGeneral:
      PortDevErrorDetect = true
      PortSetPinDirectionApi = true
      PortSetPinModeApi = false
      PortVersionInfoApi = false
      PortRefreshPortDirectionApi = false
      PortCfgDoParamChk = true
      PortCfgChkUninit = true
      PortCfgChkParamPin = true
      PortCfgChkParamVinfo = true
      PortCfgChkParamConfig = true
      PortCfgDebugReporting = true
      PortErrorhook = Det_ReportError
      PortDetIncludeFile = Det.h
      PortPackageMapping0 = NA
      PortPackageMapping1 = Pin_337
      PortPackageMapping2 = Pin_144
      PortPackageMapping3 = NA
      PortPackageMapping4 = NA
      PortSpecialRegisterAccessEnabled = true
      PortSpecialRegisterAccessOnlyForWrite = true
      PortSpecialRegisterAccessOnlyForPrivilegedModeRegisters = true
      PortSpecialRegisterAccessNotInInit = false
      PortIrqHandling = SuspendAllInterrupts
  module config PwrLmtFuncCr: implementation-config-variant=VARIANT-PRE-COMPILE  # Configuration of the Nexteer PwrLmtFuncCr module.
    PwrLmtFuncCrGeneral
    CommonPublishedInformation: ArMajorVersion=3, ArMinorVersion=2, ArPatchVersion=0, SwMajorVersion=0, SwMinorVersion=0, SwPatchVersion=0, ModuleId=0, VendorId=0
  module config QuadDet: implementation-config-variant=VARIANT-PRE-COMPILE  # Configuration of the Nexteer QuadDet module.
    QuadDetGeneral
    CommonPublishedInformation: ArMajorVersion=3, ArMinorVersion=2, ArPatchVersion=0, SwMajorVersion=0, SwMinorVersion=0, SwPatchVersion=0, ModuleId=0, VendorId=0
  module config Return: implementation-config-variant=VARIANT-PRE-COMPILE  # Configuration of the Nexteer Return module.
    ReturnGeneral
    CommonPublishedInformation: ArMajorVersion=3, ArMinorVersion=2, ArPatchVersion=0, SwMajorVersion=0, SwMinorVersion=0, SwPatchVersion=0, ModuleId=0, VendorId=0
  module config ReturnFirewall: implementation-config-variant=VARIANT-PRE-COMPILE  # Configuration of the Nexteer ReturnFirewall module.
    ReturnFirewallGeneral
    CommonPublishedInformation: ArMajorVersion=3, ArMinorVersion=2, ArPatchVersion=0, SwMajorVersion=0, SwMinorVersion=0, SwPatchVersion=0, ModuleId=0, VendorId=0
  module config Rte: implementation-config-variant=VARIANT-PRE-COMPILE, module-description=Rte_Impl  # Configuration of the Rte (Runtime Environment) module.
    RteGeneration: RteMeasurementSupport=true, RteXcpEventSupport=false, RteA2LVersion=V151, RteCalibrationSupport=NONE, RteOptimizationMode=MEMORY, RteVfbTrace=0
    112 x SwComponentInstance:
      AbsHwPos_Ap_AbsHwPos_ECU_Composition: SoftwareComponentInstanceRef=AbsHwPos, ImplementationRef=Ap_AbsHwPos_Implementation
        5 x RunnableEntityMapping, all with ActivationOffset=0, RteCyclicTriggerImplementation=Auto:
          Task_2ms_10_13_Timer0: PositionInTask=13, RTEEventRef=TMT_AbsHwPos_Per1, MappedToTaskRef=Task_2ms_10
          Task_4ms_10_3_Timer0: PositionInTask=3, RTEEventRef=TMT_AbsHwPos_Per3, MappedToTaskRef=Task_4ms_10
          Task_10ms_10a_2_Timer0: PositionInTask=2, RTEEventRef=TMT_AbsHwPos_Per4, MappedToTaskRef=Task_10ms_10a
          Task_2ms_10_14_Timer0: PositionInTask=14, RTEEventRef=TMT_AbsHwPos_Per2, MappedToTaskRef=Task_2ms_10
          Task_Init_10_20_Timer0: PositionInTask=20, RTEEventRef=AbsHwPos_Init1_InitEvent, MappedToTaskRef=Task_Init_10
        MAP_Rte_NvmBlock_AbsHwPos_EOLVehCntrOffset (NVRamAllocation): SwNvRamMappingReference=AbsHwPos.EOLVehCntrOffsetBlock, NvmBlockRef=Rte_NvmBlock_AbsHwPos_EOLVehCntrOffset
      ActivePull_Ap_ActivePull_ECU_Composition: SoftwareComponentInstanceRef=ActivePull, ImplementationRef=Ap_ActivePull_Implementation
        6 x RunnableEntityMapping, all with ActivationOffset=0, RteCyclicTriggerImplementation=Auto:
          Task_Trns_9_6_TrigModeSwitch0: PositionInTask=6, RTEEventRef=MST_ActivePull_Trns1_0, MappedToTaskRef=Task_Trns_9
          Task_Trns_9_7_TrigModeSwitch0: PositionInTask=7, RTEEventRef=MST_ActivePull_Trns2_0, MappedToTaskRef=Task_Trns_9
          Task_2ms_9_8_Timer0: PositionInTask=8, RTEEventRef=TMT_ActivePull_Per1, MappedToTaskRef=Task_2ms_9
          Task_Init_9_5_Timer0: PositionInTask=5, RTEEventRef=ActivePull_Init1_InitEvent, MappedToTaskRef=Task_Init_9
          Task_100ms_9_1_Timer0: PositionInTask=1, RTEEventRef=TMT_ActivePull_Per3, MappedToTaskRef=Task_100ms_9
          Task_2ms_9_9_Timer0: PositionInTask=9, RTEEventRef=TMT_ActivePull_Per2, MappedToTaskRef=Task_2ms_9
        MAP_Rte_NvmBlock_ActivePull_PullCmpLTComp_HwNm_f32 (NVRamAllocation): SwNvRamMappingReference=ActivePull.PullCmpLTComp, NvmBlockRef=Rte_NvmBlock_ActivePull_PullCmpLTComp_HwNm_f32
      ApXcp_Ap_ApXcp_ECU_Composition: SoftwareComponentInstanceRef=ApXcp, ImplementationRef=Ap_ApXcp_Implementation
        Task_10ms_6_3_Timer0 (RunnableEntityMapping): PositionInTask=3, ActivationOffset=0, RteCyclicTriggerImplementation=Auto, RTEEventRef=TMT_ApXcp_Per1, MappedToTaskRef=Task_10ms_6
        Task_2ms_6_2_Timer0 (RunnableEntityMapping): PositionInTask=2, ActivationOffset=0, RteCyclicTriggerImplementation=Auto, RTEEventRef=TMT_DAQ_2msTL, MappedToTaskRef=Task_2ms_6
      Ap_CtrlPolarityBrshlss_Ap_CtrlPolarityBrshlss_ECU_Composition: SoftwareComponentInstanceRef=Ap_CtrlPolarityBrshlss, ImplementationRef=Ap_CtrlPolarityBrshlss_Implementation
        Task_Init_10_0_Timer0 (RunnableEntityMapping): PositionInTask=0, ActivationOffset=0, RteCyclicTriggerImplementation=Auto, RTEEventRef=Polarity_Init1_InitEvent, MappedToTaskRef=Task_Init_10
        MAP_Rte_NvmBlock_Polarity_Polarity_Cnt_Str (NVRamAllocation): SwNvRamMappingReference=Ap_CtrlPolarityBrshlss.PolarityBlock, NvmBlockRef=Rte_NvmBlock_Polarity_Polarity_Cnt_Str
      Assist_Ap_Assist_ECU_Composition: SoftwareComponentInstanceRef=Assist, ImplementationRef=Ap_Assist_Implementation
        Task_2ms_10_6_Timer0 (RunnableEntityMapping): PositionInTask=6, ActivationOffset=0, RteCyclicTriggerImplementation=Auto, RTEEventRef=TMT_Assist_Per1, MappedToTaskRef=Task_2ms_10
      AssistFirewall_Ap_AssistFirewall_ECU_Composition: SoftwareComponentInstanceRef=AssistFirewall, ImplementationRef=Ap_AssistFirewall_Implementation
        Task_2ms_10_8_Timer0 (RunnableEntityMapping): PositionInTask=8, ActivationOffset=0, RteCyclicTriggerImplementation=Auto, RTEEventRef=TMT_AssistFirewall_Per1, MappedToTaskRef=Task_2ms_10
        Task_Init_10_25_Timer0 (RunnableEntityMapping): PositionInTask=25, ActivationOffset=0, RteCyclicTriggerImplementation=Auto, RTEEventRef=AssistFirewall_Init1_InitEvent, MappedToTaskRef=Task_Init_10
      AstLmt_Ap_AstLmt_ECU_Composition: SoftwareComponentInstanceRef=AstLmt, ImplementationRef=Ap_AstLmt_Implementation
        Task_Init_10_26_Timer0 (RunnableEntityMapping): PositionInTask=26, ActivationOffset=0, RteCyclicTriggerImplementation=Auto, RTEEventRef=AstLmt_InitEvent, MappedToTaskRef=Task_Init_10
        Task_2ms_10_24_Timer0 (RunnableEntityMapping): PositionInTask=24, ActivationOffset=0, RteCyclicTriggerImplementation=Auto, RTEEventRef=TMT_AstLmt_Per1, MappedToTaskRef=Task_2ms_10
      AvgFricLrn_Ap_AvgFricLrn_ECU_Composition: SoftwareComponentInstanceRef=AvgFricLrn, ImplementationRef=Ap_AvgFricLrn_Implementation
        3 x RunnableEntityMapping, all with ActivationOffset=0, RteCyclicTriggerImplementation=Auto:
          Task_10ms_9_1_Timer0: PositionInTask=1, RTEEventRef=TMT_AvgFricLrn_Per1, MappedToTaskRef=Task_10ms_9
          Task_Trns_9_9_TrigModeSwitch0: PositionInTask=9, RTEEventRef=MST_AvgFricLrn_Trns1_0, MappedToTaskRef=Task_Trns_9
          Task_Init_9_4_Timer0: PositionInTask=4, RTEEventRef=AvgFricLrn_Init1_InitEvent, MappedToTaskRef=Task_Init_9
        MAP_Rte_NvmBlock_AvgFricLrn_AvgFricLrnData (NVRamAllocation): SwNvRamMappingReference=AvgFricLrn.AvgFricLrnBlk, NvmBlockRef=Rte_NvmBlock_AvgFricLrn_AvgFricLrnData
      BVDiag_Ap_BVDiag_ECU_Composition: SoftwareComponentInstanceRef=BVDiag, ImplementationRef=Ap_BVDiag_Implementation
        Task_10ms_9_3_Timer0 (RunnableEntityMapping): PositionInTask=3, ActivationOffset=0, RteCyclicTriggerImplementation=Auto, RTEEventRef=TMT_BVDiag_Per1, MappedToTaskRef=Task_10ms_9
      BatteryVoltage_Ap_BatteryVoltage_ECU_Composition: SoftwareComponentInstanceRef=BatteryVoltage, ImplementationRef=Ap_BatteryVoltage_Implementation
        3 x RunnableEntityMapping, all with ActivationOffset=0, RteCyclicTriggerImplementation=Auto:
          Task_4ms_9_1_Timer0: PositionInTask=1, RTEEventRef=TMT_BatteryVoltage_Per2, MappedToTaskRef=Task_4ms_9
          Task_Init_9_9_Timer0: PositionInTask=9, RTEEventRef=BatteryVoltage_Init1_InitEvent, MappedToTaskRef=Task_Init_9
          Task_2ms_9_12_Timer0: PositionInTask=12, RTEEventRef=TMT_BatteryVoltage_Per1, MappedToTaskRef=Task_2ms_9
        MAP_Rte_NvmBlock_BatteryVoltage_OvervoltageData (NVRamAllocation): SwNvRamMappingReference=BatteryVoltage.OvervoltageBlock, NvmBlockRef=Rte_NvmBlock_BatteryVoltage_OvervoltageData
      BkCpPc_Sa_BkCpPc_ECU_Composition: SoftwareComponentInstanceRef=BkCpPc, ImplementationRef=Sa_BkCpPc_Implementation
        3 x RunnableEntityMapping, all with ActivationOffset=0, RteCyclicTriggerImplementation=Auto:
          Task_2ms_9_18_Timer0: PositionInTask=18, RTEEventRef=TMT_BkCpPc_Per1, MappedToTaskRef=Task_2ms_9
          Task_Trns_9_4_TrigModeSwitch0: PositionInTask=4, RTEEventRef=MST_BkCpPc_Trns1_0, MappedToTaskRef=Task_Trns_9
          Task_Trns_9_2_TrigModeSwitch0: PositionInTask=2, RTEEventRef=MST_BkCpPc_Trns2_0, MappedToTaskRef=Task_Trns_9
      CDD_CDD_ECU_Composition: ServiceComponentPrototypeRef=CDD, ImplementationRef=CDD_Implementation
        Task_SchM_10ms_6_2_Timer0 (RunnableEntityMapping): PositionInTask=2, ActivationOffset=0, RteCyclicTriggerImplementation=Auto, RTEEventRef=TMT_Cdd_DummyFunction, MappedToTaskRef=Task_SchM_10ms_6
      CDDInterface10_Sa_CDDInterface10_ECU_Composition: SoftwareComponentInstanceRef=CDDInterface10, ImplementationRef=Sa_CDDInterface10_Implementation
        Task_2ms_10_37_Timer0 (RunnableEntityMapping): PositionInTask=37, ActivationOffset=0, RteCyclicTriggerImplementation=Auto, RTEEventRef=TMT_CDDInterface10_Per1, MappedToTaskRef=Task_2ms_10
        Task_Init_10_1_Timer0 (RunnableEntityMapping): PositionInTask=1, ActivationOffset=0, RteCyclicTriggerImplementation=Auto, RTEEventRef=CDDInterface10_Init1_InitEvent, MappedToTaskRef=Task_Init_10
      CDDInterface11_Sa_CDDInterface11_ECU_Composition: SoftwareComponentInstanceRef=CDDInterface11, ImplementationRef=Sa_CDDInterface11_Implementation
        Task_Init_11a_0_Timer0 (RunnableEntityMapping): PositionInTask=0, ActivationOffset=0, RteCyclicTriggerImplementation=Auto, RTEEventRef=CDDInterface11_Init1_InitEvent, MappedToTaskRef=Task_Init_11a
        Task_10ms_11_1_Timer0 (RunnableEntityMapping): PositionInTask=1, ActivationOffset=0, RteCyclicTriggerImplementation=Auto, RTEEventRef=TMT_CDDInterface11_Per1, MappedToTaskRef=Task_10ms_11
      CDDInterface6_Sa_CDDInterface6_ECU_Composition: SoftwareComponentInstanceRef=CDDInterface6, ImplementationRef=Sa_CDDInterface6_Implementation
        Task_10ms_6_4_Timer0 (RunnableEntityMapping): PositionInTask=4, ActivationOffset=0, RteCyclicTriggerImplementation=Auto, RTEEventRef=TMT_CDDInterface6_Per1, MappedToTaskRef=Task_10ms_6
        Task_Init_6_2_Timer0 (RunnableEntityMapping): PositionInTask=2, ActivationOffset=0, RteCyclicTriggerImplementation=Auto, RTEEventRef=CDDInterface6_Init1_InitEvent, MappedToTaskRef=Task_Init_6
      CDDInterface9_Sa_CDDInterface9_ECU_Composition: SoftwareComponentInstanceRef=CDDInterface9, ImplementationRef=Sa_CDDInterface9_Implementation
        Task_Init_9_0_Timer0 (RunnableEntityMapping): PositionInTask=0, ActivationOffset=0, RteCyclicTriggerImplementation=Auto, RTEEventRef=CDDInterface9_Init1_InitEvent, MappedToTaskRef=Task_Init_9
        Task_2ms_9_3_Timer0 (RunnableEntityMapping): PositionInTask=3, ActivationOffset=0, RteCyclicTriggerImplementation=Auto, RTEEventRef=TMT_CDDInterface9_Per1, MappedToTaskRef=Task_2ms_9
      ChkPtAp10_Ap_ChkPtAp10_ECU_Composition: SoftwareComponentInstanceRef=ChkPtAp10, ImplementationRef=Ap_ChkPtAp10_Implementation
        10 x RunnableEntityMapping, all with ActivationOffset=0, RteCyclicTriggerImplementation=Auto:
          Task_4ms_10_5_Timer0: PositionInTask=5, RTEEventRef=TMT_ChkPtAp10_4msEnd_Per, MappedToTaskRef=Task_4ms_10
          Task_4ms_10_0_Timer0: PositionInTask=0, RTEEventRef=TMT_ChkPtAp10_4msStart_Per, MappedToTaskRef=Task_4ms_10
          Task_10ms_10a_0_Timer0: PositionInTask=0, RTEEventRef=TMT_ChkPtAp10_10msaStart_Per, MappedToTaskRef=Task_10ms_10a
          Task_2ms_10_50_Timer0: PositionInTask=50, RTEEventRef=TMT_ChkPtAp10_2msEnd_Per, MappedToTaskRef=Task_2ms_10
          Task_10ms_10b_22_Timer0: PositionInTask=22, RTEEventRef=TMT_ChkPtAp10_10msbEnd_Per, MappedToTaskRef=Task_10ms_10b
          Task_100ms_10_0_Timer0: PositionInTask=0, RTEEventRef=TMT_ChkPtAp10_100msStart_Per, MappedToTaskRef=Task_100ms_10
          Task_2ms_10_0_Timer0: PositionInTask=0, RTEEventRef=TMT_ChkPtAp10_2msStart_Per, MappedToTaskRef=Task_2ms_10
          Task_10ms_10a_4_Timer0: PositionInTask=4, RTEEventRef=TMT_ChkPtAp10_10msaEnd_Per, MappedToTaskRef=Task_10ms_10a
          Task_10ms_10b_0_Timer0: PositionInTask=0, RTEEventRef=TMT_ChkPtAp10_10msbStart_Per, MappedToTaskRef=Task_10ms_10b
          Task_100ms_10_9_Timer0: PositionInTask=9, RTEEventRef=TMT_ChkPtAp10_100msEnd_Per, MappedToTaskRef=Task_100ms_10
      ChkPtAp11_Ap_ChkPtAp11_ECU_Composition: SoftwareComponentInstanceRef=ChkPtAp11, ImplementationRef=Ap_ChkPtAp11_Implementation
        6 x RunnableEntityMapping, all with ActivationOffset=0, RteCyclicTriggerImplementation=Auto:
          Task_10ms_11_3_Timer0: PositionInTask=3, RTEEventRef=TMT_ChkPtAp11_10msEnd_Per, MappedToTaskRef=Task_10ms_11
          Task_2ms_11_0_Timer0: PositionInTask=0, RTEEventRef=TMT_ChkPtAp11_2msStart_Per, MappedToTaskRef=Task_2ms_11
          Task_100ms_11_5_Timer0: PositionInTask=5, RTEEventRef=TMT_ChkPtAp11_100msEnd_Per, MappedToTaskRef=Task_100ms_11
          Task_100ms_11_0_Timer0: PositionInTask=0, RTEEventRef=TMT_ChkPtAp11_100msStart_Per, MappedToTaskRef=Task_100ms_11
          Task_2ms_11_9_Timer0: PositionInTask=9, RTEEventRef=TMT_ChkPtAp11_2msEnd_Per, MappedToTaskRef=Task_2ms_11
          Task_10ms_11_0_Timer0: PositionInTask=0, RTEEventRef=TMT_ChkPtAp11_10msStart_Per, MappedToTaskRef=Task_10ms_11
      ChkPtAp6_Ap_ChkPtAp6_ECU_Composition: SoftwareComponentInstanceRef=ChkPtAp6, ImplementationRef=Ap_ChkPtAp6_Implementation
        6 x RunnableEntityMapping, all with ActivationOffset=0, RteCyclicTriggerImplementation=Auto:
          Task_10ms_6_0_Timer0: PositionInTask=0, RTEEventRef=TMT_ChkPtAp6_10msStart_Per, MappedToTaskRef=Task_10ms_6
          Task_100ms_6_3_Timer0: PositionInTask=3, RTEEventRef=TMT_ChkPtAp6_100msEnd_Per, MappedToTaskRef=Task_100ms_6
          Task_2ms_6_3_Timer0: PositionInTask=3, RTEEventRef=TMT_ChkPtAp6_2msEnd_Per, MappedToTaskRef=Task_2ms_6
          Task_100ms_6_0_Timer0: PositionInTask=0, RTEEventRef=TMT_ChkPtAp6_100msStart_Per, MappedToTaskRef=Task_100ms_6
          Task_2ms_6_0_Timer0: PositionInTask=0, RTEEventRef=TMT_ChkPtAp6_2msStart_Per, MappedToTaskRef=Task_2ms_6
          Task_10ms_6_6_Timer0: PositionInTask=6, RTEEventRef=TMT_ChkPtAp6_10msEnd_Per, MappedToTaskRef=Task_10ms_6
      ChkPtAp9_Ap_ChkPtAp9_ECU_Composition: SoftwareComponentInstanceRef=ChkPtAp9, ImplementationRef=Ap_ChkPtAp9_Implementation
        8 x RunnableEntityMapping, all with ActivationOffset=0, RteCyclicTriggerImplementation=Auto:
          Task_2ms_9_25_Timer0: PositionInTask=25, RTEEventRef=TMT_ChkPtAp9_2msEnd_Per, MappedToTaskRef=Task_2ms_9
          Task_100ms_9_5_Timer0: PositionInTask=5, RTEEventRef=TMT_ChkPtAp9_100msEnd_Per, MappedToTaskRef=Task_100ms_9
          Task_10ms_9_7_Timer0: PositionInTask=7, RTEEventRef=TMT_ChkPtAp9_10msEnd_Per, MappedToTaskRef=Task_10ms_9
          Task_10ms_9_0_Timer0: PositionInTask=0, RTEEventRef=TMT_ChkPtAp9_10msStart_Per, MappedToTaskRef=Task_10ms_9
          Task_100ms_9_0_Timer0: PositionInTask=0, RTEEventRef=TMT_ChkPtAp9_100msStart_Per, MappedToTaskRef=Task_100ms_9
          Task_4ms_9_2_Timer0: PositionInTask=2, RTEEventRef=TMT_ChkPtAp9_4msEnd_Per, MappedToTaskRef=Task_4ms_9
          Task_4ms_9_0_Timer0: PositionInTask=0, RTEEventRef=TMT_ChkPtAp9_4msStart_Per, MappedToTaskRef=Task_4ms_9
          Task_2ms_9_0_Timer0: PositionInTask=0, RTEEventRef=TMT_ChkPtAp9_2msStart_Per, MappedToTaskRef=Task_2ms_9
      CmMtrCurr_Sa_CmMtrCurr_ECU_Composition: SoftwareComponentInstanceRef=CmMtrCurr, ImplementationRef=Sa_CmMtrCurr_Implementation
        4 x RunnableEntityMapping, all with ActivationOffset=0, RteCyclicTriggerImplementation=Auto:
          Task_Init_11b_5_Timer0: PositionInTask=5, RTEEventRef=CmMtrCurr_InitEvent, MappedToTaskRef=Task_Init_11b
          Task_2ms_11_4_Timer0: PositionInTask=4, RTEEventRef=TMT_CmMtrCurr_Per3, MappedToTaskRef=Task_2ms_11
          Task_100ms_11_1_Timer0: PositionInTask=1, RTEEventRef=TMT_CmMtrCurr_Per1, MappedToTaskRef=Task_100ms_11
          Task_2ms_11_3_Timer0: PositionInTask=3, RTEEventRef=TMT_CmMtrCurr_Per2, MappedToTaskRef=Task_2ms_11
        MAP_Rte_NvmBlock_CmMtrCurr_CurrTempOffset (NVRamAllocation): SwNvRamMappingReference=CmMtrCurr.CurrTempOffsetBlk, NvmBlockRef=Rte_NvmBlock_CmMtrCurr_CurrTempOffset
        MAP_Rte_NvmBlock_CmMtrCurr_ShCurrCal (NVRamAllocation): SwNvRamMappingReference=CmMtrCurr.ShCurrCalBlk, NvmBlockRef=Rte_NvmBlock_CmMtrCurr_ShCurrCal
      ComplErr_Ap_ComplErr_ECU_Composition: SoftwareComponentInstanceRef=ComplErr, ImplementationRef=Ap_ComplErr_Implementation
        Task_2ms_10_42_Timer0 (RunnableEntityMapping): PositionInTask=42, ActivationOffset=0, RteCyclicTriggerImplementation=Auto, RTEEventRef=TMT_ComplErr_Per1, MappedToTaskRef=Task_2ms_10
      CtrlTemp_Sa_CtrlTemp_ECU_Composition: SoftwareComponentInstanceRef=CtrlTemp, ImplementationRef=Sa_CtrlTemp_Implementation
        3 x RunnableEntityMapping, all with ActivationOffset=0, RteCyclicTriggerImplementation=Auto:
          Task_Init_11b_3_Timer0: PositionInTask=3, RTEEventRef=CtrlTemp_Init1_InitEvent, MappedToTaskRef=Task_Init_11b
          Task_2ms_11_7_Timer0: PositionInTask=7, RTEEventRef=TMT_CtrlTemp_Per1, MappedToTaskRef=Task_2ms_11
          Task_100ms_11_2_Timer0: PositionInTask=2, RTEEventRef=TMT_CtrlTemp_Per2, MappedToTaskRef=Task_100ms_11
      CurrCmd_Ap_CurrCmd_ECU_Composition: SoftwareComponentInstanceRef=CurrCmd, ImplementationRef=Ap_CurrCmd_Implementation
        Task_2ms_10_33_Timer0 (RunnableEntityMapping): PositionInTask=33, ActivationOffset=0, RteCyclicTriggerImplementation=Auto, RTEEventRef=TMT_CurrCmd_Per1, MappedToTaskRef=Task_2ms_10
        Task_Init_10_8_Timer0 (RunnableEntityMapping): PositionInTask=8, ActivationOffset=0, RteCyclicTriggerImplementation=Auto, RTEEventRef=CurrCmd_InitEvent, MappedToTaskRef=Task_Init_10
      CurrParamComp_Ap_CurrParamComp_ECU_Composition: SoftwareComponentInstanceRef=CurrParamComp, ImplementationRef=Ap_CurrParamComp_Implementation
        3 x RunnableEntityMapping, all with ActivationOffset=0, RteCyclicTriggerImplementation=Auto:
          Task_2ms_10_35_Timer0: PositionInTask=35, RTEEventRef=TMT_CurrParamComp_Per1, MappedToTaskRef=Task_2ms_10
          Task_Init_10_9_Timer0: PositionInTask=9, RTEEventRef=CurrParamComp_InitEvent, MappedToTaskRef=Task_Init_10
          Task_100ms_10_2_Timer0: PositionInTask=2, RTEEventRef=TMT_CurrParamComp_Per2, MappedToTaskRef=Task_100ms_10
        MAP_Rte_NvmBlock_CurrParamComp_EOLNomMtrParam (NVRamAllocation): SwNvRamMappingReference=CurrParamComp.EOLNomMtrParamBlk, NvmBlockRef=Rte_NvmBlock_CurrParamComp_EOLNomMtrParam
      CustBattDiag_Ap_CustBattDiag_ECU_Composition: SoftwareComponentInstanceRef=CustBattDiag, ImplementationRef=Ap_CustBattDiag_Implementation
        Task_100ms_9_2_Timer0 (RunnableEntityMapping): PositionInTask=2, ActivationOffset=0, RteCyclicTriggerImplementation=Auto, RTEEventRef=TMT_CustBattDiag_Per2, MappedToTaskRef=Task_100ms_9
        Task_10ms_9_4_Timer0 (RunnableEntityMapping): PositionInTask=4, ActivationOffset=0, RteCyclicTriggerImplementation=Auto, RTEEventRef=TMT_CustBattDiag_Per1, MappedToTaskRef=Task_10ms_9
      Damping_Ap_Damping_ECU_Composition: SoftwareComponentInstanceRef=Damping, ImplementationRef=Ap_Damping_Implementation
        Task_2ms_10_15_Timer0 (RunnableEntityMapping): PositionInTask=15, ActivationOffset=0, RteCyclicTriggerImplementation=Auto, RTEEventRef=TMT_Damping_Per1, MappedToTaskRef=Task_2ms_10
        Task_Init_10_13_Timer0 (RunnableEntityMapping): PositionInTask=13, ActivationOffset=0, RteCyclicTriggerImplementation=Auto, RTEEventRef=Damping_Init1_InitEvent, MappedToTaskRef=Task_Init_10
      DampingFirewall_Ap_DampingFirewall_ECU_Composition: SoftwareComponentInstanceRef=DampingFirewall, ImplementationRef=Ap_DampingFirewall_Implementation
        Task_Init_10_15_Timer0 (RunnableEntityMapping):
          PositionInTask = 15
          ActivationOffset = 0
          RteCyclicTriggerImplementation = Auto
          RTEEventRef = DampingFirewall_Init1_InitEvent
          MappedToTaskRef = Task_Init_10
        Task_2ms_10_18_Timer0 (RunnableEntityMapping): PositionInTask=18, ActivationOffset=0, RteCyclicTriggerImplementation=Auto, RTEEventRef=TMT_DampingFirewall_Per1, MappedToTaskRef=Task_2ms_10
      Dem_Dem_ECU_Composition: ServiceComponentPrototypeRef=Dem, ImplementationRef=Dem_Implementation
        Task_SchM_10ms_6_1_Timer0 (RunnableEntityMapping): PositionInTask=1, ActivationOffset=0, RteCyclicTriggerImplementation=Auto, RTEEventRef=TMT_Dem_MainFunction, MappedToTaskRef=Task_SchM_10ms_6
      DemIf_Ap_DemIf_ECU_Composition: SoftwareComponentInstanceRef=DemIf, ImplementationRef=Ap_DemIf_Implementation
        Task_10ms_6_5_Timer0 (RunnableEntityMapping): PositionInTask=5, ActivationOffset=0, RteCyclicTriggerImplementation=Auto, RTEEventRef=TMT_DemIf_Per, MappedToTaskRef=Task_10ms_6
        Task_Init_6_5_Timer0 (RunnableEntityMapping): PositionInTask=5, ActivationOffset=0, RteCyclicTriggerImplementation=Auto, RTEEventRef=DemIf_InitEvent, MappedToTaskRef=Task_Init_6
      DiagMgr10_Ap_DiagMgr10_ECU_Composition: SoftwareComponentInstanceRef=DiagMgr10, ImplementationRef=Ap_DiagMgr10_Implementation
        4 x RunnableEntityMapping, all with ActivationOffset=0, RteCyclicTriggerImplementation=Auto:
          Task_100ms_10_8_Timer0: PositionInTask=8, RTEEventRef=TMT_DiagMgr10_Per, MappedToTaskRef=Task_100ms_10
          Task_Trns_10_0_TrigModeSwitch0: PositionInTask=0, RTEEventRef=MST_DiagMgr10_Trns_0, MappedToTaskRef=Task_Trns_10
          Task_Init_10_2_Timer0: PositionInTask=2, RTEEventRef=DiagMgr10_InitEvent, MappedToTaskRef=Task_Init_10
          Task_2ms_10_27_Timer0: PositionInTask=27, RTEEventRef=TMT_DiagMgr_Per1, MappedToTaskRef=Task_2ms_10
      DiagMgr11_Ap_DiagMgr11_ECU_Composition: SoftwareComponentInstanceRef=DiagMgr11, ImplementationRef=Ap_DiagMgr11_Implementation
        3 x RunnableEntityMapping, all with ActivationOffset=0, RteCyclicTriggerImplementation=Auto:
          Task_Trns_11_0_TrigModeSwitch0: PositionInTask=0, RTEEventRef=MST_DiagMgr11_Trns_0, MappedToTaskRef=Task_Trns_11
          Task_100ms_11_4_Timer0: PositionInTask=4, RTEEventRef=TMT_DiagMgr11_Per, MappedToTaskRef=Task_100ms_11
          Task_Init_11b_0_Timer0: PositionInTask=0, RTEEventRef=DiagMgr11_InitEvent, MappedToTaskRef=Task_Init_11b
      DiagMgr6_Ap_DiagMgr6_ECU_Composition: SoftwareComponentInstanceRef=DiagMgr6, ImplementationRef=Ap_DiagMgr6_Implementation
        6 x RunnableEntityMapping, all with ActivationOffset=0, RteCyclicTriggerImplementation=Auto:
          Task_Init_6_1_Timer0: PositionInTask=1, RTEEventRef=DiagMgr_Init1_InitEvent, MappedToTaskRef=Task_Init_6
          Task_100ms_6_2_Timer0: PositionInTask=2, RTEEventRef=TMT_DiagMgr6_Per, MappedToTaskRef=Task_100ms_6
          Task_Init_6_0_Timer0: PositionInTask=0, RTEEventRef=DiagMgr6_InitEvent, MappedToTaskRef=Task_Init_6
          Task_Trns_6_0_TrigModeSwitch0: PositionInTask=0, RTEEventRef=MST_DiagMgr_Trns1_0, MappedToTaskRef=Task_Trns_6
          Task_Trns_6_1_TrigModeSwitch0: PositionInTask=1, RTEEventRef=MST_DiagMgr6_Trns_0, MappedToTaskRef=Task_Trns_6
          Task_100ms_6_1_Timer0: PositionInTask=1, RTEEventRef=TMT_DiagMgr_Per2, MappedToTaskRef=Task_100ms_6
      DiagMgr9_Ap_DiagMgr9_ECU_Composition: SoftwareComponentInstanceRef=DiagMgr9, ImplementationRef=Ap_DiagMgr9_Implementation
        3 x RunnableEntityMapping, all with ActivationOffset=0, RteCyclicTriggerImplementation=Auto:
          Task_Trns_9_0_TrigModeSwitch0: PositionInTask=0, RTEEventRef=MST_DiagMgr9_Trns_0, MappedToTaskRef=Task_Trns_9
          Task_Init_9_1_Timer0: PositionInTask=1, RTEEventRef=DiagMgr9_InitEvent, MappedToTaskRef=Task_Init_9
          Task_100ms_9_4_Timer0: PositionInTask=4, RTEEventRef=TMT_DiagMgr9_Per, MappedToTaskRef=Task_100ms_9
      DiagSvc_Ap_DiagSvc_ECU_Composition: SoftwareComponentInstanceRef=DiagSvc, ImplementationRef=Ap_DiagSvc_Implementation
        Task_SchM_10ms_6_5_Timer0 (RunnableEntityMapping): PositionInTask=5, ActivationOffset=0, RteCyclicTriggerImplementation=Auto, RTEEventRef=TMT_DiagSvc_DummyFunction, MappedToTaskRef=Task_SchM_10ms_6
      DigMSB_Sa_DigMSB_ECU_Composition: SoftwareComponentInstanceRef=DigMSB, ImplementationRef=Sa_DigMSB_Implementation
        3 x RunnableEntityMapping, all with ActivationOffset=0, RteCyclicTriggerImplementation=Auto:
          Task_Init_10_21_Timer0: PositionInTask=21, RTEEventRef=DigMSB_InitEvent, MappedToTaskRef=Task_Init_10
          Task_2ms_10_10_Timer0: PositionInTask=10, RTEEventRef=TMT_DigMSB_Per2, MappedToTaskRef=Task_2ms_10
          Task_100ms_10_1_Timer0: PositionInTask=1, RTEEventRef=TMT_DigMSB_Per3, MappedToTaskRef=Task_100ms_10
        MAP_Rte_NvmBlock_Sa_DigMSB_DigMSBEOLData (NVRamAllocation): SwNvRamMappingReference=DigMSB.DigMSBEOLBlk, NvmBlockRef=Rte_NvmBlock_Sa_DigMSB_DigMSBEOLData
      DigPhsReasDiag_Ap_DigPhsReasDiag_ECU_Composition: SoftwareComponentInstanceRef=DigPhsReasDiag, ImplementationRef=Ap_DigPhsReasDiag_Implementation
        3 x RunnableEntityMapping, all with ActivationOffset=0, RteCyclicTriggerImplementation=Auto:
          Task_Init_10_7_Timer0: PositionInTask=7, RTEEventRef=DigPhsReasDiag_InitEvent, MappedToTaskRef=Task_Init_10
          Task_2ms_10_47_Timer0: PositionInTask=47, RTEEventRef=TMT_DigPhsReasDiag_Per1, MappedToTaskRef=Task_2ms_10
          Task_Trns_10_8_TrigModeSwitch0: PositionInTask=8, RTEEventRef=MST_DigPhsReasDiag_Trans1_0, MappedToTaskRef=Task_Trns_10
      EOTActuatorMng_Ap_EOTActuatorMng_ECU_Composition: SoftwareComponentInstanceRef=EOTActuatorMng, ImplementationRef=Ap_EOTActuatorMng_Implementation
        Task_2ms_9_6_Timer0 (RunnableEntityMapping): PositionInTask=6, ActivationOffset=0, RteCyclicTriggerImplementation=Auto, RTEEventRef=TMT_EOTActuatorMng_Per1, MappedToTaskRef=Task_2ms_9
      ElePwr_Ap_ElePwr_ECU_Composition: SoftwareComponentInstanceRef=ElePwr, ImplementationRef=Ap_ElePwr_Implementation
        Task_10ms_9_5_Timer0 (RunnableEntityMapping): PositionInTask=5, ActivationOffset=0, RteCyclicTriggerImplementation=Auto, RTEEventRef=TMT_ElePwr_Per1, MappedToTaskRef=Task_10ms_9
      EtDmpFw_Ap_EtDmpFw_ECU_Composition: SoftwareComponentInstanceRef=EtDmpFw, ImplementationRef=Ap_EtDmpFw_Implementation
        Task_2ms_10_20_Timer0 (RunnableEntityMapping): PositionInTask=20, ActivationOffset=0, RteCyclicTriggerImplementation=Auto, RTEEventRef=TMT_EtDmpFw_Per1, MappedToTaskRef=Task_2ms_10
      FaultLog_Ap_FaultLog_ECU_Composition: SoftwareComponentInstanceRef=FaultLog, ImplementationRef=Ap_FaultLog_Implementation
        3 x RunnableEntityMapping, all with ActivationOffset=0, RteCyclicTriggerImplementation=Auto:
          Task_10ms_6_1_Timer0: PositionInTask=1, RTEEventRef=TMT_FaultLog_Per1, MappedToTaskRef=Task_10ms_6
          Task_Init_6_4_Timer0: PositionInTask=4, RTEEventRef=FaultLog_Init1_InitEvent, MappedToTaskRef=Task_Init_6
          Task_Trns_6_4_TrigModeSwitch0: PositionInTask=4, RTEEventRef=MST_FaultLog_Trns1_0, MappedToTaskRef=Task_Trns_6
        MAP_Rte_NvmBlock_FaultLog_FaultLog (NVRamAllocation): SwNvRamMappingReference=FaultLog.FaultLogData, NvmBlockRef=Rte_NvmBlock_FaultLog_FaultLog
      FltInjection_Ap_FltInjection_ECU_Composition: SoftwareComponentInstanceRef=FltInjection, ImplementationRef=Ap_FltInjection_Implementation
        Task_2ms_10_49_Timer0 (RunnableEntityMapping): PositionInTask=49, ActivationOffset=0, RteCyclicTriggerImplementation=Auto, RTEEventRef=TMT_FltInjection_Per1, MappedToTaskRef=Task_2ms_10
      FrqDepDmpnInrtCmp_Ap_FrqDepDmpnInrtCmp_ECU_Composition: SoftwareComponentInstanceRef=FrqDepDmpnInrtCmp, ImplementationRef=Ap_FrqDepDmpnInrtCmp_Implementation
        Task_2ms_10_16_Timer0 (RunnableEntityMapping): PositionInTask=16, ActivationOffset=0, RteCyclicTriggerImplementation=Auto, RTEEventRef=TMT_FrqDepDmpnInrtCmp_Per1, MappedToTaskRef=Task_2ms_10
        Task_Init_10_12_Timer0 (RunnableEntityMapping): PositionInTask=12, ActivationOffset=0, RteCyclicTriggerImplementation=Auto, RTEEventRef=FrqDepDmpnInrtCmp_InitEvent, MappedToTaskRef=Task_Init_10
      HOWDetect_Ap_HOWDetect_ECU_Composition: SoftwareComponentInstanceRef=HOWDetect, ImplementationRef=Ap_HOWDetect_Implementation
        Task_2ms_9_22_Timer0 (RunnableEntityMapping): PositionInTask=22, ActivationOffset=0, RteCyclicTriggerImplementation=Auto, RTEEventRef=TMT_HOWDetect_Per1, MappedToTaskRef=Task_2ms_9
        Task_Init_9_11_Timer0 (RunnableEntityMapping): PositionInTask=11, ActivationOffset=0, RteCyclicTriggerImplementation=Auto, RTEEventRef=HOWDetect_Init1_InitEvent, MappedToTaskRef=Task_Init_9
      HiLoadStall_Ap_HiLoadStall_ECU_Composition: SoftwareComponentInstanceRef=HiLoadStall, ImplementationRef=Ap_HiLoadStall_Implementation
        Task_2ms_9_4_Timer0 (RunnableEntityMapping): PositionInTask=4, ActivationOffset=0, RteCyclicTriggerImplementation=Auto, RTEEventRef=TMT_HiLoadStall_Per1, MappedToTaskRef=Task_2ms_9
      HighFreqAssist_Ap_HighFreqAssist_ECU_Composition: SoftwareComponentInstanceRef=HighFreqAssist, ImplementationRef=Ap_HighFreqAssist_Implementation
        Task_2ms_10_5_Timer0 (RunnableEntityMapping): PositionInTask=5, ActivationOffset=0, RteCyclicTriggerImplementation=Auto, RTEEventRef=TMT_HighFreqAssist_Per1, MappedToTaskRef=Task_2ms_10
      HwPwUp_Ap_HwPwUp_ECU_Composition: SoftwareComponentInstanceRef=HwPwUp, ImplementationRef=Ap_HwPwUp_Implementation
        4 x RunnableEntityMapping, all with ActivationOffset=0, RteCyclicTriggerImplementation=Auto:
          Task_2ms_10_43_Timer0: PositionInTask=43, RTEEventRef=TMT_HwPwUp_Per1, MappedToTaskRef=Task_2ms_10
          Task_Trns_10_5_TrigModeSwitch0: PositionInTask=5, RTEEventRef=MST_HwPwUp_Trns2_0, MappedToTaskRef=Task_Trns_10
          Task_Trns_10_3_TrigModeSwitch1: PositionInTask=3, RTEEventRef=MST_HwPwUp_Trns1_1, MappedToTaskRef=Task_Trns_10
          Task_Trns_10_3_TrigModeSwitch0: PositionInTask=3, RTEEventRef=MST_HwPwUp_Trns1_0, MappedToTaskRef=Task_Trns_10
      HwTqArbn_Sa_HwTqArbn_ECU_Composition: SoftwareComponentInstanceRef=HwTqArbn, ImplementationRef=Sa_HwTqArbn_Implementation
        4 x RunnableEntityMapping, all with ActivationOffset=0, RteCyclicTriggerImplementation=Auto:
          Task_2ms_10_2_Timer0: PositionInTask=2, RTEEventRef=TMT_HwTqArbn_Per1, MappedToTaskRef=Task_2ms_10
          Task_Init_10_19_Timer0: PositionInTask=19, RTEEventRef=HwTqArbn_Init1_InitEvent, MappedToTaskRef=Task_Init_10
          Task_100ms_10_5_Timer0: PositionInTask=5, RTEEventRef=TMT_HwTqArbn_Per3, MappedToTaskRef=Task_100ms_10
          Task_2ms_10_3_Timer0: PositionInTask=3, RTEEventRef=TMT_HwTqArbn_Per2, MappedToTaskRef=Task_2ms_10
        MAP_Rte_NvmBlock_HwTqArbn_HwTqArbnEOLCh1OffsetTrimData (NVRamAllocation): SwNvRamMappingReference=HwTqArbn.HwTqArbnEOLCh1OffsetTrimBlk, NvmBlockRef=Rte_NvmBlock_HwTqArbn_HwTqArbnEOLCh1OffsetTrimData
      HwTqCorrln_Sa_HwTqCorrln_ECU_Composition: SoftwareComponentInstanceRef=HwTqCorrln, ImplementationRef=Sa_HwTqCorrln_Implementation
        4 x RunnableEntityMapping, all with ActivationOffset=0, RteCyclicTriggerImplementation=Auto:
          Task_100ms_10_4_Timer0: PositionInTask=4, RTEEventRef=TMT_HwTqCorrln_Per3, MappedToTaskRef=Task_100ms_10
          Task_Init_10_18_Timer0: PositionInTask=18, RTEEventRef=HwTqCorrln_Init1_InitEvent, MappedToTaskRef=Task_Init_10
          Task_2ms_10_1_Timer0: PositionInTask=1, RTEEventRef=TMT_HwTqCorrln_Per1, MappedToTaskRef=Task_2ms_10
          Task_4ms_10_2_Timer0: PositionInTask=2, RTEEventRef=TMT_HwTqCorrln_Per2, MappedToTaskRef=Task_4ms_10
        MAP_Rte_NvmBlock_HwTqCorrln_HwTqCorrlnCh1CMCLPFSvData (NVRamAllocation): SwNvRamMappingReference=HwTqCorrln.HwTqCorrlnCh1CMCLPFSvBlk, NvmBlockRef=Rte_NvmBlock_HwTqCorrln_HwTqCorrlnCh1CMCLPFSvData
      HystComp_Ap_HystComp_ECU_Composition: SoftwareComponentInstanceRef=HystComp, ImplementationRef=Ap_HystComp_Implementation
        Task_Init_10_11_Timer0 (RunnableEntityMapping): PositionInTask=11, ActivationOffset=0, RteCyclicTriggerImplementation=Auto, RTEEventRef=HystComp_Init1_InitEvent, MappedToTaskRef=Task_Init_10
        Task_2ms_10_7_Timer0 (RunnableEntityMapping): PositionInTask=7, ActivationOffset=0, RteCyclicTriggerImplementation=Auto, RTEEventRef=TMT_HystComp_Per1, MappedToTaskRef=Task_2ms_10
      IoHwAb10_IoHwAb10_ECU_Composition: SoftwareComponentInstanceRef=IoHwAb10, ImplementationRef=IoHwAb10_Implementation
        Task_Init_10_4_Timer0 (RunnableEntityMapping): PositionInTask=4, ActivationOffset=0, RteCyclicTriggerImplementation=Auto, RTEEventRef=IoHwAb_InitEvent, MappedToTaskRef=Task_Init_10
        Task_2ms_10_40_Timer0 (RunnableEntityMapping): PositionInTask=40, ActivationOffset=0, RteCyclicTriggerImplementation=Auto, RTEEventRef=TMT_IoHwAb_ReadAdc, MappedToTaskRef=Task_2ms_10
      IoHwAb9_IoHwAb9_ECU_Composition: SoftwareComponentInstanceRef=IoHwAb9, ImplementationRef=IoHwAb9_Implementation
        Task_2ms_9_2_Timer0 (RunnableEntityMapping): PositionInTask=2, ActivationOffset=0, RteCyclicTriggerImplementation=Auto, RTEEventRef=TMT_IoHwAb_StartAdc, MappedToTaskRef=Task_2ms_9
      IoHwAbsDigSig_IoHwAbstraction_ECU_Composition: SoftwareComponentInstanceRef=IoHwAbsDigSig, ImplementationRef=IoHwAbstraction_Implementation
        Task_SchM_10ms_6_4_Timer0 (RunnableEntityMapping): PositionInTask=4, ActivationOffset=0, RteCyclicTriggerImplementation=Auto, RTEEventRef=TMT_IoHwAb_DummyFunction, MappedToTaskRef=Task_SchM_10ms_6
      LmtCod_Ap_LmtCod_ECU_Composition: SoftwareComponentInstanceRef=LmtCod, ImplementationRef=Ap_LmtCod_Implementation
        Task_2ms_10_22_Timer0 (RunnableEntityMapping): PositionInTask=22, ActivationOffset=0, RteCyclicTriggerImplementation=Auto, RTEEventRef=TMT_LmtCod_Per1, MappedToTaskRef=Task_2ms_10
      LoaMgr_Ap_LoaMgr_ECU_Composition: SoftwareComponentInstanceRef=LoaMgr, ImplementationRef=Ap_LoaMgr_Implementation
        Task_4ms_10_4_Timer0 (RunnableEntityMapping): PositionInTask=4, ActivationOffset=0, RteCyclicTriggerImplementation=Auto, RTEEventRef=TMT_LoaMgr_Per1, MappedToTaskRef=Task_4ms_10
        EaLoaScaleAndRate (ExclusiveAreaImplementation): ExclusiveAreaImplMechanism=INTERRUPT_BLOCKING, ExclusiveAreaRef=EaLoaScaleAndRate
        Task_Init_10_30_Timer0 (RunnableEntityMapping): PositionInTask=30, ActivationOffset=0, RteCyclicTriggerImplementation=Auto, RTEEventRef=LoaMgr_Init1_InitEvent, MappedToTaskRef=Task_Init_10
      LrnEOT_Ap_LrnEOT_ECU_Composition: SoftwareComponentInstanceRef=LrnEOT, ImplementationRef=Ap_LrnEOT_Implementation
        Task_10ms_9_2_Timer0 (RunnableEntityMapping): PositionInTask=2, ActivationOffset=0, RteCyclicTriggerImplementation=Auto, RTEEventRef=TMT_LrnEOT_Per1, MappedToTaskRef=Task_10ms_9
        Task_Init_9_8_Timer0 (RunnableEntityMapping): PositionInTask=8, ActivationOffset=0, RteCyclicTriggerImplementation=Auto, RTEEventRef=LrnEOT_Init1_InitEvent, MappedToTaskRef=Task_Init_9
        MAP_Rte_NvmBlock_LrnEOT_LearnedEOT (NVRamAllocation): SwNvRamMappingReference=LrnEOT.EOTLearnedBlk, NvmBlockRef=Rte_NvmBlock_LrnEOT_LearnedEOT
      MtrDrvDiag_Sa_MtrDrvDiag_ECU_Composition: SoftwareComponentInstanceRef=MtrDrvDiag, ImplementationRef=Sa_MtrDrvDiag_Implementation
        3 x RunnableEntityMapping, all with ActivationOffset=0, RteCyclicTriggerImplementation=Auto:
          Task_2ms_10_46_Timer0: PositionInTask=46, RTEEventRef=TMT_MtrDrvDiag_Per2, MappedToTaskRef=Task_2ms_10
          Task_2ms_10_45_Timer0: PositionInTask=45, RTEEventRef=TMT_MtrDrvDiag_Per1, MappedToTaskRef=Task_2ms_10
          Task_Trns_10_4_TrigModeSwitch0: PositionInTask=4, RTEEventRef=MST_MtrDrvDiag_Trns1_0, MappedToTaskRef=Task_Trns_10
      MtrTempEst_Ap_MtrTempEst_ECU_Composition: SoftwareComponentInstanceRef=MtrTempEst, ImplementationRef=Ap_MtrTempEst_Implementation
        Task_100ms_11_3_Timer0 (RunnableEntityMapping): PositionInTask=3, ActivationOffset=0, RteCyclicTriggerImplementation=Auto, RTEEventRef=TMT_MtrTempEst_Per1, MappedToTaskRef=Task_100ms_11
        Task_Init_11b_4_Timer0 (RunnableEntityMapping): PositionInTask=4, ActivationOffset=0, RteCyclicTriggerImplementation=Auto, RTEEventRef=MtrTempEst_Init1_InitEvent, MappedToTaskRef=Task_Init_11b
      MtrVel_Sa_MtrVel_ECU_Composition: SoftwareComponentInstanceRef=MtrVel, ImplementationRef=Sa_MtrVel_Implementation
        3 x RunnableEntityMapping, all with ActivationOffset=0, RteCyclicTriggerImplementation=Auto:
          Task_Init_10_22_Timer0: PositionInTask=22, RTEEventRef=MtrVel_InitEvent, MappedToTaskRef=Task_Init_10
          Task_2ms_10_11_Timer0: PositionInTask=11, RTEEventRef=TMT_MtrVel_Per2, MappedToTaskRef=Task_2ms_10
          Task_2ms_10_12_Timer0: PositionInTask=12, RTEEventRef=TMT_MtrVel_Per1, MappedToTaskRef=Task_2ms_10
      MtrVel2_Sa_MtrVel2_ECU_Composition: SoftwareComponentInstanceRef=MtrVel2, ImplementationRef=Sa_MtrVel2_Implementation
        3 x RunnableEntityMapping, all with ActivationOffset=0, RteCyclicTriggerImplementation=Auto:
          Task_Init_11b_2_Timer0: PositionInTask=2, RTEEventRef=MtrVel2_InitEvent, MappedToTaskRef=Task_Init_11b
          Task_2ms_11_1_Timer0: PositionInTask=1, RTEEventRef=TMT_MtrVel2_Per1, MappedToTaskRef=Task_2ms_11
          Task_2ms_11_2_Timer0: PositionInTask=2, RTEEventRef=TMT_MtrVel2_Per2, MappedToTaskRef=Task_2ms_11
      MtrVel3_Sa_MtrVel3_ECU_Composition: SoftwareComponentInstanceRef=MtrVel3, ImplementationRef=Sa_MtrVel3_Implementation
        Task_Init_10_23_Timer0 (RunnableEntityMapping): PositionInTask=23, ActivationOffset=0, RteCyclicTriggerImplementation=Auto, RTEEventRef=MtrVel3_InitEvent, MappedToTaskRef=Task_Init_10
      NexteerLibs_NexteerLibs_ECU_Composition: ServiceComponentPrototypeRef=NexteerLibs, ImplementationRef=NexteerLibs_Implementation
        Task_2ms_10_39_Timer0 (RunnableEntityMapping): PositionInTask=39, ActivationOffset=0, RteCyclicTriggerImplementation=Auto, RTEEventRef=TMT_SystemTime_Per1, MappedToTaskRef=Task_2ms_10
      Nhet1CfgAndUse_Cd_Nhet1CfgAndUse_ECU_Composition: SoftwareComponentInstanceRef=Nhet1CfgAndUse, ImplementationRef=Cd_Nhet1CfgAndUse_Implementation
        Task_2ms_9_15_Timer0 (RunnableEntityMapping): PositionInTask=15, ActivationOffset=0, RteCyclicTriggerImplementation=Auto, RTEEventRef=TMT_Nhet1CfgAndUse_Per2, MappedToTaskRef=Task_2ms_9
        Task_2ms_9_14_Timer0 (RunnableEntityMapping): PositionInTask=14, ActivationOffset=0, RteCyclicTriggerImplementation=Auto, RTEEventRef=TMT_Nhet1CfgAndUse_Per1, MappedToTaskRef=Task_2ms_9
      NtWrap_NtWrap_ECU_Composition: SoftwareComponentInstanceRef=NtWrap, ImplementationRef=NtWrap_Implementation
        Task_100ms_10_7_Timer0 (RunnableEntityMapping): PositionInTask=7, ActivationOffset=0, RteCyclicTriggerImplementation=Auto, RTEEventRef=TMT_NtWrap_Per1, MappedToTaskRef=Task_100ms_10
      NvMProxy_NvMProxy_ECU_Composition: ServiceComponentPrototypeRef=NvMProxy, ImplementationRef=NvMProxy_Implementation
        Task_SchM_10ms_6_3_Timer0 (RunnableEntityMapping): PositionInTask=3, ActivationOffset=0, RteCyclicTriggerImplementation=Auto, RTEEventRef=TMT_NvMProxy_MainFunction, MappedToTaskRef=Task_SchM_10ms_6
      OvrVoltMon_Sa_OvrVoltMon_ECU_Composition: SoftwareComponentInstanceRef=OvrVoltMon, ImplementationRef=Sa_OvrVoltMon_Implementation
        Task_2ms_10_44_Timer0 (RunnableEntityMapping): PositionInTask=44, ActivationOffset=0, RteCyclicTriggerImplementation=Auto, RTEEventRef=TMT_OvrVoltMon_Per1, MappedToTaskRef=Task_2ms_10
      PICurrCntrl_Ap_PICurrCntrl_ECU_Composition: SoftwareComponentInstanceRef=PICurrCntrl, ImplementationRef=Ap_PICurrCntrl_Implementation
        Task_Init_10_32_Timer0 (RunnableEntityMapping): PositionInTask=32, ActivationOffset=0, RteCyclicTriggerImplementation=Auto, RTEEventRef=PICurrCntrl_InitEvent, MappedToTaskRef=Task_Init_10
      PSADMQ_Ap_PSADMQ_ECU_Composition: SoftwareComponentInstanceRef=PSADMQ, ImplementationRef=Ap_PSADMQ_Implementation
        Task_2ms_9_24_Timer0 (RunnableEntityMapping): PositionInTask=24, ActivationOffset=0, RteCyclicTriggerImplementation=Auto, RTEEventRef=TMT_PSADMQ_Per1, MappedToTaskRef=Task_2ms_9
      PSADSG_Ap_PSADSG_ECU_Composition: SoftwareComponentInstanceRef=PSADSG, ImplementationRef=Ap_PSADSG_Implementation
        Task_2ms_10_17_Timer0 (RunnableEntityMapping): PositionInTask=17, ActivationOffset=0, RteCyclicTriggerImplementation=Auto, RTEEventRef=TMT_PSADSG_Per1, MappedToTaskRef=Task_2ms_10
      PSASH_Ap_PSASH_ECU_Composition: SoftwareComponentInstanceRef=PSASH, ImplementationRef=Ap_PSASH_Implementation
        Task_2ms_9_10_Timer0 (RunnableEntityMapping): PositionInTask=10, ActivationOffset=0, RteCyclicTriggerImplementation=Auto, RTEEventRef=TMT_PSASH_Per1, MappedToTaskRef=Task_2ms_9
        Task_Init_9_6_Timer0 (RunnableEntityMapping): PositionInTask=6, ActivationOffset=0, RteCyclicTriggerImplementation=Auto, RTEEventRef=PSASH_Init1_InitEvent, MappedToTaskRef=Task_Init_9
      PSATA_Ap_PSATA_ECU_Composition: SoftwareComponentInstanceRef=PSATA, ImplementationRef=Ap_PSATA_Implementation
        Task_Init_10_24_Timer0 (RunnableEntityMapping): PositionInTask=24, ActivationOffset=0, RteCyclicTriggerImplementation=Auto, RTEEventRef=PSATA_Init1_InitEvent, MappedToTaskRef=Task_Init_10
        Task_2ms_10_23_Timer0 (RunnableEntityMapping): PositionInTask=23, ActivationOffset=0, RteCyclicTriggerImplementation=Auto, RTEEventRef=TMT_PSATA_Per1, MappedToTaskRef=Task_2ms_10
      PeakCurrEst_Ap_PeakCurrEst_ECU_Composition: SoftwareComponentInstanceRef=PeakCurrEst, ImplementationRef=Ap_PeakCurrEst_Implementation
        Task_2ms_10_36_Timer0 (RunnableEntityMapping): PositionInTask=36, ActivationOffset=0, RteCyclicTriggerImplementation=Auto, RTEEventRef=TMT_PeakCurrEst_Per1, MappedToTaskRef=Task_2ms_10
        Task_100ms_10_3_Timer0 (RunnableEntityMapping): PositionInTask=3, ActivationOffset=0, RteCyclicTriggerImplementation=Auto, RTEEventRef=TMT_PeakCurrEst_Per2, MappedToTaskRef=Task_100ms_10
      PhaseAbcFdbkMeas_Cd_PhaseAbcFdbkMeas_ECU_Composition: SoftwareComponentInstanceRef=PhaseAbcFdbkMeas, ImplementationRef=Cd_PhaseAbcFdbkMeas_Implementation
        Task_2ms_9_17_Timer0 (RunnableEntityMapping): PositionInTask=17, ActivationOffset=0, RteCyclicTriggerImplementation=Auto, RTEEventRef=TMT_Cd_PhaseAbcFdbkMeas_Per1, MappedToTaskRef=Task_2ms_9
        Task_Init_9_13_Timer0 (RunnableEntityMapping):
          PositionInTask = 13
          ActivationOffset = 0
          RteCyclicTriggerImplementation = Auto
          RTEEventRef = Cd_PhaseAbcFdbkMeas_Init2_InitEvent
          MappedToTaskRef = Task_Init_9
      PosServo_Ap_PosServo_ECU_Composition: SoftwareComponentInstanceRef=PosServo, ImplementationRef=Ap_PosServo_Implementation
        Task_Init_9_7_Timer0 (RunnableEntityMapping): PositionInTask=7, ActivationOffset=0, RteCyclicTriggerImplementation=Auto, RTEEventRef=PosServo_Init1_InitEvent, MappedToTaskRef=Task_Init_9
        Task_2ms_9_11_Timer0 (RunnableEntityMapping): PositionInTask=11, ActivationOffset=0, RteCyclicTriggerImplementation=Auto, RTEEventRef=TMT_PosServo_Per1, MappedToTaskRef=Task_2ms_9
      PsaAgArbn_Ap_PsaAgArbn_ECU_Composition: SoftwareComponentInstanceRef=PsaAgArbn, ImplementationRef=Ap_PsaAgArbn_Implementation
        Task_Init_10_33_Timer0 (RunnableEntityMapping): PositionInTask=33, ActivationOffset=0, RteCyclicTriggerImplementation=Auto, RTEEventRef=PsaAgArbn_Init1_InitEvent, MappedToTaskRef=Task_Init_10
        Task_2ms_10_48_Timer0 (RunnableEntityMapping): PositionInTask=48, ActivationOffset=0, RteCyclicTriggerImplementation=Auto, RTEEventRef=TMT_PsaAgArbn_Per1, MappedToTaskRef=Task_2ms_10
        MAP_Rte_NvmBlock_PsaAgArbn_PsaAgArbnLrndOffsData (NVRamAllocation): SwNvRamMappingReference=PsaAgArbn.PsaAgArbnLrndOffsBlk, NvmBlockRef=Rte_NvmBlock_PsaAgArbn_PsaAgArbnLrndOffsData
      PwrLmtFuncCr_Ap_PwrLmtFuncCr_ECU_Composition: SoftwareComponentInstanceRef=PwrLmtFuncCr, ImplementationRef=Ap_PwrLmtFuncCr_Implementation
        3 x RunnableEntityMapping, all with ActivationOffset=0, RteCyclicTriggerImplementation=Auto:
          Task_Init_10_17_Timer0: PositionInTask=17, RTEEventRef=PwrLmtFuncCr_Init1_InitEvent, MappedToTaskRef=Task_Init_10
          Task_10ms_10a_1_Timer0: PositionInTask=1, RTEEventRef=TMT_PwrLmtFuncCr_Per2, MappedToTaskRef=Task_10ms_10a
          Task_2ms_10_29_Timer0: PositionInTask=29, RTEEventRef=TMT_PwrLmtFuncCr_Per1, MappedToTaskRef=Task_2ms_10
      QuadDet_Ap_QuadDet_ECU_Composition: SoftwareComponentInstanceRef=QuadDet, ImplementationRef=Ap_QuadDet_Implementation
        Task_2ms_10_32_Timer0 (RunnableEntityMapping): PositionInTask=32, ActivationOffset=0, RteCyclicTriggerImplementation=Auto, RTEEventRef=TMT_QuadDet_Per1, MappedToTaskRef=Task_2ms_10
      Return_Ap_Return_ECU_Composition: SoftwareComponentInstanceRef=Return, ImplementationRef=Ap_Return_Implementation
        Task_2ms_9_7_Timer0 (RunnableEntityMapping): PositionInTask=7, ActivationOffset=0, RteCyclicTriggerImplementation=Auto, RTEEventRef=TMT_Return_Per1, MappedToTaskRef=Task_2ms_9
      ReturnFirewall_Ap_ReturnFirewall_ECU_Composition: SoftwareComponentInstanceRef=ReturnFirewall, ImplementationRef=Ap_ReturnFirewall_Implementation
        Task_2ms_10_19_Timer0 (RunnableEntityMapping): PositionInTask=19, ActivationOffset=0, RteCyclicTriggerImplementation=Auto, RTEEventRef=TMT_ReturnFirewall_Per1, MappedToTaskRef=Task_2ms_10
      RteErrata10_RteErrata10_ECU_Composition: SoftwareComponentInstanceRef=RteErrata10, ImplementationRef=RteErrata10_Implementation
        4 x RunnableEntityMapping, all with PositionInTask=9, ActivationOffset=0, RteCyclicTriggerImplementation=Auto, MappedToTaskRef=Task_Trns_10:
          Task_Trns_10_9_TrigModeSwitch3: RTEEventRef=MST_RteErrata10_Trns_3
          Task_Trns_10_9_TrigModeSwitch2: RTEEventRef=MST_RteErrata10_Trns_2
          Task_Trns_10_9_TrigModeSwitch1: RTEEventRef=MST_RteErrata10_Trns_1
          Task_Trns_10_9_TrigModeSwitch0: RTEEventRef=MST_RteErrata10_Trns_0
      RteErrata11_RteErrata11_ECU_Composition: SoftwareComponentInstanceRef=RteErrata11, ImplementationRef=RteErrata11_Implementation
        4 x RunnableEntityMapping, all with PositionInTask=1, ActivationOffset=0, RteCyclicTriggerImplementation=Auto, MappedToTaskRef=Task_Trns_11:
          Task_Trns_11_1_TrigModeSwitch3: RTEEventRef=MST_RteErrata11_Trns_3
          Task_Trns_11_1_TrigModeSwitch2: RTEEventRef=MST_RteErrata11_Trns_2
          Task_Trns_11_1_TrigModeSwitch1: RTEEventRef=MST_RteErrata11_Trns_1
          Task_Trns_11_1_TrigModeSwitch0: RTEEventRef=MST_RteErrata11_Trns_0
      RteErrata6_RteErrata6_ECU_Composition: SoftwareComponentInstanceRef=RteErrata6, ImplementationRef=RteErrata6_Implementation
        4 x RunnableEntityMapping, all with PositionInTask=5, ActivationOffset=0, RteCyclicTriggerImplementation=Auto, MappedToTaskRef=Task_Trns_6:
          Task_Trns_6_5_TrigModeSwitch3: RTEEventRef=MST_RteErrata6_Trns_3
          Task_Trns_6_5_TrigModeSwitch2: RTEEventRef=MST_RteErrata6_Trns_2
          Task_Trns_6_5_TrigModeSwitch1: RTEEventRef=MST_RteErrata6_Trns_1
          Task_Trns_6_5_TrigModeSwitch0: RTEEventRef=MST_RteErrata6_Trns_0
      RteErrata9_RteErrata9_ECU_Composition: SoftwareComponentInstanceRef=RteErrata9, ImplementationRef=RteErrata9_Implementation
        4 x RunnableEntityMapping, all with PositionInTask=12, ActivationOffset=0, RteCyclicTriggerImplementation=Auto, MappedToTaskRef=Task_Trns_9:
          Task_Trns_9_12_TrigModeSwitch3: RTEEventRef=MST_RteErrata9_Trns_3
          Task_Trns_9_12_TrigModeSwitch2: RTEEventRef=MST_RteErrata9_Trns_2
          Task_Trns_9_12_TrigModeSwitch1: RTEEventRef=MST_RteErrata9_Trns_1
          Task_Trns_9_12_TrigModeSwitch0: RTEEventRef=MST_RteErrata9_Trns_0
      ShtdnMech_Sa_ShtdnMech_ECU_Composition: SoftwareComponentInstanceRef=ShtdnMech, ImplementationRef=Sa_ShtdnMech_Implementation
        Task_10ms_10b_21_Timer0 (RunnableEntityMapping): PositionInTask=21, ActivationOffset=0, RteCyclicTriggerImplementation=Auto, RTEEventRef=TMT_ShtdnMech_Per1, MappedToTaskRef=Task_10ms_10b
      SignlCondn_Ap_SignlCondn_ECU_Composition: SoftwareComponentInstanceRef=SignlCondn, ImplementationRef=Ap_SignlCondn_Implementation
        Task_2ms_11_5_Timer0 (RunnableEntityMapping): PositionInTask=5, ActivationOffset=0, RteCyclicTriggerImplementation=Auto, RTEEventRef=TMT_SignlCondn_Per1, MappedToTaskRef=Task_2ms_11
      SrlComDriver_Cd_SrlComDriver_ECU_Composition: SoftwareComponentInstanceRef=SrlComDriver, ImplementationRef=Cd_SrlComDriver_Implementation
        Task_Trns_6_3_TrigModeSwitch0 (RunnableEntityMapping): PositionInTask=3, ActivationOffset=0, RteCyclicTriggerImplementation=Auto, RTEEventRef=MST_SrlComDriver_Trns2_0, MappedToTaskRef=Task_Trns_6
        BusOff (ExclusiveAreaImplementation): ExclusiveAreaImplMechanism=INTERRUPT_BLOCKING, ExclusiveAreaRef=BusOff
        3 x RunnableEntityMapping, all with ActivationOffset=0, RteCyclicTriggerImplementation=Auto:
          Task_Trns_6_2_TrigModeSwitch0: PositionInTask=2, RTEEventRef=MST_SrlComDriver_Trns1_0, MappedToTaskRef=Task_Trns_6
          Task_10ms_6_2_Timer0: PositionInTask=2, RTEEventRef=TMT_SrlComDriver_Per1, MappedToTaskRef=Task_10ms_6
          Task_Init_6_3_Timer0: PositionInTask=3, RTEEventRef=SrlComDriver_Init1_InitEvent, MappedToTaskRef=Task_Init_6
      SrlComInput_Ap_SrlComInput_ECU_Composition: SoftwareComponentInstanceRef=SrlComInput, ImplementationRef=Ap_SrlComInput_Implementation
        Task_10ms_10b_13_TrigDataRec0 (RunnableEntityMapping):
          PositionInTask = 13
          ActivationOffset = 0
          RteCyclicTriggerImplementation = Auto
          RTEEventRef = DRT_SrlComInput_MsgIsDat4V2Bsi_552_ISDAT4V2BSI552MsgRxTime_MSec_u32
          MappedToTaskRef = Task_10ms_10b
        EaShutdownTimeData (ExclusiveAreaImplementation): ExclusiveAreaImplMechanism=INTERRUPT_BLOCKING, ExclusiveAreaRef=EaShutdownTimeData
        DmdDelestDa (ExclusiveAreaImplementation): ExclusiveAreaImplMechanism=INTERRUPT_BLOCKING, ExclusiveAreaRef=DmdDelestDa
        20 x RunnableEntityMapping, all with ActivationOffset=0, RteCyclicTriggerImplementation=Auto:
          Task_10ms_10b_10_TrigDataRec0: PositionInTask=10, RTEEventRef=DRT_SrlComInput_MsgIsDatBsi_412_ISDATBSI412MsgRxTime_MSec_u32, MappedToTaskRef=Task_10ms_10b
          Task_Trns_10_2_TrigModeSwitch0: PositionInTask=2, RTEEventRef=MST_SrlComInput_Trns2_0, MappedToTaskRef=Task_Trns_10
          Task_Init_10_28_Timer0: PositionInTask=28, RTEEventRef=SrlComInput_InitEvent, MappedToTaskRef=Task_Init_10
          Task_10ms_10b_1_Timer0: PositionInTask=1, RTEEventRef=TMT_SrlComInput_Per1, MappedToTaskRef=Task_10ms_10b
          Task_10ms_10b_11_TrigDataRec0: PositionInTask=11, RTEEventRef=DRT_SrlComInput_MsgIsDatBsi_432_ISDATBSI432MsgRxTime_MSec_u32, MappedToTaskRef=Task_10ms_10b
          Task_10ms_10b_6_TrigDataRec0: PositionInTask=6, RTEEventRef=DRT_SrlComInput_MsgIsInteElectronBsi_092_ISINTEELECTRONBSIMsgRxTime_MSec_u32, MappedToTaskRef=Task_10ms_10b
          Task_10ms_10b_14_TrigDataRec0: PositionInTask=14, RTEEventRef=DRT_SrlComInput_MsgIsDynCds_34D_ISDYNCDS34DMsgRxTime_MSec_u32, MappedToTaskRef=Task_10ms_10b
          Task_10ms_10b_4_TrigDataRec0: PositionInTask=4, RTEEventRef=DRT_SrlComInput_MsgIsDynCmm_388_ISDYNCMM388MsgRxTime_MSec_u32, MappedToTaskRef=Task_10ms_10b
          Task_10ms_10b_5_TrigDataRec0: PositionInTask=5, RTEEventRef=DRT_SrlComInput_MsgIsDynAas_2EB_ISDYNAASMsgRxTime_MSec_u32, MappedToTaskRef=Task_10ms_10b
          Task_10ms_10b_12_TrigDataRec0: PositionInTask=12, RTEEventRef=DRT_SrlComInput_MsgIsDatBsi_572_ISDATBSI572MsgRxTime_MSec_u32, MappedToTaskRef=Task_10ms_10b
          Task_Trns_10_6_TrigModeSwitch0: PositionInTask=6, RTEEventRef=MST_SrlComInput_Trns1_0, MappedToTaskRef=Task_Trns_10
          Task_10ms_10b_17_TrigDataRec0: PositionInTask=17, RTEEventRef=DRT_SrlComInput_MsgProtoHs1DynUcf_5CD_PROTOHS1DYNUCF5CDMsgRxTime_MSec_u32, MappedToTaskRef=Task_10ms_10b
          Task_10ms_10b_3_TrigDataRec0: PositionInTask=3, RTEEventRef=DRT_SrlComInput_MsgIsDynAbr_38D_ISDYNABRMsgRxTime_MSec_u32, MappedToTaskRef=Task_10ms_10b
          Task_10ms_10b_2_TrigDataRec0: PositionInTask=2, RTEEventRef=DRT_SrlComInput_MsgIsDynVol_305_ISDYNVOLMsgRxTime_MSec_u32, MappedToTaskRef=Task_10ms_10b
          Task_10ms_10b_15_TrigDataRec0: PositionInTask=15, RTEEventRef=DRT_SrlComInput_MsgIsDatAbr_50D_ISDATABR50DMsgRxTime_MSec_u32, MappedToTaskRef=Task_10ms_10b
          Task_10ms_10b_9_TrigDataRec0: PositionInTask=9, RTEEventRef=DRT_SrlComInput_MsgIsDatBsi_3F2_ISDATBSI3F2MsgRxTime_MSec_u32, MappedToTaskRef=Task_10ms_10b
          Task_10ms_10b_18_Timer0: PositionInTask=18, RTEEventRef=TMT_SrlComInput_Per2, MappedToTaskRef=Task_10ms_10b
          Task_10ms_10b_16_TrigDataRec0: PositionInTask=16, RTEEventRef=DRT_SrlComInput_MsgIsDyn2Fre_3CD_ISDYN2FRE3CDMsgRxTime_MSec_u32, MappedToTaskRef=Task_10ms_10b
          Task_10ms_10b_7_TrigDataRec0: PositionInTask=7, RTEEventRef=DRT_SrlComInput_MsgIsDynCmm_208_ISDYNCMM208MsgRxTime_MSec_u32, MappedToTaskRef=Task_10ms_10b
          Task_10ms_10b_8_TrigDataRec0: PositionInTask=8, RTEEventRef=DRT_SrlComInput_MsgIsDyn2Cmm_348_ISDYN2CMMMsgRxTime_MSec_u32, MappedToTaskRef=Task_10ms_10b
        3 x NVRamAllocation:
          MAP_Rte_NvmBlock_SrlComInput_ShutdownTimeData: SwNvRamMappingReference=SrlComInput.ShutdownTime, NvmBlockRef=Rte_NvmBlock_SrlComInput_ShutdownTimeData
          MAP_Rte_NvmBlock_SrlComInput_VVHTYPEData: SwNvRamMappingReference=SrlComInput.VVHTYPE, NvmBlockRef=Rte_NvmBlock_SrlComInput_VVHTYPEData
          MAP_Rte_NvmBlock_SrlComInput_ElecIntData: SwNvRamMappingReference=SrlComInput.ElecInt, NvmBlockRef=Rte_NvmBlock_SrlComInput_ElecIntData
      SrlComOutput_Ap_SrlComOutput_ECU_Composition: SoftwareComponentInstanceRef=SrlComOutput, ImplementationRef=Ap_SrlComOutput_Implementation
        Task_Trns_10_1_TrigModeSwitch0 (RunnableEntityMapping): PositionInTask=1, ActivationOffset=0, RteCyclicTriggerImplementation=Auto, RTEEventRef=MST_SrlComOutput_Trns1_0, MappedToTaskRef=Task_Trns_10
        4 x ExclusiveAreaImplementation, all with ExclusiveAreaImplMechanism=INTERRUPT_BLOCKING:
          IsDatDiraMsg: ExclusiveAreaRef=IsDatDiraMsg
          IsDynDaeMsg: ExclusiveAreaRef=IsDynDaeMsg
          IsDynVolMsg: ExclusiveAreaRef=IsDynVolMsg
          IsSupvDiraMsg: ExclusiveAreaRef=IsSupvDiraMsg
        Task_10ms_10a_3_Timer0 (RunnableEntityMapping): PositionInTask=3, ActivationOffset=0, RteCyclicTriggerImplementation=Auto, RTEEventRef=TMT_SrlComOutput_Per1, MappedToTaskRef=Task_10ms_10a
        Task_Init_10_29_Timer0 (RunnableEntityMapping): PositionInTask=29, ActivationOffset=0, RteCyclicTriggerImplementation=Auto, RTEEventRef=SrlComOutput_InitEvent, MappedToTaskRef=Task_Init_10
      StOpCtrl_Ap_StOpCtrl_ECU_Composition: SoftwareComponentInstanceRef=StOpCtrl, ImplementationRef=Ap_StOpCtrl_Implementation
        Task_2ms_10_21_Timer0 (RunnableEntityMapping): PositionInTask=21, ActivationOffset=0, RteCyclicTriggerImplementation=Auto, RTEEventRef=TMT_StOpCtrl_Per1, MappedToTaskRef=Task_2ms_10
      StaMd_Ap_StaMd_ECU_Composition: SoftwareComponentInstanceRef=StaMd, ImplementationRef=Ap_StaMd_Implementation
        Task_Init_10_3_Timer0 (RunnableEntityMapping): PositionInTask=3, ActivationOffset=0, RteCyclicTriggerImplementation=Auto, RTEEventRef=StaMd_Init1_InitEvent, MappedToTaskRef=Task_Init_10
        StaMds_MilestoneRqst_WARMINIT_ExclArea (ExclusiveAreaImplementation): ExclusiveAreaImplMechanism=INTERRUPT_BLOCKING, ExclusiveAreaRef=StaMds_MilestoneRqst_WARMINIT_ExclArea
        Task_2ms_10_28_Timer0 (RunnableEntityMapping): PositionInTask=28, ActivationOffset=0, RteCyclicTriggerImplementation=Auto, RTEEventRef=TMT_StaMd_Per1, MappedToTaskRef=Task_2ms_10
        Task_Trns_10_7_TrigModeSwitch0 (RunnableEntityMapping): PositionInTask=7, ActivationOffset=0, RteCyclicTriggerImplementation=Auto, RTEEventRef=MST_StaMd_Trns1_0, MappedToTaskRef=Task_Trns_10
      StaMd11_Ap_StaMd11_ECU_Composition: SoftwareComponentInstanceRef=StaMd11, ImplementationRef=Ap_StaMd11_Implementation
        Task_2ms_11_8_Timer0 (RunnableEntityMapping): PositionInTask=8, ActivationOffset=0, RteCyclicTriggerImplementation=Auto, RTEEventRef=TMT_StaMd11_Per1, MappedToTaskRef=Task_2ms_11
        StaMds11_MilestoneRqst_WARMINIT_ExclArea (ExclusiveAreaImplementation): ExclusiveAreaImplMechanism=INTERRUPT_BLOCKING, ExclusiveAreaRef=StaMds11_MilestoneRqst_WARMINIT_ExclArea
      StaMd6_Ap_StaMd6_ECU_Composition: SoftwareComponentInstanceRef=StaMd6, ImplementationRef=Ap_StaMd6_Implementation
        Task_SchM_Trns_6_0_Timer0 (RunnableEntityMapping): PositionInTask=0, ActivationOffset=0, RteCyclicTriggerImplementation=Auto, RTEEventRef=TMT_StaMd6_Trns_DemShutdown, MappedToTaskRef=Task_SchM_Trns_6
        StaMds6_MilestoneRqst_WARMINIT_ExclArea (ExclusiveAreaImplementation): ExclusiveAreaImplMechanism=INTERRUPT_BLOCKING, ExclusiveAreaRef=StaMds6_MilestoneRqst_WARMINIT_ExclArea
        Task_2ms_6_1_Timer0 (RunnableEntityMapping): PositionInTask=1, ActivationOffset=0, RteCyclicTriggerImplementation=Auto, RTEEventRef=TMT_StaMd6_Per1, MappedToTaskRef=Task_2ms_6
      StaMd9_Ap_StaMd9_ECU_Composition: SoftwareComponentInstanceRef=StaMd9, ImplementationRef=Ap_StaMd9_Implementation
        Task_2ms_9_20_Timer0 (RunnableEntityMapping): PositionInTask=20, ActivationOffset=0, RteCyclicTriggerImplementation=Auto, RTEEventRef=TMT_StaMd9_Per1, MappedToTaskRef=Task_2ms_9
        StaMds9_MilestoneRqst_WARMINIT_ExclArea (ExclusiveAreaImplementation): ExclusiveAreaImplMechanism=INTERRUPT_BLOCKING, ExclusiveAreaRef=StaMds9_MilestoneRqst_WARMINIT_ExclArea
      StabilityComp_Ap_StabilityComp_ECU_Composition: SoftwareComponentInstanceRef=StabilityComp, ImplementationRef=Ap_StabilityComp_Implementation
        Task_Init_10_16_Timer0 (RunnableEntityMapping): PositionInTask=16, ActivationOffset=0, RteCyclicTriggerImplementation=Auto, RTEEventRef=StabilityComp_Init1_InitEvent, MappedToTaskRef=Task_Init_10
        Task_2ms_10_9_Timer0 (RunnableEntityMapping): PositionInTask=9, ActivationOffset=0, RteCyclicTriggerImplementation=Auto, RTEEventRef=TMT_StabilityComp_Per1, MappedToTaskRef=Task_2ms_10
      StabilityComp2_Ap_StabilityComp2_ECU_Composition: SoftwareComponentInstanceRef=StabilityComp2, ImplementationRef=Ap_StabilityComp2_Implementation
        Task_Init_11b_1_Timer0 (RunnableEntityMapping): PositionInTask=1, ActivationOffset=0, RteCyclicTriggerImplementation=Auto, RTEEventRef=StabilityComp2_Init1_InitEvent, MappedToTaskRef=Task_Init_11b
        Task_2ms_11_6_Timer0 (RunnableEntityMapping): PositionInTask=6, ActivationOffset=0, RteCyclicTriggerImplementation=Auto, RTEEventRef=TMT_StabilityComp2_Per1, MappedToTaskRef=Task_2ms_11
      Sweep_Ap_Sweep_ECU_Composition: SoftwareComponentInstanceRef=Sweep, ImplementationRef=Ap_Sweep_Implementation
        Task_2ms_10_4_Timer0 (RunnableEntityMapping): PositionInTask=4, ActivationOffset=0, RteCyclicTriggerImplementation=Auto, RTEEventRef=TMT_Sweep_Per1, MappedToTaskRef=Task_2ms_10
        Task_Init_10_27_Timer0 (RunnableEntityMapping): PositionInTask=27, ActivationOffset=0, RteCyclicTriggerImplementation=Auto, RTEEventRef=Sweep_InitEvent, MappedToTaskRef=Task_Init_10
      Sweep2_Ap_Sweep2_ECU_Composition: SoftwareComponentInstanceRef=Sweep2, ImplementationRef=Ap_Sweep2_Implementation
        Task_2ms_10_25_Timer0 (RunnableEntityMapping): PositionInTask=25, ActivationOffset=0, RteCyclicTriggerImplementation=Auto, RTEEventRef=TMT_Sweep2_Per1, MappedToTaskRef=Task_2ms_10
      ThrmlDutyCycle_Ap_ThrmlDutyCycle_ECU_Composition: SoftwareComponentInstanceRef=ThrmlDutyCycle, ImplementationRef=Ap_ThrmlDutyCycle_Implementation
        3 x RunnableEntityMapping, all with ActivationOffset=0, RteCyclicTriggerImplementation=Auto:
          Task_Trns_9_10_TrigModeSwitch0: PositionInTask=10, RTEEventRef=MST_ThrmlDutyCycle_Trns1_0, MappedToTaskRef=Task_Trns_9
          Task_Init_9_3_Timer0: PositionInTask=3, RTEEventRef=ThrmlDutyCycle_Init1_InitEvent, MappedToTaskRef=Task_Init_9
          Task_100ms_9_3_Timer0: PositionInTask=3, RTEEventRef=TMT_ThrmlDutyCycle_Per1, MappedToTaskRef=Task_100ms_9
        MAP_Rte_NvmBlock_ThrmlDutyCycle_ThrmlDutyCycle_FltStVal (NVRamAllocation): SwNvRamMappingReference=ThrmlDutyCycle.ThrmlDutyCycle_FltStVar, NvmBlockRef=Rte_NvmBlock_ThrmlDutyCycle_ThrmlDutyCycle_FltStVal
      TmprlMon_Sa_TmprlMon_ECU_Composition: SoftwareComponentInstanceRef=TmprlMon, ImplementationRef=Sa_TmprlMon_Implementation
        5 x RunnableEntityMapping, all with ActivationOffset=0, RteCyclicTriggerImplementation=Auto:
          Task_Trns_9_5_TrigModeSwitch0: PositionInTask=5, RTEEventRef=MST_TmprlMon_Trns2_0, MappedToTaskRef=Task_Trns_9
          Task_Trns_9_3_TrigModeSwitch0: PositionInTask=3, RTEEventRef=MST_TmprlMon_Trns1_0, MappedToTaskRef=Task_Trns_9
          Task_10ms_9_6_Timer0: PositionInTask=6, RTEEventRef=TMT_TmprlMon_Per3, MappedToTaskRef=Task_10ms_9
          Task_2ms_9_21_Timer0: PositionInTask=21, RTEEventRef=TMT_TmprlMon_Per2, MappedToTaskRef=Task_2ms_9
          Task_2ms_9_1_Timer0: PositionInTask=1, RTEEventRef=TMT_TmprlMon_Per1, MappedToTaskRef=Task_2ms_9
      TmprlMon2_Sa_TmprlMon2_ECU_Composition: SoftwareComponentInstanceRef=TmprlMon2, ImplementationRef=Sa_TmprlMon2_Implementation
        Task_2ms_10_38_Timer0 (RunnableEntityMapping): PositionInTask=38, ActivationOffset=0, RteCyclicTriggerImplementation=Auto, RTEEventRef=TMT_TmprlMon2_Per1, MappedToTaskRef=Task_2ms_10
      TqRsDg_Ap_TqRsDg_ECU_Composition: SoftwareComponentInstanceRef=TqRsDg, ImplementationRef=Ap_TqRsDg_Implementation
        Task_Init_10_14_Timer0 (RunnableEntityMapping): PositionInTask=14, ActivationOffset=0, RteCyclicTriggerImplementation=Auto, RTEEventRef=TqRsDg_Init1_InitEvent, MappedToTaskRef=Task_Init_10
        Task_2ms_10_30_Timer0 (RunnableEntityMapping): PositionInTask=30, ActivationOffset=0, RteCyclicTriggerImplementation=Auto, RTEEventRef=TMT_TqRsDg_Per1, MappedToTaskRef=Task_2ms_10
      TranlDampg_Ap_TranlDampg_ECU_Composition: SoftwareComponentInstanceRef=TranlDampg, ImplementationRef=Ap_TranlDampg_Implementation
        Task_2ms_10_26_Timer0 (RunnableEntityMapping): PositionInTask=26, ActivationOffset=0, RteCyclicTriggerImplementation=Auto, RTEEventRef=TMT_Ap_TranlDampg_Per1, MappedToTaskRef=Task_2ms_10
        Task_Init_10_31_Timer0 (RunnableEntityMapping): PositionInTask=31, ActivationOffset=0, RteCyclicTriggerImplementation=Auto, RTEEventRef=Ap_TranlDampg_InitEvent, MappedToTaskRef=Task_Init_10
      TrqCanc_Ap_TrqCanc_ECU_Composition: SoftwareComponentInstanceRef=TrqCanc, ImplementationRef=Ap_TrqCanc_Implementation
        Task_Init_10_10_Timer0 (RunnableEntityMapping): PositionInTask=10, ActivationOffset=0, RteCyclicTriggerImplementation=Auto, RTEEventRef=TrqCanc_InitEvent, MappedToTaskRef=Task_Init_10
        Task_2ms_10_34_Timer0 (RunnableEntityMapping): PositionInTask=34, ActivationOffset=0, RteCyclicTriggerImplementation=Auto, RTEEventRef=TMT_TrqCanc_Per1, MappedToTaskRef=Task_2ms_10
        MAP_Rte_NvmBlock_TrqCanc_CogTrqRplComp (NVRamAllocation): SwNvRamMappingReference=TrqCanc.CogTrqRplCompBlk, NvmBlockRef=Rte_NvmBlock_TrqCanc_CogTrqRplComp
        MAP_Rte_NvmBlock_TrqCanc_CogTrqCal (NVRamAllocation): SwNvRamMappingReference=TrqCanc.CogTrqCalBlk, NvmBlockRef=Rte_NvmBlock_TrqCanc_CogTrqCal
      TrqCmdScl_Ap_TrqCmdScl_ECU_Composition: SoftwareComponentInstanceRef=TrqCmdScl, ImplementationRef=Ap_TrqCmdScl_Implementation
        Task_2ms_10_31_Timer0 (RunnableEntityMapping): PositionInTask=31, ActivationOffset=0, RteCyclicTriggerImplementation=Auto, RTEEventRef=TMT_TrqCmdScl_Per1, MappedToTaskRef=Task_2ms_10
        MAP_Rte_NvmBlock_TrqCmdScl_TorqueCmdSF_Uls_f32 (NVRamAllocation): SwNvRamMappingReference=TrqCmdScl.TorqueCmdSF_EOLData, NvmBlockRef=Rte_NvmBlock_TrqCmdScl_TorqueCmdSF_Uls_f32
      TrqLOA_Ap_TrqLOA_ECU_Composition: SoftwareComponentInstanceRef=TrqLOA, ImplementationRef=Ap_TrqLOA_Implementation
        Task_Init_9_12_Timer0 (RunnableEntityMapping): PositionInTask=12, ActivationOffset=0, RteCyclicTriggerImplementation=Auto, RTEEventRef=TrqLOA_Init1_InitEvent, MappedToTaskRef=Task_Init_9
        Task_2ms_9_23_Timer0 (RunnableEntityMapping): PositionInTask=23, ActivationOffset=0, RteCyclicTriggerImplementation=Auto, RTEEventRef=TMT_TrqLOA_Per1, MappedToTaskRef=Task_2ms_9
      TuningSelAuth_Ap_TuningSelAuth_ECU_Composition: SoftwareComponentInstanceRef=TuningSelAuth, ImplementationRef=Ap_TuningSelAuth_Implementation
        Task_Init_11a_1_Timer0 (RunnableEntityMapping): PositionInTask=1, ActivationOffset=0, RteCyclicTriggerImplementation=Auto, RTEEventRef=TuningSelAuth_Init1_InitEvent, MappedToTaskRef=Task_Init_11a
        Task_10ms_11_2_Timer0 (RunnableEntityMapping): PositionInTask=2, ActivationOffset=0, RteCyclicTriggerImplementation=Auto, RTEEventRef=TMT_TuningSelAuth_Per1, MappedToTaskRef=Task_10ms_11
      VehDyn_Ap_VehDyn_ECU_Composition: SoftwareComponentInstanceRef=VehDyn, ImplementationRef=Ap_VehDyn_Implementation
        3 x RunnableEntityMapping, all with ActivationOffset=0, RteCyclicTriggerImplementation=Auto:
          Task_Trns_9_11_TrigModeSwitch0: PositionInTask=11, RTEEventRef=MST_VehDyn_Trns1_0, MappedToTaskRef=Task_Trns_9
          Task_2ms_9_13_Timer0: PositionInTask=13, RTEEventRef=TMT_VehDyn_Per1, MappedToTaskRef=Task_2ms_9
          Task_Init_9_10_Timer0: PositionInTask=10, RTEEventRef=VehDyn_Init1_InitEvent, MappedToTaskRef=Task_Init_9
        MAP_Rte_NvmBlock_VehDyn_MotPosReset (NVRamAllocation): SwNvRamMappingReference=VehDyn.VehDynReset, NvmBlockRef=Rte_NvmBlock_VehDyn_MotPosReset
      VehPwrMd_Ap_VehPwrMd_ECU_Composition: SoftwareComponentInstanceRef=VehPwrMd, ImplementationRef=Ap_VehPwrMd_Implementation
        Task_Init_9_2_Timer0 (RunnableEntityMapping): PositionInTask=2, ActivationOffset=0, RteCyclicTriggerImplementation=Auto, RTEEventRef=VehPwrMd_Init1_InitEvent, MappedToTaskRef=Task_Init_9
        Task_2ms_9_19_Timer0 (RunnableEntityMapping): PositionInTask=19, ActivationOffset=0, RteCyclicTriggerImplementation=Auto, RTEEventRef=TMT_VehPwrMd_Per1, MappedToTaskRef=Task_2ms_9
      VehSpdLmt_Ap_VehSpdLmt_ECU_Composition: SoftwareComponentInstanceRef=VehSpdLmt, ImplementationRef=Ap_VehSpdLmt_Implementation
        Task_2ms_9_5_Timer0 (RunnableEntityMapping): PositionInTask=5, ActivationOffset=0, RteCyclicTriggerImplementation=Auto, RTEEventRef=TMT_VehSpdLmt_Per1, MappedToTaskRef=Task_2ms_9
      WdgM_WdgM_ECU_Composition: ServiceComponentPrototypeRef=WdgM, ImplementationRef=WdgM_Implementation
        Task_SchM_10ms_6_0_Timer0 (RunnableEntityMapping): PositionInTask=0, ActivationOffset=0, RteCyclicTriggerImplementation=Auto, RTEEventRef=TMT_MainFunction, MappedToTaskRef=Task_SchM_10ms_6
      ePWM2_Ap_ePWM2_ECU_Composition: SoftwareComponentInstanceRef=ePWM2, ImplementationRef=Ap_ePWM2_Implementation
        3 x RunnableEntityMapping, all with ActivationOffset=0, RteCyclicTriggerImplementation=Auto:
          Task_Trns_9_8_TrigModeSwitch0: PositionInTask=8, RTEEventRef=MST_ePWM2_Trns1_0, MappedToTaskRef=Task_Trns_9
          Task_2ms_9_16_Timer0: PositionInTask=16, RTEEventRef=TMT_ePWM2_Per1, MappedToTaskRef=Task_2ms_9
          Task_Trns_9_1_TrigModeSwitch0: PositionInTask=1, RTEEventRef=MST_ePWM2_Trns2_0, MappedToTaskRef=Task_Trns_9
      uDiag_Cd_uDiag_ECU_Composition: SoftwareComponentInstanceRef=uDiag, ImplementationRef=Cd_uDiag_Implementation
        7 x RunnableEntityMapping, all with ActivationOffset=0, RteCyclicTriggerImplementation=Auto:
          Task_10ms_10b_19_Timer0: PositionInTask=19, RTEEventRef=TMT_uDiagECC_Per, MappedToTaskRef=Task_10ms_10b
          Task_100ms_10_6_Timer0: PositionInTask=6, RTEEventRef=TMT_uDiagStaticRegs_Per, MappedToTaskRef=Task_100ms_10
          Task_Init_10_5_Timer0: PositionInTask=5, RTEEventRef=uDiagResetHandler_InitEvent, MappedToTaskRef=Task_Init_10
          Task_4ms_10_1_Timer0: PositionInTask=1, RTEEventRef=TMT_uDiagLossOfExec_Per3, MappedToTaskRef=Task_4ms_10
          Task_Init_10_6_Timer0: PositionInTask=6, RTEEventRef=uDiagPeriphStartup_InitEvent, MappedToTaskRef=Task_Init_10
          Task_10ms_10b_20_Timer0: PositionInTask=20, RTEEventRef=TMT_uDiagVIM_Per, MappedToTaskRef=Task_10ms_10b
          Task_2ms_10_41_Timer0: PositionInTask=41, RTEEventRef=TMT_uDiagLossOfExec_Per2, MappedToTaskRef=Task_2ms_10
    84 x ComponentTypeCalibration, all with CalibrationSupportEnabled=false:
      Ap_AbsHwPos: ComponentTypeRef=Ap_AbsHwPos
      Ap_ActivePull: ComponentTypeRef=Ap_ActivePull
      Ap_ApXcp: ComponentTypeRef=Ap_ApXcp
      Ap_CtrlPolarityBrshlss: ComponentTypeRef=Ap_CtrlPolarityBrshlss
      Ap_Assist: ComponentTypeRef=Ap_Assist
      Ap_AssistFirewall: ComponentTypeRef=Ap_AssistFirewall
      Ap_AstLmt: ComponentTypeRef=Ap_AstLmt
      Ap_AvgFricLrn: ComponentTypeRef=Ap_AvgFricLrn
      Ap_BVDiag: ComponentTypeRef=Ap_BVDiag
      Ap_BatteryVoltage: ComponentTypeRef=Ap_BatteryVoltage
      Ap_ChkPtAp10: ComponentTypeRef=Ap_ChkPtAp10
      Ap_ChkPtAp11: ComponentTypeRef=Ap_ChkPtAp11
      Ap_ChkPtAp6: ComponentTypeRef=Ap_ChkPtAp6
      Ap_ChkPtAp9: ComponentTypeRef=Ap_ChkPtAp9
      Ap_ComplErr: ComponentTypeRef=Ap_ComplErr
      Ap_CurrCmd: ComponentTypeRef=Ap_CurrCmd
      Ap_CurrParamComp: ComponentTypeRef=Ap_CurrParamComp
      Ap_CustBattDiag: ComponentTypeRef=Ap_CustBattDiag
      Ap_Damping: ComponentTypeRef=Ap_Damping
      Ap_DampingFirewall: ComponentTypeRef=Ap_DampingFirewall
      Ap_DemIf: ComponentTypeRef=Ap_DemIf
      Ap_DiagMgr10: ComponentTypeRef=Ap_DiagMgr10
      Ap_DiagMgr11: ComponentTypeRef=Ap_DiagMgr11
      Ap_DiagMgr6: ComponentTypeRef=Ap_DiagMgr6
      Ap_DiagMgr9: ComponentTypeRef=Ap_DiagMgr9
      Ap_DiagSvc: ComponentTypeRef=Ap_DiagSvc
      Ap_DigPhsReasDiag: ComponentTypeRef=Ap_DigPhsReasDiag
      Ap_EOTActuatorMng: ComponentTypeRef=Ap_EOTActuatorMng
      Ap_ElePwr: ComponentTypeRef=Ap_ElePwr
      Ap_EtDmpFw: ComponentTypeRef=Ap_EtDmpFw
      Ap_FaultLog: ComponentTypeRef=Ap_FaultLog
      Ap_FltInjection: ComponentTypeRef=Ap_FltInjection
      Ap_FrqDepDmpnInrtCmp: ComponentTypeRef=Ap_FrqDepDmpnInrtCmp
      Ap_HOWDetect: ComponentTypeRef=Ap_HOWDetect
      Ap_HiLoadStall: ComponentTypeRef=Ap_HiLoadStall
      Ap_HighFreqAssist: ComponentTypeRef=Ap_HighFreqAssist
      Ap_HwPwUp: ComponentTypeRef=Ap_HwPwUp
      Ap_HystComp: ComponentTypeRef=Ap_HystComp
      IoHwAb10: ComponentTypeRef=IoHwAb10
      IoHwAb9: ComponentTypeRef=IoHwAb9
      Ap_LmtCod: ComponentTypeRef=Ap_LmtCod
      Ap_LoaMgr: ComponentTypeRef=Ap_LoaMgr
      Ap_LrnEOT: ComponentTypeRef=Ap_LrnEOT
      Ap_MtrTempEst: ComponentTypeRef=Ap_MtrTempEst
      NtWrap: ComponentTypeRef=NtWrap
      Ap_PICurrCntrl: ComponentTypeRef=Ap_PICurrCntrl
      Ap_PSADMQ: ComponentTypeRef=Ap_PSADMQ
      Ap_PSADSG: ComponentTypeRef=Ap_PSADSG
      Ap_PSASH: ComponentTypeRef=Ap_PSASH
      Ap_PSATA: ComponentTypeRef=Ap_PSATA
      Ap_PeakCurrEst: ComponentTypeRef=Ap_PeakCurrEst
      Ap_PosServo: ComponentTypeRef=Ap_PosServo
      Ap_PsaAgArbn: ComponentTypeRef=Ap_PsaAgArbn
      Ap_PwrLmtFuncCr: ComponentTypeRef=Ap_PwrLmtFuncCr
      Ap_QuadDet: ComponentTypeRef=Ap_QuadDet
      Ap_Return: ComponentTypeRef=Ap_Return
      Ap_ReturnFirewall: ComponentTypeRef=Ap_ReturnFirewall
      RteErrata10: ComponentTypeRef=RteErrata10
      RteErrata11: ComponentTypeRef=RteErrata11
      RteErrata6: ComponentTypeRef=RteErrata6
      RteErrata9: ComponentTypeRef=RteErrata9
      Ap_SignlCondn: ComponentTypeRef=Ap_SignlCondn
      Ap_SrlComInput: ComponentTypeRef=Ap_SrlComInput
      Ap_SrlComOutput: ComponentTypeRef=Ap_SrlComOutput
      Ap_StOpCtrl: ComponentTypeRef=Ap_StOpCtrl
      Ap_StaMd: ComponentTypeRef=Ap_StaMd
      Ap_StaMd11: ComponentTypeRef=Ap_StaMd11
      Ap_StaMd6: ComponentTypeRef=Ap_StaMd6
      Ap_StaMd9: ComponentTypeRef=Ap_StaMd9
      Ap_StabilityComp: ComponentTypeRef=Ap_StabilityComp
      Ap_StabilityComp2: ComponentTypeRef=Ap_StabilityComp2
      Ap_Sweep: ComponentTypeRef=Ap_Sweep
      Ap_Sweep2: ComponentTypeRef=Ap_Sweep2
      Ap_ThrmlDutyCycle: ComponentTypeRef=Ap_ThrmlDutyCycle
      Ap_TqRsDg: ComponentTypeRef=Ap_TqRsDg
      Ap_TranlDampg: ComponentTypeRef=Ap_TranlDampg
      Ap_TrqCanc: ComponentTypeRef=Ap_TrqCanc
      Ap_TrqCmdScl: ComponentTypeRef=Ap_TrqCmdScl
      Ap_TrqLOA: ComponentTypeRef=Ap_TrqLOA
      Ap_TuningSelAuth: ComponentTypeRef=Ap_TuningSelAuth
      Ap_VehDyn: ComponentTypeRef=Ap_VehDyn
      Ap_VehPwrMd: ComponentTypeRef=Ap_VehPwrMd
      Ap_VehSpdLmt: ComponentTypeRef=Ap_VehSpdLmt
      Ap_ePWM2: ComponentTypeRef=Ap_ePWM2
  module config ShtdnMech: implementation-config-variant=VARIANT-PRE-COMPILE  # Configuration of the Nexteer ShtdnMech module.
    ShtdnMechGeneral
    CommonPublishedInformation: ArMajorVersion=3, ArMinorVersion=2, ArPatchVersion=0, SwMajorVersion=0, SwMinorVersion=0, SwPatchVersion=0, ModuleId=0, VendorId=0
  module config SignlCondn: implementation-config-variant=VARIANT-PRE-COMPILE  # Configuration of the Nexteer SignlCondn module.
    SignlCondnGeneral
    CommonPublishedInformation: ArMajorVersion=3, ArMinorVersion=2, ArPatchVersion=0, SwMajorVersion=0, SwMinorVersion=0, SwPatchVersion=0, ModuleId=0, VendorId=0
  module config StabilityComp: implementation-config-variant=VARIANT-PRE-COMPILE  # Configuration of the Nexteer StabilityComp module.
    StabilityCompGeneral
    CommonPublishedInformation: ArMajorVersion=3, ArMinorVersion=2, ArPatchVersion=0, SwMajorVersion=0, SwMinorVersion=0, SwPatchVersion=0, ModuleId=0, VendorId=0
  module config StabilityComp2: implementation-config-variant=VARIANT-PRE-COMPILE  # Configuration of the Nexteer StabilityComp2 module.
    StabilityComp2General
    CommonPublishedInformation: ArMajorVersion=3, ArMinorVersion=2, ArPatchVersion=0, SwMajorVersion=0, SwMinorVersion=0, SwPatchVersion=0, ModuleId=0, VendorId=0
  module config StaMd: implementation-config-variant=VARIANT-PRE-COMPILE  # Configuration of the Nexteer States and Modes module.
    StaMdGeneral:
      TypeHDataSize = 100
      StaMdTODType = TOD_SteadyState
      StaMdNvMWriteAllAPI = NvMProxy_WriteAll
      StaMdNvMGetErrorStatusAPI = NvMProxy_GetErrorStatus
      StaMdTrnsDiagMgrShtDwnTaskActivation = Task_SchM_Trns_6
      GenerateExcludeOsAppRef = Ap_0
      StaMdCoreOsAppRef = Ap_10
      StaMdSComOsAppRef = Ap_6
      StaMdSysCovOsAppRef = Ap_11
    CommonPublishedInformation: ArMajorVersion=3, ArMinorVersion=2, ArPatchVersion=0, SwMajorVersion=0, SwMinorVersion=0, SwPatchVersion=0, ModuleId=0, VendorId=0
  module config StOpCtrl: implementation-config-variant=VARIANT-PRE-COMPILE  # Configuration of the Nexteer StOpCtrl module.
    StOpCtrlGeneral
    CommonPublishedInformation: ArMajorVersion=3, ArMinorVersion=2, ArPatchVersion=0, SwMajorVersion=0, SwMinorVersion=0, SwPatchVersion=0, ModuleId=0, VendorId=0
  module config ThrmlDutyCycle: implementation-config-variant=VARIANT-PRE-COMPILE  # Configuration of the Nexteer ThrmlDutyCycle module.
    ThrmlDutyCycleGeneral
    CommonPublishedInformation: ArMajorVersion=3, ArMinorVersion=2, ArPatchVersion=0, SwMajorVersion=0, SwMinorVersion=0, SwPatchVersion=0, ModuleId=0, VendorId=0
  module config TmprlMon: implementation-config-variant=VARIANT-PRE-COMPILE  # Configuration of the Nexteer TmprlMon module.
    TmprlMonGeneral
    CommonPublishedInformation: ArMajorVersion=3, ArMinorVersion=2, ArPatchVersion=0, SwMajorVersion=0, SwMinorVersion=0, SwPatchVersion=0, ModuleId=0, VendorId=0
  module config TmprlMon2: implementation-config-variant=VARIANT-PRE-COMPILE  # Configuration of the Nexteer TmprlMon2 module.
    TmprlMon2General
    CommonPublishedInformation: ArMajorVersion=3, ArMinorVersion=2, ArPatchVersion=0, SwMajorVersion=0, SwMinorVersion=0, SwPatchVersion=0, ModuleId=0, VendorId=0
  module config TqRsDg: implementation-config-variant=VARIANT-PRE-COMPILE  # Configuration of the Nexteer TqRsDg module.
    TqRsDgGeneral
    CommonPublishedInformation: ArMajorVersion=3, ArMinorVersion=2, ArPatchVersion=0, SwMajorVersion=0, SwMinorVersion=0, SwPatchVersion=0, ModuleId=0, VendorId=0
  module config TrqCanc: implementation-config-variant=VARIANT-PRE-COMPILE  # Configuration of the Nexteer TrqCanc module.
    TrqCancGeneral
    CommonPublishedInformation: ArMajorVersion=3, ArMinorVersion=2, ArPatchVersion=0, SwMajorVersion=0, SwMinorVersion=0, SwPatchVersion=0, ModuleId=0, VendorId=0
  module config TrqCmdScl: implementation-config-variant=VARIANT-PRE-COMPILE  # Configuration of the Nexteer TrqCmdScl module.
    TrqCmdSclGeneral
    CommonPublishedInformation: ArMajorVersion=3, ArMinorVersion=2, ArPatchVersion=0, SwMajorVersion=0, SwMinorVersion=0, SwPatchVersion=0, ModuleId=0, VendorId=0
  module config TuningSelAuth: implementation-config-variant=VARIANT-PRE-COMPILE  # Configuration of the Nexteer TuningSelAuth module.
    TuningSelAuthGeneral
    CommonPublishedInformation: ArMajorVersion=3, ArMinorVersion=2, ArPatchVersion=0, SwMajorVersion=0, SwMinorVersion=0, SwPatchVersion=0, ModuleId=0, VendorId=0
  module config uDiag: implementation-config-variant=VARIANT-PRE-COMPILE  # Configuration of the Microprocessor diagnostics module
    RuntimeRegCheck (uDiagRegChkConfigSet)
      GHVSRC (uDiagRegCheck): uDiagRegAddress=4294967112, uDiagRegValue=16842753
      FBPARERR (uDiagRegCheckLnk): uDiagRegAddress=4294966776, uDiagRegValueLnk=VIM_Fallback, uDiagRegUseSizeofInOffset=false, uDiagRegValueLnkOffset=0
      205 x uDiagRegCheck:
        RCLKSRC: uDiagRegAddress=4294967120, uDiagRegValue=9
        BMMCR1: uDiagRegAddress=4294967236, uDiagRegValue=10
        CLKCNTL: uDiagRegAddress=4294967248, uDiagRegValue=16843008
        LOGICPDPWRCTRL0: uDiagRegAddress=4294901760, uDiagRegValue=84216325
        MEMPDPWRCTRL0: uDiagRegAddress=4294901776, uDiagRegValue=84541440
        PDCLKDISREG: uDiagRegAddress=4294901792, uDiagRegValue=4
        GLOBALCTRL1: uDiagRegAddress=4294901920, uDiagRegValue=0
        PINMMR00: uDiagRegAddress=4294961936, uDiagRegValue=33685504
        PINMMR01: uDiagRegAddress=4294961940, uDiagRegValue=16843776
        PINMMR02: uDiagRegAddress=4294961944, uDiagRegValue=67174657
        PINMMR03: uDiagRegAddress=4294961948, uDiagRegValue=17039361
        PINMMR04: uDiagRegAddress=4294961952, uDiagRegValue=269484292
        PINMMR05: uDiagRegAddress=4294961956, uDiagRegValue=17302532
        PINMMR06: uDiagRegAddress=4294961960, uDiagRegValue=16843024
        PINMMR07: uDiagRegAddress=4294961964, uDiagRegValue=16843009
        PINMMR08: uDiagRegAddress=4294961968, uDiagRegValue=16843009
        PINMMR09: uDiagRegAddress=4294961972, uDiagRegValue=16843009
        PINMMR10: uDiagRegAddress=4294961976, uDiagRegValue=16843009
        PINMMR11: uDiagRegAddress=4294961980, uDiagRegValue=16843009
        PINMMR12: uDiagRegAddress=4294961984, uDiagRegValue=16843009
        PINMMR13: uDiagRegAddress=4294961988, uDiagRegValue=16843009
        PINMMR14: uDiagRegAddress=4294961992, uDiagRegValue=16843009
        PINMMR15: uDiagRegAddress=4294961996, uDiagRegValue=16843009
        PINMMR16: uDiagRegAddress=4294962000, uDiagRegValue=16843009
        PINMMR17: uDiagRegAddress=4294962004, uDiagRegValue=16843009
        PINMMR18: uDiagRegAddress=4294962008, uDiagRegValue=65537
        PINMMR19: uDiagRegAddress=4294962012, uDiagRegValue=16843009
        PINMMR20: uDiagRegAddress=4294962016, uDiagRegValue=16843009
        PINMMR21: uDiagRegAddress=4294962020, uDiagRegValue=16842753
        PINMMR22: uDiagRegAddress=4294962024, uDiagRegValue=16843009
        PINMMR23: uDiagRegAddress=4294962028, uDiagRegValue=1
        PINMMR24: uDiagRegAddress=4294962032, uDiagRegValue=0
        PINMMR25: uDiagRegAddress=4294962036, uDiagRegValue=0
        PINMMR26: uDiagRegAddress=4294962040, uDiagRegValue=16842752
        PINMMR27: uDiagRegAddress=4294962044, uDiagRegValue=16843009
        PINMMR28: uDiagRegAddress=4294962048, uDiagRegValue=16843009
        PINMMR29: uDiagRegAddress=4294962052, uDiagRegValue=257
        PINMMR30: uDiagRegAddress=4294962056, uDiagRegValue=514
        FRDCNTL: uDiagRegAddress=4294471680, uDiagRegValue=785
        FEDACTRL1: uDiagRegAddress=4294471688, uDiagRegValue=656906
        RAMCTRL_EVEN: uDiagRegAddress=4294965248, uDiagRegValue=327690
        RAMTHRESHOLD_EVEN: uDiagRegAddress=4294965252, uDiagRegValue=1
        RAMINTCTRL_EVEN: uDiagRegAddress=4294965260, uDiagRegValue=1
        RAMTEST_EVEN: uDiagRegAddress=4294965296, uDiagRegValue=5
        RAMCTRL_ODD: uDiagRegAddress=4294965504, uDiagRegValue=327690
        RAMTHRESHOLD_ODD: uDiagRegAddress=4294965508, uDiagRegValue=1
        RAMINTCTRL_ODD: uDiagRegAddress=4294965516, uDiagRegValue=1
        RAMTEST_ODD: uDiagRegAddress=4294965552, uDiagRegValue=5
        PACT: uDiagRegAddress=4294960512, uDiagRegValue=0
        STCGCR1: uDiagRegAddress=4294960644, uDiagRegValue=5
        CCMKEYR: uDiagRegAddress=4294964740, uDiagRegValue=0
        PLLCTL1: uDiagRegAddress=4294967152, uDiagRegValue=352000
        PLLCTL2: uDiagRegAddress=4294967156, uDiagRegValue=29184
        PLLCTL3: uDiagRegAddress=4294959360, uDiagRegValue=1610964736
        DCCGCTRL_DCC1: uDiagRegAddress=4294962176, uDiagRegValue=10
        DCCCNT0SEED_DCC1: uDiagRegAddress=4294962184, uDiagRegValue=9333
        DCCVALID0SEED_DCC1: uDiagRegAddress=4294962188, uDiagRegValue=39666
        DCCCNT1SEED_DCC1: uDiagRegAddress=4294962192, uDiagRegValue=9800
        DCCCNT1CLKSRC_DCC1: uDiagRegAddress=4294962212, uDiagRegValue=40963
        DCCCNT0CLKSRC_DCC1: uDiagRegAddress=4294962216, uDiagRegValue=0
        DCCGCTRL_DCC2: uDiagRegAddress=4294964224, uDiagRegValue=10
        DCCCNT0SEED_DCC2: uDiagRegAddress=4294964232, uDiagRegValue=19417
        DCCVALID0SEED_DCC2: uDiagRegAddress=4294964236, uDiagRegValue=1201
        DCCCNT1SEED_DCC2: uDiagRegAddress=4294964240, uDiagRegValue=80000
        DCCCNT1CLKSRC_DCC2: uDiagRegAddress=4294964260, uDiagRegValue=40968
        DCCCNT0CLKSRC_DCC2: uDiagRegAddress=4294964264, uDiagRegValue=0
        ESMEEPAPR1: uDiagRegAddress=4294964480, uDiagRegValue=0
        ESMIESR1: uDiagRegAddress=4294964488, uDiagRegValue=1411910606
        ESMILSR1: uDiagRegAddress=4294964496, uDiagRegValue=2048
        ESMLTCPR: uDiagRegAddress=4294964532, uDiagRegValue=16383
        ESMIEPSR4: uDiagRegAddress=4294964544, uDiagRegValue=0
        ESMIESR4: uDiagRegAddress=4294964552, uDiagRegValue=1073741860
        ESMILSR4: uDiagRegAddress=4294964560, uDiagRegValue=0
        RTIGCTRL: uDiagRegAddress=4294966272, uDiagRegValue=3
        RTITBCTRL: uDiagRegAddress=4294966276, uDiagRegValue=0
        RTISETINTENA: uDiagRegAddress=4294966400, uDiagRegValue=1
        RTIDWDCTRL: uDiagRegAddress=4294966416, uDiagRegValue=2844088794
        RTIDWDPRLD: uDiagRegAddress=4294966420, uDiagRegValue=57
        RTIWWDRXNCTRL: uDiagRegAddress=4294966436, uDiagRegValue=5
        RTIWWDSIZECTRL: uDiagRegAddress=4294966440, uDiagRegValue=5
        CRC_CTRL1: uDiagRegAddress=4261412872, uDiagRegValue=0
        PARCTL: uDiagRegAddress=4294966768, uDiagRegValue=10
        FIRQPR0_FIQ_IRQ: uDiagRegAddress=4294966800, uDiagRegValue=3
        FIRQPR1_FIQ_IRQ: uDiagRegAddress=4294966804, uDiagRegValue=0
        FIRQPR2_FIQ_IRQ: uDiagRegAddress=4294966808, uDiagRegValue=0
        CHANCTRL0: uDiagRegAddress=4294966912, uDiagRegValue=75779
        CHANCTRL23: uDiagRegAddress=4294967004, uDiagRegValue=50529027
        ADOPMODECR_ADC1: uDiagRegAddress=4294426628, uDiagRegValue=2148794369
        ADCLOCKCR_ADC1: uDiagRegAddress=4294426632, uDiagRegValue=4
        ADCALCR_ADC1: uDiagRegAddress=4294426636, uDiagRegValue=0
        ADEVMODECR_ADC1: uDiagRegAddress=4294426640, uDiagRegValue=65585
        ADG1MODECR_ADC1: uDiagRegAddress=4294426644, uDiagRegValue=65584
        ADG2MODECR_ADC1: uDiagRegAddress=4294426648, uDiagRegValue=65592
        ADEVSRC_ADC1: uDiagRegAddress=4294426652, uDiagRegValue=0
        ADG1SRC_ADC1: uDiagRegAddress=4294426656, uDiagRegValue=0
        ADG2SRC_ADC1: uDiagRegAddress=4294426660, uDiagRegValue=1
        ADEVINTENA_ADC1: uDiagRegAddress=4294426664, uDiagRegValue=0
        ADG1INTENA_ADC1: uDiagRegAddress=4294426668, uDiagRegValue=0
        ADG2INTENA_ADC1: uDiagRegAddress=4294426672, uDiagRegValue=0
        ADBNDCR_ADC1: uDiagRegAddress=4294426712, uDiagRegValue=1966110
        ADBNDEND_ADC1: uDiagRegAddress=4294426716, uDiagRegValue=2
        ADEVSAMP_ADC1: uDiagRegAddress=4294426720, uDiagRegValue=6
        ADG1SAMP_ADC1: uDiagRegAddress=4294426724, uDiagRegValue=6
        ADG2SAMP_ADC1: uDiagRegAddress=4294426728, uDiagRegValue=6
        ADEVSEL_ADC1: uDiagRegAddress=4294426744, uDiagRegValue=0
        ADG1SEL_ADC1: uDiagRegAddress=4294426748, uDiagRegValue=0
        ADG2SEL_ADC1: uDiagRegAddress=4294426752, uDiagRegValue=8481
        ADPARCR_ADC1: uDiagRegAddress=4294427008, uDiagRegValue=10
        ADOPMODECR_ADC2: uDiagRegAddress=4294427140, uDiagRegValue=2148794369
        ADCLOCKCR_ADC2: uDiagRegAddress=4294427144, uDiagRegValue=4
        ADCALCR_ADC2: uDiagRegAddress=4294427148, uDiagRegValue=0
        ADEVMODECR_ADC2: uDiagRegAddress=4294427152, uDiagRegValue=65584
        ADG1MODECR_ADC2: uDiagRegAddress=4294427156, uDiagRegValue=65592
        ADG2MODECR_ADC2: uDiagRegAddress=4294427160, uDiagRegValue=65584
        ADEVSRC_ADC2: uDiagRegAddress=4294427164, uDiagRegValue=0
        ADG1SRC_ADC2: uDiagRegAddress=4294427168, uDiagRegValue=3
        ADG2SRC_ADC2: uDiagRegAddress=4294427172, uDiagRegValue=0
        ADEVINTENA_ADC2: uDiagRegAddress=4294427176, uDiagRegValue=0
        ADG1INTENA_ADC2: uDiagRegAddress=4294427180, uDiagRegValue=0
        ADG2INTENA_ADC2: uDiagRegAddress=4294427184, uDiagRegValue=0
        ADBNDCR_ADC2: uDiagRegAddress=4294427224, uDiagRegValue=2
        ADBNDEND_ADC2: uDiagRegAddress=4294427228, uDiagRegValue=2
        ADEVSAMP_ADC2: uDiagRegAddress=4294427232, uDiagRegValue=6
        ADG1SAMP_ADC2: uDiagRegAddress=4294427236, uDiagRegValue=6
        ADG2SAMP_ADC2: uDiagRegAddress=4294427240, uDiagRegValue=6
        ADEVSEL_ADC2: uDiagRegAddress=4294427256, uDiagRegValue=0
        ADG1SEL_ADC2: uDiagRegAddress=4294427260, uDiagRegValue=8451
        ADG2SEL_ADC2: uDiagRegAddress=4294427264, uDiagRegValue=0
        ADPARCR_ADC2: uDiagRegAddress=4294427520, uDiagRegValue=10
        HETGCR_HET1: uDiagRegAddress=4294424576, uDiagRegValue=393217
        HETPFR_HET1: uDiagRegAddress=4294424580, uDiagRegValue=1792
        HETEXC1_HET1: uDiagRegAddress=4294424604, uDiagRegValue=0
        HETPRY_HET1: uDiagRegAddress=4294424612, uDiagRegValue=0
        HETAND_HET1: uDiagRegAddress=4294424620, uDiagRegValue=0
        HETHRSH_HET1: uDiagRegAddress=4294424628, uDiagRegValue=0
        HETXOR_HET1: uDiagRegAddress=4294424632, uDiagRegValue=0
        HETREQENS_HET1: uDiagRegAddress=4294424636, uDiagRegValue=22
        HETREQDS_HET1: uDiagRegAddress=4294424644, uDiagRegValue=16
        HETPCR_HET1: uDiagRegAddress=4294424692, uDiagRegValue=10
        HETPPR_HET1: uDiagRegAddress=4294424700, uDiagRegValue=0
        HETLBPSEL_HET1: uDiagRegAddress=4294424716, uDiagRegValue=0
        HETLBPDIR_HET1: uDiagRegAddress=4294424720, uDiagRegValue=327680
        HETPINDIS_HET1: uDiagRegAddress=4294424724, uDiagRegValue=0
        HETGCR_HET2: uDiagRegAddress=4294424832, uDiagRegValue=196609
        HETPFR_HET2: uDiagRegAddress=4294424836, uDiagRegValue=1024
        HETEXC1_HET2: uDiagRegAddress=4294424860, uDiagRegValue=0
        HETPRY_HET2: uDiagRegAddress=4294424868, uDiagRegValue=0
        HETAND_HET2: uDiagRegAddress=4294424876, uDiagRegValue=0
        HETHRSH_HET2: uDiagRegAddress=4294424884, uDiagRegValue=0
        HETXOR_HET2: uDiagRegAddress=4294424888, uDiagRegValue=0
        HETREQENS_HET2: uDiagRegAddress=4294424892, uDiagRegValue=0
        HETREQDS_HET2: uDiagRegAddress=4294424900, uDiagRegValue=0
        HETDIR_HET2: uDiagRegAddress=4294424908, uDiagRegValue=0
        HETPCR_HET2: uDiagRegAddress=4294424948, uDiagRegValue=10
        HETPPR_HET2: uDiagRegAddress=4294424956, uDiagRegValue=0
        HETLBPSEL_HET2: uDiagRegAddress=4294424972, uDiagRegValue=0
        HETLBPDIR_HET2: uDiagRegAddress=4294424976, uDiagRegValue=327680
        HETPINDIS_HET2: uDiagRegAddress=4294424980, uDiagRegValue=0
        HTU__GC_HTU1: uDiagRegAddress=4294419456, uDiagRegValue=65792
        HTU__MP1S_HTU1: uDiagRegAddress=4294419532, uDiagRegValue=0
        HTU__MP1E_HTU1: uDiagRegAddress=4294419536, uDiagRegValue=0
        HTU__GC_HTU2: uDiagRegAddress=4294419712, uDiagRegValue=0
        HTU_IHADDRCT_HTU1: uDiagRegAddress=4283301896, uDiagRegValue=0
        HTU_ITCOUNT_HTU1: uDiagRegAddress=4283301900, uDiagRegValue=0
        GIOGCR0: uDiagRegAddress=4294425600, uDiagRegValue=1
        GIOINTDET: uDiagRegAddress=4294425608, uDiagRegValue=0
        GIOPOL: uDiagRegAddress=4294425612, uDiagRegValue=0
        GIODIR_A_: uDiagRegAddress=4294425652, uDiagRegValue=0
        GIODIR_B_: uDiagRegAddress=4294425684, uDiagRegValue=0
        DMA_DMAMPCTRL: uDiagRegAddress=4294963632, uDiagRegValue=252250377
        DMA_DMAMPR0S: uDiagRegAddress=4294963640, uDiagRegValue=4278845440
        DMA_DMAMPR0E: uDiagRegAddress=4294963644, uDiagRegValue=4282859519
        DMA_DMAMPR1S: uDiagRegAddress=4294963648, uDiagRegValue=4244081664
        DMA_DMAMPR1E: uDiagRegAddress=4294963652, uDiagRegValue=4261413375
        DMA_DMAMPR3S: uDiagRegAddress=4294963664, uDiagRegValue=2097152
        DMA_DMAMPR3E: uDiagRegAddress=4294963668, uDiagRegValue=4294967295
        DMA_CP00_IDADDR: uDiagRegAddress=4294443012, uDiagRegValue=4261412968
        DMA_CP00_ITCOUNT: uDiagRegAddress=4294443016, uDiagRegValue=65537
        DMA_CP00_CHCTRL: uDiagRegAddress=4294443024, uDiagRegValue=61440
        DMA_CP01_IDADDR: uDiagRegAddress=4294443044, uDiagRegValue=4261412960
        DMA_CP01_CHCTRL: uDiagRegAddress=4294443056, uDiagRegValue=61704
        DMA_CP02_ISADDR: uDiagRegAddress=4294443072, uDiagRegValue=4278977026
        DMA_CP02_ITCOUNT: uDiagRegAddress=4294443080, uDiagRegValue=65539
        DMA_CP02_CHCTRL: uDiagRegAddress=4294443088, uDiagRegValue=20767
        DMA_CP02_EIOFF: uDiagRegAddress=4294443092, uDiagRegValue=131076
        DMA_CP03_ISADDR: uDiagRegAddress=4294443104, uDiagRegValue=4281991170
        DMA_CP03_ITCOUNT: uDiagRegAddress=4294443112, uDiagRegValue=65540
        DMA_CP03_CHCTRL: uDiagRegAddress=4294443120, uDiagRegValue=20767
        DMA_CP03_EIOFF: uDiagRegAddress=4294443124, uDiagRegValue=131076
        DMA_CP05_IDADDR: uDiagRegAddress=4294443172, uDiagRegValue=4282777832
        DMA_CP05_ITCOUNT: uDiagRegAddress=4294443176, uDiagRegValue=65537
        DMA_CP05_CHCTRL: uDiagRegAddress=4294443184, uDiagRegValue=499969
        DMA_CP06_IDADDR: uDiagRegAddress=4294443204, uDiagRegValue=4244081680
        DMA_CP06_ITCOUNT: uDiagRegAddress=4294443208, uDiagRegValue=262146
        DMA_CP06_CHCTRL: uDiagRegAddress=4294443216, uDiagRegValue=20767
        DMA_CP06_EIOFF: uDiagRegAddress=4294443220, uDiagRegValue=393218
        DMA_CP06_FIOFF: uDiagRegAddress=4294443224, uDiagRegValue=16777220
        DMA_CP09_ISADDR: uDiagRegAddress=4294443296, uDiagRegValue=4282253554
        DMA_CP09_ITCOUNT: uDiagRegAddress=4294443304, uDiagRegValue=65540
        DMA_CP09_CHCTRL: uDiagRegAddress=4294443312, uDiagRegValue=20767
        DMA_CP09_EIOFF: uDiagRegAddress=4294443316, uDiagRegValue=131076
        DMA_CP12_ISADDR: uDiagRegAddress=4294443392, uDiagRegValue=4278845954
        DMA_CP12_ITCOUNT: uDiagRegAddress=4294443400, uDiagRegValue=65539
        DMA_CP12_CHCTRL: uDiagRegAddress=4294443408, uDiagRegValue=20767
        DMA_CP12_EIOFF: uDiagRegAddress=4294443412, uDiagRegValue=131076
      12 x uDiagRegCheckLnk:
        DMA_CP02_IDADDR: uDiagRegAddress=4294443076, uDiagRegValueLnk=DMAData_G_str.FastSPI_Cnt_u16[0], uDiagRegUseSizeofInOffset=false, uDiagRegValueLnkOffset=0
        DMA_CP03_IDADDR: uDiagRegAddress=4294443108, uDiagRegValueLnk=DMAData_G_str.FastADC_Cnt_u16[0], uDiagRegUseSizeofInOffset=false, uDiagRegValueLnkOffset=0
        DMA_CP05_ISADDR: uDiagRegAddress=4294443168, uDiagRegValueLnk=DMAData_G_str.PWMPeriod_Cnt_u32, uDiagRegUseSizeofInOffset=false, uDiagRegValueLnkOffset=0
        DMA_CP06_ISADDR: uDiagRegAddress=4294443200, uDiagRegValueLnk=DMAData_G_str.PWMCmp_Cnt_u16[0][0], uDiagRegUseSizeofInOffset=false, uDiagRegValueLnkOffset=0
        DMA_CP09_IDADDR: uDiagRegAddress=4294443300, uDiagRegValueLnk=DMAData_G_str.SlowADC_Cnt_u16[0], uDiagRegUseSizeofInOffset=false, uDiagRegValueLnkOffset=0
        DMA_CP12_IDADDR: uDiagRegAddress=4294443396, uDiagRegValueLnk=DMAData_G_str.SlowSPI_Cnt_u16[0], uDiagRegUseSizeofInOffset=false, uDiagRegValueLnkOffset=0
        DMA_DMAMPR2S: uDiagRegAddress=4294963656, uDiagRegValueLnk=DMAData_G_str, uDiagRegUseSizeofInOffset=false, uDiagRegValueLnkOffset=0
        DMA_DMAMPR2E: uDiagRegAddress=4294963660, uDiagRegValueLnk=DMAData_G_str, uDiagRegUseSizeofInOffset=true, uDiagRegValueLnkOffset=-1
        HTU__MP0S_HTU1: uDiagRegAddress=4294419572, uDiagRegValueLnk=Nhet1CfgAndUse_HtuDataTrq_Cnt_G_str, uDiagRegUseSizeofInOffset=false, uDiagRegValueLnkOffset=0
        HTU__MP0E_HTU1: uDiagRegAddress=4294419576, uDiagRegValueLnk=Nhet1CfgAndUse_HtuDataTrq_Cnt_G_str, uDiagRegUseSizeofInOffset=false, uDiagRegValueLnkOffset=60
        HTU_IFADDRA_HTU1: uDiagRegAddress=4283301904, uDiagRegValueLnk=Nhet1CfgAndUse_HtuDataTrq_Cnt_G_str.HtuDataTrq1_Cnt_u32[0], uDiagRegUseSizeofInOffset=false, uDiagRegValueLnkOffset=0
        HTU_IFADDRB_HTU1: uDiagRegAddress=4283301920, uDiagRegValueLnk=Nhet1CfgAndUse_HtuDataTrq_Cnt_G_str.HtuDataTrq2_Cnt_u32[0], uDiagRegUseSizeofInOffset=false, uDiagRegValueLnkOffset=0
    CommonPublishedInformation: ArMajorVersion=1, ArMinorVersion=2, ArPatchVersion=0, SwMajorVersion=1, SwMinorVersion=0, SwPatchVersion=0, ModuleId=104, VendorId=0
    uDiagGeneral:
      uDiagVCLK_kHz = 80000
      uDiagEnableFPUDiag = STD_OFF
      uDiagGladiatorCompatible = STD_OFF
      uDiagVIMPerTrusted = STD_OFF
      uDiagECCPerTrusted = STD_OFF
      uDiagVimTableName = osaIRQTable
      WdgMVersion = TTTech_v2.0.3
      uDiagIncludes = Nhet.h
      uDiagIncludes = Usr_RegCkDefs.h
      uDiagIncludes = Dma.h
  module config VehSpdLmt: implementation-config-variant=VARIANT-PRE-COMPILE  # Configuration of the Nexteer VehSpdLmt module.
    VehSpdLmtGeneral
    CommonPublishedInformation: ArMajorVersion=3, ArMinorVersion=2, ArPatchVersion=0, SwMajorVersion=0, SwMinorVersion=0, SwPatchVersion=0, ModuleId=0, VendorId=0
  module config Wdg_internal_TMS570LS3x: definition=Wdg, implementation-config-variant=VARIANT-PRE-COMPILE, module-description=Wdg_Impl  # Configuration of the Wdg (Watchdog driver) module. This is the TMS570LS3x internal watchdog driver.
    WdgGeneral:
      WdgDevErrorDetect = false
      WdgDemReport = false
      WdgDisableAllowed = false
      WdgVersionInfoApi = false
      WdgInternalTickCounter = true
      WdgUseOsSuspendInterrupt = true
      WdgInitialTimeout = 0.006
      WdgGlobalMemoryAppTaskRef = Ap_0
    WdgModeConfig (WdgSettingsConfig): WdgDefaultMode=WDGIF_SLOW_MODE
      WdgWindowStart: Value=0
      WdgRtiKhz: Value=80000
  module config WdgIf: implementation-config-variant=VARIANT-PRE-COMPILE, module-description=WdgIf_Impl  # Configuration of the WdgIf (Watchdog Interface) module.
    Wdg_internal_TMS570LS3x (WdgIfDevice): WdgIfDeviceIndex=0, WdgIfDriverRef=WdgGeneral
    WdgIfGeneral: WdgIfDevErrorDetect=false, WdgIfDemReport=false, WdgIfVersionInfoApi=false, WdgIfInternalTickCounterRef=Wdg_internal_TMS570LS3x
