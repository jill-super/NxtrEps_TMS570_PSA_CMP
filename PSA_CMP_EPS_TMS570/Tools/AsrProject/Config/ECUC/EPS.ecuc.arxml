[part 3 of 3: package /ActiveEcuC]
AUTOSAR XML (schema 3.0.2)
package /ActiveEcuC  (continued)
  module config WdgM: implementation-config-variant=VARIANT-PRE-COMPILE, module-description=WdgM_Impl  # Configuration of the WdgM (Watchdog Manager) module.
    WdgM_Runtime (WdgMConfigSet): WdgMInitialMode=WdgMMode
      WdgMMode: WdgMExpiredSupervisionCycleTol=0, WdgMModeId=0, WdgMTicksPerSecond=1000000, WdgMSupervisionCycle=0.004, WdgMInitialTriggerModeId=0
        SE_2ms_Alive0 (WdgMAliveSupervision):
          WdgMExpectedAliveIndications = 2
          WdgMMaxMargin = 0
          WdgMMinMargin = 0
          WdgMSupervisionReferenceCycle = 1
          WdgMAliveSupervisionCheckpointRef = ChkPtAp9_2msStart_CP
        WdgMProgramFlowSupervision: WdgMGlobalCheckpointInitialRef=ChkPtAp9_2msStart_CP
          11 x WdgMGlobalTransition:
            GT_2ms_9_10: WdgMGlobalTransitionDestRef=ChkPtAp10_2msStart_CP, WdgMGlobalTransitionSourceRef=ChkPtAp9_2msEnd_CP
            GT_2ms_10_11: WdgMGlobalTransitionDestRef=ChkPtAp11_2msStart_CP, WdgMGlobalTransitionSourceRef=ChkPtAp10_2msEnd_CP
            GT_2ms_11_6: WdgMGlobalTransitionDestRef=ChkPtAp6_2msStart_CP, WdgMGlobalTransitionSourceRef=ChkPtAp11_2msEnd_CP
            GT_4ms_9_10: WdgMGlobalTransitionDestRef=ChkPtAp10_4msStart_CP, WdgMGlobalTransitionSourceRef=ChkPtAp9_4msEnd_CP
            GT_10ms_9_10a: WdgMGlobalTransitionDestRef=ChkPtAp10_10msaStart_CP, WdgMGlobalTransitionSourceRef=ChkPtAp9_10msEnd_CP
            GT_10ms_10a_6: WdgMGlobalTransitionDestRef=ChkPtAp6_10msStart_CP, WdgMGlobalTransitionSourceRef=ChkPtAp10_10msaEnd_CP
            GT_10ms_6_10b: WdgMGlobalTransitionDestRef=ChkPtAp10_10msbStart_CP, WdgMGlobalTransitionSourceRef=ChkPtAp6_10msEnd_CP
            GT_10ms_10b_11: WdgMGlobalTransitionDestRef=ChkPtAp11_10msStart_CP, WdgMGlobalTransitionSourceRef=ChkPtAp10_10msbEnd_CP
            GT_100ms_9_10: WdgMGlobalTransitionDestRef=ChkPtAp10_100msStart_CP, WdgMGlobalTransitionSourceRef=ChkPtAp9_100msEnd_CP
            GT_100ms_10_11: WdgMGlobalTransitionDestRef=ChkPtAp11_100msStart_CP, WdgMGlobalTransitionSourceRef=ChkPtAp10_100msEnd_CP
            GT_100ms_11_6: WdgMGlobalTransitionDestRef=ChkPtAp6_100msStart_CP, WdgMGlobalTransitionSourceRef=ChkPtAp11_100msEnd_CP
        WdgMTrigger: WdgMWatchdogMode=WDGIF_SLOW_MODE, WdgMTriggerConditionValue=6, WdgMTriggerWindowStart=2, WdgMTriggerModeId=0, WdgMTriggerWatchdogRef=WdgMWatchdog
        SE_2ms_9_Status (WdgMLocalStatusParams):
          WdgMFailedSupervisionRefCycleTol = 0
          WdgMSupervisedEntityInitialMode = WDGM_LOCAL_STATUS_OK
          WdgMFailedDeadlineRefCycleTol = 0
          WdgMDeadlineReferenceCycle = 0
          WdgMFailedProgramFlowRefCycleTol = 0
          WdgMProgramFlowReferenceCycle = 0
          WdgMLocalStatusSupervisedEntityRef = SE_2ms_9
        7 x WdgMAliveSupervision, all with WdgMMaxMargin=0, WdgMMinMargin=0:
          SE_2ms_Alive1: WdgMExpectedAliveIndications=2, WdgMSupervisionReferenceCycle=1, WdgMAliveSupervisionCheckpointRef=ChkPtAp6_2msEnd_CP
          SE_4ms_Alive0: WdgMExpectedAliveIndications=1, WdgMSupervisionReferenceCycle=1, WdgMAliveSupervisionCheckpointRef=ChkPtAp9_4msStart_CP
          SE_4ms_Alive1: WdgMExpectedAliveIndications=1, WdgMSupervisionReferenceCycle=1, WdgMAliveSupervisionCheckpointRef=ChkPtAp10_4msEnd_CP
          SE_10ms_Alive0: WdgMExpectedAliveIndications=2, WdgMSupervisionReferenceCycle=5, WdgMAliveSupervisionCheckpointRef=ChkPtAp9_10msStart_CP
          SE_10ms_Alive1: WdgMExpectedAliveIndications=2, WdgMSupervisionReferenceCycle=5, WdgMAliveSupervisionCheckpointRef=ChkPtAp11_10msEnd_CP
          SE_100ms_Alive0: WdgMExpectedAliveIndications=1, WdgMSupervisionReferenceCycle=25, WdgMAliveSupervisionCheckpointRef=ChkPtAp9_100msStart_CP
          SE_100ms_Alive1: WdgMExpectedAliveIndications=1, WdgMSupervisionReferenceCycle=25, WdgMAliveSupervisionCheckpointRef=ChkPtAp6_100msEnd_CP
        14 x WdgMLocalStatusParams, all with WdgMFailedSupervisionRefCycleTol=0, WdgMSupervisedEntityInitialMode=WDGM_LOCAL_STATUS_OK, WdgMFailedDeadlineRefCycleTol=0, WdgMDeadlineReferenceCycle=0, WdgMFailedProgramFlowRefCycleTol=0, WdgMProgramFlowReferenceCycle=0:
          SE_2ms_10_Status: WdgMLocalStatusSupervisedEntityRef=SE_2ms_10
          SE_2ms_11_Status: WdgMLocalStatusSupervisedEntityRef=SE_2ms_11
          SE_2ms_6_Status: WdgMLocalStatusSupervisedEntityRef=SE_2ms_6
          SE_4ms_9_Status: WdgMLocalStatusSupervisedEntityRef=SE_4ms_9
          SE_4ms_10_Status: WdgMLocalStatusSupervisedEntityRef=SE_4ms_10
          SE_10ms_9_Status: WdgMLocalStatusSupervisedEntityRef=SE_10ms_9
          SE_10ms_10a_Status: WdgMLocalStatusSupervisedEntityRef=SE_10ms_10a
          SE_10ms_6_Status: WdgMLocalStatusSupervisedEntityRef=SE_10ms_6
          SE_10ms_10b_Status: WdgMLocalStatusSupervisedEntityRef=SE_10ms_10b
          SE_10ms_11_Status: WdgMLocalStatusSupervisedEntityRef=SE_10ms_11
          SE_100ms_{9..11}_Status: WdgMLocalStatusSupervisedEntityRef=SE_100ms_{9..11}
          SE_100ms_6_Status: WdgMLocalStatusSupervisedEntityRef=SE_100ms_6
    WdgMGeneral:
      WdgMDevErrorDetect = false
      WdgMDemReport = false
      WdgMImmediateReset = true
      WdgMOffModeEnabled = false
      WdgMVersionInfoApi = false
      WdgMDefensiveBehavior = true
      WdgMUseRte = true
      WdgMDemSupervisionReport = false
      WdgMFirstCycleAliveCounterReset = true
      WdgMUseOsSuspendInterrupt = true
      WdgMTimebaseSource = WDGM_INTERNAL_HARDWARE_TICK
      WdgMSecondResetPath = false
      WdgMTickOverrunCorrection = true
      WdgMEntityDeactivationEnabled = false
      WdgMStateChangeNotification = false
      WdgMGlobalMemoryAppTaskRef = Ap_0
      SE_2ms_9 (WdgMSupervisedEntity):
        WdgMSupervisedEntityId = 0
        WdgMEnableEntityDeactivation = false
        WdgMSupportedAutosarAPI = API_4_0
        WdgMLocalCheckpointFinalRef = ChkPtAp9_2msEnd_CP
        WdgMLocalCheckpointInitialRef = ChkPtAp9_2msStart_CP
        WdgMAppTaskRef = Ap_9
        ChkPtAp9_2msStart_CP (WdgMCheckpoint): WdgMCheckpointId=0
        LT_2ms_9 (WdgMLocalTransition): WdgMLocalTransitionDestRef=ChkPtAp9_2msEnd_CP, WdgMLocalTransitionSourceRef=ChkPtAp9_2msStart_CP
        ChkPtAp9_2msEnd_CP (WdgMCheckpoint): WdgMCheckpointId=1
      WdgMWatchdog: WdgMWatchdogName=Watchdog, WdgIfDeviceRef=Wdg_internal_TMS570LS3x
      WdgMCallerIds: WdgMCallerId=0
      14 x WdgMSupervisedEntity, all with WdgMEnableEntityDeactivation=false, WdgMSupportedAutosarAPI=API_4_0:
        SE_2ms_10: WdgMSupervisedEntityId=1, WdgMLocalCheckpointFinalRef=ChkPtAp10_2msEnd_CP, WdgMLocalCheckpointInitialRef=ChkPtAp10_2msStart_CP, WdgMAppTaskRef=Ap_10
          ChkPtAp10_2msStart_CP (WdgMCheckpoint): WdgMCheckpointId=0
          LT_2ms_10 (WdgMLocalTransition): WdgMLocalTransitionDestRef=ChkPtAp10_2msEnd_CP, WdgMLocalTransitionSourceRef=ChkPtAp10_2msStart_CP
          ChkPtAp10_2msEnd_CP (WdgMCheckpoint): WdgMCheckpointId=1
        SE_2ms_11: WdgMSupervisedEntityId=2, WdgMLocalCheckpointFinalRef=ChkPtAp11_2msEnd_CP, WdgMLocalCheckpointInitialRef=ChkPtAp11_2msStart_CP, WdgMAppTaskRef=Ap_11
          ChkPtAp11_2msStart_CP (WdgMCheckpoint): WdgMCheckpointId=0
          LT_2ms_11 (WdgMLocalTransition): WdgMLocalTransitionDestRef=ChkPtAp11_2msEnd_CP, WdgMLocalTransitionSourceRef=ChkPtAp11_2msStart_CP
          ChkPtAp11_2msEnd_CP (WdgMCheckpoint): WdgMCheckpointId=1
        SE_2ms_6: WdgMSupervisedEntityId=3, WdgMLocalCheckpointFinalRef=ChkPtAp6_2msEnd_CP, WdgMLocalCheckpointInitialRef=ChkPtAp6_2msStart_CP, WdgMAppTaskRef=Ap_6
          ChkPtAp6_2msStart_CP (WdgMCheckpoint): WdgMCheckpointId=0
          LT_2ms_6 (WdgMLocalTransition): WdgMLocalTransitionDestRef=ChkPtAp6_2msEnd_CP, WdgMLocalTransitionSourceRef=ChkPtAp6_2msStart_CP
          ChkPtAp6_2msEnd_CP (WdgMCheckpoint): WdgMCheckpointId=1
        SE_4ms_9: WdgMSupervisedEntityId=4, WdgMLocalCheckpointFinalRef=ChkPtAp9_4msEnd_CP, WdgMLocalCheckpointInitialRef=ChkPtAp9_4msStart_CP, WdgMAppTaskRef=Ap_9
          ChkPtAp9_4msStart_CP (WdgMCheckpoint): WdgMCheckpointId=0
          LT_4ms_9 (WdgMLocalTransition): WdgMLocalTransitionDestRef=ChkPtAp9_4msEnd_CP, WdgMLocalTransitionSourceRef=ChkPtAp9_4msStart_CP
          ChkPtAp9_4msEnd_CP (WdgMCheckpoint): WdgMCheckpointId=1
        SE_4ms_10: WdgMSupervisedEntityId=5, WdgMLocalCheckpointFinalRef=ChkPtAp10_4msEnd_CP, WdgMLocalCheckpointInitialRef=ChkPtAp10_4msStart_CP, WdgMAppTaskRef=Ap_10
          ChkPtAp10_4msStart_CP (WdgMCheckpoint): WdgMCheckpointId=0
          LT_4ms_10 (WdgMLocalTransition): WdgMLocalTransitionDestRef=ChkPtAp10_4msEnd_CP, WdgMLocalTransitionSourceRef=ChkPtAp10_4msStart_CP
          ChkPtAp10_4msEnd_CP (WdgMCheckpoint): WdgMCheckpointId=1
        SE_10ms_9: WdgMSupervisedEntityId=6, WdgMLocalCheckpointFinalRef=ChkPtAp9_10msEnd_CP, WdgMLocalCheckpointInitialRef=ChkPtAp9_10msStart_CP, WdgMAppTaskRef=Ap_9
          ChkPtAp9_10msStart_CP (WdgMCheckpoint): WdgMCheckpointId=0
          LT_10ms_9 (WdgMLocalTransition): WdgMLocalTransitionDestRef=ChkPtAp9_10msEnd_CP, WdgMLocalTransitionSourceRef=ChkPtAp9_10msStart_CP
          ChkPtAp9_10msEnd_CP (WdgMCheckpoint): WdgMCheckpointId=1
        SE_10ms_10a: WdgMSupervisedEntityId=7, WdgMLocalCheckpointFinalRef=ChkPtAp10_10msaEnd_CP, WdgMLocalCheckpointInitialRef=ChkPtAp10_10msaStart_CP, WdgMAppTaskRef=Ap_10
          ChkPtAp10_10msaStart_CP (WdgMCheckpoint): WdgMCheckpointId=0
          LT_10ms_10a (WdgMLocalTransition): WdgMLocalTransitionDestRef=ChkPtAp10_10msaEnd_CP, WdgMLocalTransitionSourceRef=ChkPtAp10_10msaStart_CP
          ChkPtAp10_10msaEnd_CP (WdgMCheckpoint): WdgMCheckpointId=1
        SE_10ms_6: WdgMSupervisedEntityId=8, WdgMLocalCheckpointFinalRef=ChkPtAp6_10msEnd_CP, WdgMLocalCheckpointInitialRef=ChkPtAp6_10msStart_CP, WdgMAppTaskRef=Ap_6
          ChkPtAp6_10msStart_CP (WdgMCheckpoint): WdgMCheckpointId=0
          LT_10ms_6 (WdgMLocalTransition): WdgMLocalTransitionDestRef=ChkPtAp6_10msEnd_CP, WdgMLocalTransitionSourceRef=ChkPtAp6_10msStart_CP
          ChkPtAp6_10msEnd_CP (WdgMCheckpoint): WdgMCheckpointId=1
        SE_10ms_10b: WdgMSupervisedEntityId=9, WdgMLocalCheckpointFinalRef=ChkPtAp10_10msbEnd_CP, WdgMLocalCheckpointInitialRef=ChkPtAp10_10msbStart_CP, WdgMAppTaskRef=Ap_10
          ChkPtAp10_10msbStart_CP (WdgMCheckpoint): WdgMCheckpointId=0
          LT_10ms_10b (WdgMLocalTransition): WdgMLocalTransitionDestRef=ChkPtAp10_10msbEnd_CP, WdgMLocalTransitionSourceRef=ChkPtAp10_10msbStart_CP
          ChkPtAp10_10msbEnd_CP (WdgMCheckpoint): WdgMCheckpointId=1
        SE_10ms_11: WdgMSupervisedEntityId=10, WdgMLocalCheckpointFinalRef=ChkPtAp11_10msEnd_CP, WdgMLocalCheckpointInitialRef=ChkPtAp11_10msStart_CP, WdgMAppTaskRef=Ap_11
          ChkPtAp11_10msStart_CP (WdgMCheckpoint): WdgMCheckpointId=0
          LT_10ms_11 (WdgMLocalTransition): WdgMLocalTransitionDestRef=ChkPtAp11_10msEnd_CP, WdgMLocalTransitionSourceRef=ChkPtAp11_10msStart_CP
          ChkPtAp11_10msEnd_CP (WdgMCheckpoint): WdgMCheckpointId=1
        SE_100ms_9: WdgMSupervisedEntityId=11, WdgMLocalCheckpointFinalRef=ChkPtAp9_100msEnd_CP, WdgMLocalCheckpointInitialRef=ChkPtAp9_100msStart_CP, WdgMAppTaskRef=Ap_9
          ChkPtAp9_100msStart_CP (WdgMCheckpoint): WdgMCheckpointId=0
          LT_100ms_9 (WdgMLocalTransition): WdgMLocalTransitionDestRef=ChkPtAp9_100msEnd_CP, WdgMLocalTransitionSourceRef=ChkPtAp9_100msStart_CP
          ChkPtAp9_100msEnd_CP (WdgMCheckpoint): WdgMCheckpointId=1
        SE_100ms_10: WdgMSupervisedEntityId=12, WdgMLocalCheckpointFinalRef=ChkPtAp10_100msEnd_CP, WdgMLocalCheckpointInitialRef=ChkPtAp10_100msStart_CP, WdgMAppTaskRef=Ap_10
          ChkPtAp10_100msStart_CP (WdgMCheckpoint): WdgMCheckpointId=0
          LT_100ms_10 (WdgMLocalTransition): WdgMLocalTransitionDestRef=ChkPtAp10_100msEnd_CP, WdgMLocalTransitionSourceRef=ChkPtAp10_100msStart_CP
          ChkPtAp10_100msEnd_CP (WdgMCheckpoint): WdgMCheckpointId=1
        SE_100ms_11: WdgMSupervisedEntityId=13, WdgMLocalCheckpointFinalRef=ChkPtAp11_100msEnd_CP, WdgMLocalCheckpointInitialRef=ChkPtAp11_100msStart_CP, WdgMAppTaskRef=Ap_11
          ChkPtAp11_100msStart_CP (WdgMCheckpoint): WdgMCheckpointId=0
          LT_100ms_11 (WdgMLocalTransition): WdgMLocalTransitionDestRef=ChkPtAp11_100msEnd_CP, WdgMLocalTransitionSourceRef=ChkPtAp11_100msStart_CP
          ChkPtAp11_100msEnd_CP (WdgMCheckpoint): WdgMCheckpointId=1
        SE_100ms_6: WdgMSupervisedEntityId=14, WdgMLocalCheckpointFinalRef=ChkPtAp6_100msEnd_CP, WdgMLocalCheckpointInitialRef=ChkPtAp6_100msStart_CP, WdgMAppTaskRef=Ap_6
          ChkPtAp6_100msStart_CP (WdgMCheckpoint): WdgMCheckpointId=0
          LT_100ms_6 (WdgMLocalTransition): WdgMLocalTransitionDestRef=ChkPtAp6_100msEnd_CP, WdgMLocalTransitionSourceRef=ChkPtAp6_100msStart_CP
          ChkPtAp6_100msEnd_CP (WdgMCheckpoint): WdgMCheckpointId=1
  module config EcuM: implementation-config-variant=VARIANT-PRE-COMPILE, module-description=EcuM_Impl  # Configuration of the EcuM (ECU State Manager) module.
    EcuMConfiguration:
      EcuMConfigConsistencyHash = 0
      EcuMNvramReadallTimeout = 0
      EcuMNvramWriteallTimeout = 0
      EcuMRunMinimumDuration = 0.1
      EcuMSleepActivityPeriod = 0
      EcuMComStackTypesIncludeFile = ComStack_Types.h
      EcuMDefaultAppMode = OSDEFAULTAPPMODE
      EcuMModuleConfigurationRef = McuModuleConfiguration
      EcuMModuleConfigurationRef = Gpt_Runtime
      EcuMModuleConfigurationRef = Port_Runtime
      EcuMNormalMcuModeRef = (unset)
      EcuMDefaultShutdownTarget: EcuMDefaultState=EcuMStateOff, EcuMDefaultSleepModeRef=(unset)
      EcuMDriverInitListZero
      EcuMDriverInitListOne
        Code1 (EcuMDriverInitItem): EcuMModuleID=Code, EcuMModuleService=(unset), EcuMAdditionalInitCode=EcuStartup_Init1();
      EcuMDriverInitListTwo
        Code1 (EcuMDriverInitItem): EcuMModuleID=Code, EcuMModuleService=(unset), EcuMAdditionalInitCode=EcuStartup_Init2();
      EcuMDriverInitListThree
        EcuMDriverInitItem: EcuMModuleID=Code, EcuMModuleService=(unset), EcuMAdditionalInitCode=/* Inserted to fix build error */
      EcuMDriverRestartList
        EcuMDriverInitItem: EcuMModuleID=Code, EcuMModuleService=(unset), EcuMAdditionalInitCode=/* Inserted to fix build error */
      InitialEcuMSleepModeEcuMSleepMode (EcuMSleepMode):
        EcuMSleepModeSuspend = false
        EcuMSleepModeId = 0
        EcuMSleepModeName = EcuMSleepMode
        EcuMMcuMode = (unset)
        EcuMWakeupSourceMask = ECUM_WKSOURCE_RESET
        EcuMWakeupSourceMask = ECUM_WKSOURCE_POWER
        EcuMWakeupSourceMask = ECUM_WKSOURCE_INTERNAL_RESET
        EcuMWakeupSourceMask = ECUM_WKSOURCE_INTERNAL_WDG
        EcuMWakeupSourceMask = ECUM_WKSOURCE_EXTERNAL_WDG
        EcuMSleepModeMcuModeRef = McuModeConf
      EcuMTTII: EcuMDivisor=1, EcuMSleepModeRef=(unset), EcuMSuccessorRef=(unset)
      EcuMUsrCfg_EPS (EcuMUserConfig): EcuMUser=1
      ECUM_WKSOURCE_POWER (EcuMWakeupSource): EcuMResetReason=6, EcuMValidationTimeout=0, EcuMWakeupSourceId=1, EcuMWakeupSourcePolling=false
      EcuMWdgM:
        EcuMWdgMPostRunModeRef = Mode_0
        EcuMWdgMRunModeRef = Mode_0
        EcuMWdgMShutdownModeRef = Mode_0
        EcuMWdgMStartupModeRef = (unset)
        EcuMWdgMWakeupModeRef = Mode_0
        EcuMSupervisedEntityRef = (unset)
      8 x EcuMWakeupSource, all with EcuMValidationTimeout=0, EcuMWakeupSourcePolling=false:
        ECUM_WKSOURCE_RESET: EcuMResetReason=-1, EcuMWakeupSourceId=2
        ECUM_WKSOURCE_INTERNAL_RESET: EcuMResetReason=3, EcuMWakeupSourceId=4
        ECUM_WKSOURCE_INTERNAL_WDG: EcuMResetReason=4, EcuMWakeupSourceId=8
        ECUM_WKSOURCE_EXTERNAL_WDG: EcuMResetReason=-1, EcuMWakeupSourceId=16
        ECUM_WKSOURCE_SOFTWARE_RESET: EcuMResetReason=2, EcuMWakeupSourceId=32
        ECUM_WKSOURCE_OSCI_OR_PLLSLIP_RESET: EcuMResetReason=5, EcuMWakeupSourceId=64
        ECUM_WKSOURCE_EXTERNAL_RESET: EcuMResetReason=1, EcuMWakeupSourceId=128
        ECUM_WKSOURCE_RESET_UNDEFINED: EcuMResetReason=7, EcuMWakeupSourceId=256
    EcuMGeneral:
      EcuMMainFunctionPeriod = 0.01
      EcuMIncludeDem = false
      EcuMIncludeDet = true
      EcuMIncludeNvramMgr = true
      EcuMIncludeWdgM = false
      EcuMIncludeComM = false
      EcuMIncludeRte = true
      EcuMIncludeSchM = false
      EcuMTTIIEnabled = false
      EcuMVersionInfoApi = false
      EcuMDevErrorDetect = true
      EcuMCheckParameter = true
      EcuMCheckPointerParameter = true
      EcuMCheckConfigType = true
      EcuMCheckUnInit = true
      EcuMCheckStateParameter = true
      EcuMCheckWkSourceParameter = true
      EcuMCheckBootTargetParameter = true
      EcuMCheckSleepModeParameter = true
      EcuMCheckUserParameter = true
      EcuMEnableProdErrorReporting = false
      EcuMDetErrorhookFunction = Det_ReportError
      EcuMDemSetError = Dem_ReportErrorStatus
      EcuMMcuIncludeFile = Mcu.h
      EcuMWdgMIncludeFile = WdgM.h
      EcuMComMIncludeFile = ComM.h
      EcuMSchMIncludeFile = SchM.h
      EcuMComMCallbackFile = ComM_EcuM.h
      EcuMRteIncludeFile = Rte_Main.h
      EcuMNvmIncludeFile = Nvm.h
      EcuMDetIncludeFile = Det.h
      EcuMDemIncludeFile = Dem.h
      EcuMOsIncludeFile = Os.h
      EcuMProdErrorDetectIncludeFile = Dem.h
      EcuMDevErrorDetectIncludeFile = Det.h
      EcuMAdditionalIncludes = EcuStartup.h
      EcuMNvmTypesFile = Nvm.h
      EcuMNvmCancelWriteAllTimeout = 60
      EcuMTTIISleepModeRef = (unset)
      EcuMIrqHandling = InterruptFunctionSet
      EcuMTTIIWakeupSourceRef = (unset)
      EcuMApiSwitches: EcuMKillAllRUNRequestApi=true, EcuMGetValidatedWakeupEventsApi=true, EcuMGetExpiredWakeupEventsApi=true, EcuMGetStatusOfWakeupSourceApi=true
      EcuMCalloutSwitches:
        EcuMOnRTEStartupCallout = true
        EcuMOnEnterRunCallout = true
        EcuMOnExitRunCallout = true
        EcuMOnExitPostRunCallout = true
        EcuMOnPrepShutdownCallout = true
        EcuMOnGoSleepCallout = true
        EcuMOnGoOffOneCallout = true
        EcuMOnGoOffTwoCallout = true
        EcuMOnWakeupReactionCallout = true
        EcuMGeneratorCompatibilityError = false
      EcuMServicePortConfig:
        EcuMGenStateRequestPort = true
        EcuMGenBootTargetPort = false
        EcuMGenApplicationModePort = false
        EcuMGenShutdownTargetPort = false
        EcuMGenModeSwitchPort = false
        EcuMModeSwitchCbkName = (unset)
        EcuMModeSwitchRteAck = true
        EcuMServiceComponentName = EcuM
    VectorCommonData: BswmdVersion=4.08.00
  module config Dem: implementation-config-variant=VARIANT-LINK-TIME, module-description=Dem_Impl  # Configuration of the Dem (Diagnostic Event Manager) module.
    DemConfigSet: DemActiveDsdServiceTableRef=
      DtcClass0 (DemDTCClass): DemDTC=0, DemDTCKind=DEM_DTC_KIND_ALL_DTCS, DemDTCSeverity=DEM_DTC_SEV_NO_SEVERITY, DemDTCFunctionalUnit=0, DemDTCSupportWarningIndicator=false
      NVM_E_REQ_FAILED (DemEventParameter):
        DemEventID = 65
        DemInitMonitorName = (unset)
        DemEventKind = DEM_EVENT_KIND_BSW
        DemImportedEvent = false
        DemExtendedDataRef = (unset)
        DemDTCClassRef = DtcClass17
        DemEventClass:
          DemEventPriority = 0
          DemFFPrestorageSupported = false
          DemHealingAllowed = false
          DemHealingCycleCounter = 1
          DemHealingCycleRef = (unset)
          DemOperationCycleRef = DEM_IGNITION
          DemPredebounceAlgorithmClass
            DemPreDebounceCounterBased: DemCountInStepSize=1, DemCountOutStepSize=1, DemJumpDown=false, DemJumpUp=true, DemPreDebounceName=DEM_PRE_DEBOUNCE_COUNTER_BASED
      4 x DemGroupOfDTC:
        DEM_DTC_GROUP_ALL_DTCS: DemGroupDTCs=(unset)
        DEM_DTC_GROUP_CHASSIS_DTCS: DemGroupDTCs=4194304
        DEM_DTC_GROUP_BODY_DTCS: DemGroupDTCs=8388608
        DEM_DTC_GROUP_NETWORK_COM_DTCS: DemGroupDTCs=12582912
      75 x DemDTCClass, all with DemDTCKind=DEM_DTC_KIND_ALL_DTCS, DemDTCSeverity=DEM_DTC_SEV_NO_SEVERITY:
        DtcClass{1..28}: DemDTC=0, DemDTCFunctionalUnit=0, DemDTCSupportWarningIndicator=false
        DtcClass29: DemDTC=5651087, DemDTCFunctionalUnit=255, DemDTCSupportWarningIndicator=false, DemTriggerOnDTCStatusTargetRef=CBDTCStatusChange_FaultLog, DemTriggerOnDTCStatusTargetRef=CBDTCStatusChange_DemIf
        DtcClass30: DemDTC=5506712, DemDTCFunctionalUnit=255, DemDTCSupportWarningIndicator=true, DemTriggerOnDTCStatusTargetRef=CBDTCStatusChange_FaultLog, DemTriggerOnDTCStatusTargetRef=CBDTCStatusChange_DemIf
        DtcClass31: DemDTC=5507862, DemDTCFunctionalUnit=255, DemDTCSupportWarningIndicator=false, DemTriggerOnDTCStatusTargetRef=CBDTCStatusChange_FaultLog, DemTriggerOnDTCStatusTargetRef=CBDTCStatusChange_DemIf
        DtcClass32: DemDTC=5376257, DemDTCFunctionalUnit=255, DemDTCSupportWarningIndicator=false, DemTriggerOnDTCStatusTargetRef=CBDTCStatusChange_FaultLog, DemTriggerOnDTCStatusTargetRef=CBDTCStatusChange_DemIf
        DtcClass33: DemDTC=13632392, DemDTCFunctionalUnit=255, DemDTCSupportWarningIndicator=false, DemTriggerOnDTCStatusTargetRef=CBDTCStatusChange_FaultLog, DemTriggerOnDTCStatusTargetRef=CBDTCStatusChange_DemIf
        DtcClass34: DemDTC=13703303, DemDTCFunctionalUnit=255, DemDTCSupportWarningIndicator=false, DemTriggerOnDTCStatusTargetRef=CBDTCStatusChange_FaultLog, DemTriggerOnDTCStatusTargetRef=CBDTCStatusChange_DemIf
        DtcClass35: DemDTC=13767553, DemDTCFunctionalUnit=255, DemDTCSupportWarningIndicator=false, DemTriggerOnDTCStatusTargetRef=CBDTCStatusChange_FaultLog, DemTriggerOnDTCStatusTargetRef=CBDTCStatusChange_DemIf
        DtcClass36: DemDTC=13833090, DemDTCFunctionalUnit=255, DemDTCSupportWarningIndicator=false, DemTriggerOnDTCStatusTargetRef=CBDTCStatusChange_FaultLog, DemTriggerOnDTCStatusTargetRef=CBDTCStatusChange_DemIf
        DtcClass37: DemDTC=13833091, DemDTCFunctionalUnit=255, DemDTCSupportWarningIndicator=false, DemTriggerOnDTCStatusTargetRef=CBDTCStatusChange_FaultLog, DemTriggerOnDTCStatusTargetRef=CBDTCStatusChange_DemIf
        DtcClass38: DemDTC=13631496, DemDTCFunctionalUnit=255, DemDTCSupportWarningIndicator=false, DemTriggerOnDTCStatusTargetRef=CBDTCStatusChange_FaultLog, DemTriggerOnDTCStatusTargetRef=CBDTCStatusChange_DemIf
        DtcClass39: DemDTC=13699207, DemDTCFunctionalUnit=255, DemDTCSupportWarningIndicator=false, DemTriggerOnDTCStatusTargetRef=CBDTCStatusChange_FaultLog, DemTriggerOnDTCStatusTargetRef=CBDTCStatusChange_DemIf
        DtcClass40: DemDTC=13702023, DemDTCFunctionalUnit=255, DemDTCSupportWarningIndicator=false, DemTriggerOnDTCStatusTargetRef=CBDTCStatusChange_FaultLog, DemTriggerOnDTCStatusTargetRef=CBDTCStatusChange_DemIf
        DtcClass41: DemDTC=13764737, DemDTCFunctionalUnit=255, DemDTCSupportWarningIndicator=false, DemTriggerOnDTCStatusTargetRef=CBDTCStatusChange_FaultLog, DemTriggerOnDTCStatusTargetRef=CBDTCStatusChange_DemIf
        DtcClass42: DemDTC=13698439, DemDTCFunctionalUnit=255, DemDTCSupportWarningIndicator=false, DemTriggerOnDTCStatusTargetRef=CBDTCStatusChange_FaultLog, DemTriggerOnDTCStatusTargetRef=CBDTCStatusChange_DemIf
        DtcClass43: DemDTC=13763969, DemDTCFunctionalUnit=255, DemDTCSupportWarningIndicator=false, DemTriggerOnDTCStatusTargetRef=CBDTCStatusChange_FaultLog, DemTriggerOnDTCStatusTargetRef=CBDTCStatusChange_DemIf
        DtcClass44: DemDTC=13829506, DemDTCFunctionalUnit=255, DemDTCSupportWarningIndicator=false, DemTriggerOnDTCStatusTargetRef=CBDTCStatusChange_FaultLog, DemTriggerOnDTCStatusTargetRef=CBDTCStatusChange_DemIf
        DtcClass45: DemDTC=13829507, DemDTCFunctionalUnit=255, DemDTCSupportWarningIndicator=false, DemTriggerOnDTCStatusTargetRef=CBDTCStatusChange_FaultLog, DemTriggerOnDTCStatusTargetRef=CBDTCStatusChange_DemIf
        DtcClass46: DemDTC=13768833, DemDTCFunctionalUnit=255, DemDTCSupportWarningIndicator=false, DemTriggerOnDTCStatusTargetRef=CBDTCStatusChange_FaultLog, DemTriggerOnDTCStatusTargetRef=CBDTCStatusChange_DemIf
        DtcClass47: DemDTC=13704583, DemDTCFunctionalUnit=255, DemDTCSupportWarningIndicator=false, DemTriggerOnDTCStatusTargetRef=CBDTCStatusChange_FaultLog, DemTriggerOnDTCStatusTargetRef=CBDTCStatusChange_DemIf
        DtcClass48: DemDTC=13770113, DemDTCFunctionalUnit=255, DemDTCSupportWarningIndicator=false, DemTriggerOnDTCStatusTargetRef=CBDTCStatusChange_FaultLog, DemTriggerOnDTCStatusTargetRef=CBDTCStatusChange_DemIf
        DtcClass49: DemDTC=13835650, DemDTCFunctionalUnit=255, DemDTCSupportWarningIndicator=false, DemTriggerOnDTCStatusTargetRef=CBDTCStatusChange_FaultLog, DemTriggerOnDTCStatusTargetRef=CBDTCStatusChange_DemIf
        DtcClass50: DemDTC=13835651, DemDTCFunctionalUnit=255, DemDTCSupportWarningIndicator=false, DemTriggerOnDTCStatusTargetRef=CBDTCStatusChange_FaultLog, DemTriggerOnDTCStatusTargetRef=CBDTCStatusChange_DemIf
        DtcClass51: DemDTC=328082, DemDTCFunctionalUnit=255, DemDTCSupportWarningIndicator=false, DemTriggerOnDTCStatusTargetRef=CBDTCStatusChange_FaultLog, DemTriggerOnDTCStatusTargetRef=CBDTCStatusChange_DemIf
        DtcClass52: DemDTC=5311057, DemDTCFunctionalUnit=255, DemDTCSupportWarningIndicator=true, DemTriggerOnDTCStatusTargetRef=CBDTCStatusChange_FaultLog, DemTriggerOnDTCStatusTargetRef=CBDTCStatusChange_DemIf
        DtcClass53: DemDTC=5311393, DemDTCFunctionalUnit=255, DemDTCSupportWarningIndicator=false, DemTriggerOnDTCStatusTargetRef=CBDTCStatusChange_FaultLog, DemTriggerOnDTCStatusTargetRef=CBDTCStatusChange_DemIf
        DtcClass54: DemDTC=5311394, DemDTCFunctionalUnit=255, DemDTCSupportWarningIndicator=true, DemTriggerOnDTCStatusTargetRef=CBDTCStatusChange_FaultLog, DemTriggerOnDTCStatusTargetRef=CBDTCStatusChange_DemIf
        DtcClass55: DemDTC=5311395, DemDTCFunctionalUnit=255, DemDTCSupportWarningIndicator=true, DemTriggerOnDTCStatusTargetRef=CBDTCStatusChange_FaultLog, DemTriggerOnDTCStatusTargetRef=CBDTCStatusChange_DemIf
        DtcClass56: DemDTC=5311489, DemDTCFunctionalUnit=255, DemDTCSupportWarningIndicator=true, DemTriggerOnDTCStatusTargetRef=CBDTCStatusChange_FaultLog, DemTriggerOnDTCStatusTargetRef=CBDTCStatusChange_DemIf
        DtcClass57: DemDTC=5311492, DemDTCFunctionalUnit=255, DemDTCSupportWarningIndicator=true, DemTriggerOnDTCStatusTargetRef=CBDTCStatusChange_FaultLog, DemTriggerOnDTCStatusTargetRef=CBDTCStatusChange_DemIf
        DtcClass58: DemDTC=5311516, DemDTCFunctionalUnit=255, DemDTCSupportWarningIndicator=true, DemTriggerOnDTCStatusTargetRef=CBDTCStatusChange_FaultLog, DemTriggerOnDTCStatusTargetRef=CBDTCStatusChange_DemIf
        DtcClass59: DemDTC=5311555, DemDTCFunctionalUnit=255, DemDTCSupportWarningIndicator=true, DemTriggerOnDTCStatusTargetRef=CBDTCStatusChange_FaultLog, DemTriggerOnDTCStatusTargetRef=CBDTCStatusChange_DemIf
        DtcClass60: DemDTC=5311586, DemDTCFunctionalUnit=255, DemDTCSupportWarningIndicator=true, DemTriggerOnDTCStatusTargetRef=CBDTCStatusChange_FaultLog, DemTriggerOnDTCStatusTargetRef=CBDTCStatusChange_DemIf
        DtcClass61: DemDTC=5311638, DemDTCFunctionalUnit=255, DemDTCSupportWarningIndicator=true, DemTriggerOnDTCStatusTargetRef=CBDTCStatusChange_FaultLog, DemTriggerOnDTCStatusTargetRef=CBDTCStatusChange_DemIf
        DtcClass62: DemDTC=5311640, DemDTCFunctionalUnit=255, DemDTCSupportWarningIndicator=true, DemTriggerOnDTCStatusTargetRef=CBDTCStatusChange_FaultLog, DemTriggerOnDTCStatusTargetRef=CBDTCStatusChange_DemIf
        DtcClass63: DemDTC=5478485, DemDTCFunctionalUnit=255, DemDTCSupportWarningIndicator=true, DemTriggerOnDTCStatusTargetRef=CBDTCStatusChange_FaultLog, DemTriggerOnDTCStatusTargetRef=CBDTCStatusChange_DemIf
        DtcClass64: DemDTC=5508096, DemDTCFunctionalUnit=255, DemDTCSupportWarningIndicator=false, DemTriggerOnDTCStatusTargetRef=CBDTCStatusChange_FaultLog, DemTriggerOnDTCStatusTargetRef=CBDTCStatusChange_DemIf
        DtcClass65: DemDTC=5596815, DemDTCFunctionalUnit=255, DemDTCSupportWarningIndicator=false, DemTriggerOnDTCStatusTargetRef=CBDTCStatusChange_FaultLog, DemTriggerOnDTCStatusTargetRef=CBDTCStatusChange_DemIf
        DtcClass66: DemDTC=5508352, DemDTCFunctionalUnit=255, DemDTCSupportWarningIndicator=false, DemTriggerOnDTCStatusTargetRef=CBDTCStatusChange_FaultLog, DemTriggerOnDTCStatusTargetRef=CBDTCStatusChange_DemIf
        DtcClass67: DemDTC=5653508, DemDTCFunctionalUnit=255, DemDTCSupportWarningIndicator=false, DemTriggerOnDTCStatusTargetRef=CBDTCStatusChange_FaultLog, DemTriggerOnDTCStatusTargetRef=CBDTCStatusChange_DemIf
        DtcClass68: DemDTC=5322338, DemDTCFunctionalUnit=255, DemDTCSupportWarningIndicator=false, DemTriggerOnDTCStatusTargetRef=CBDTCStatusChange_FaultLog, DemTriggerOnDTCStatusTargetRef=CBDTCStatusChange_DemIf
        DtcClass69: DemDTC=5377442, DemDTCFunctionalUnit=255, DemDTCSupportWarningIndicator=false, DemTriggerOnDTCStatusTargetRef=CBDTCStatusChange_FaultLog, DemTriggerOnDTCStatusTargetRef=CBDTCStatusChange_DemIf
        DtcClass70: DemDTC=5377536, DemDTCFunctionalUnit=255, DemDTCSupportWarningIndicator=false, DemTriggerOnDTCStatusTargetRef=CBDTCStatusChange_FaultLog, DemTriggerOnDTCStatusTargetRef=CBDTCStatusChange_DemIf
        DtcClass71: DemDTC=13832968, DemDTCFunctionalUnit=255, DemDTCSupportWarningIndicator=false, DemTriggerOnDTCStatusTargetRef=CBDTCStatusChange_FaultLog, DemTriggerOnDTCStatusTargetRef=CBDTCStatusChange_DemIf
        DtcClass72: DemDTC=13829384, DemDTCFunctionalUnit=255, DemDTCSupportWarningIndicator=false, DemTriggerOnDTCStatusTargetRef=CBDTCStatusChange_FaultLog, DemTriggerOnDTCStatusTargetRef=CBDTCStatusChange_DemIf
        DtcClass73: DemDTC=13830152, DemDTCFunctionalUnit=255, DemDTCSupportWarningIndicator=false, DemTriggerOnDTCStatusTargetRef=CBDTCStatusChange_FaultLog, DemTriggerOnDTCStatusTargetRef=CBDTCStatusChange_DemIf
        DtcClass74: DemDTC=13834248, DemDTCFunctionalUnit=255, DemDTCSupportWarningIndicator=false, DemTriggerOnDTCStatusTargetRef=CBDTCStatusChange_FaultLog, DemTriggerOnDTCStatusTargetRef=CBDTCStatusChange_DemIf
        DtcClass75: DemDTC=13835528, DemDTCFunctionalUnit=255, DemDTCSupportWarningIndicator=false, DemTriggerOnDTCStatusTargetRef=CBDTCStatusChange_FaultLog, DemTriggerOnDTCStatusTargetRef=CBDTCStatusChange_DemIf
      51 x DemEventParameter, all with DemInitMonitorName=(unset), DemExtendedDataRef=(unset):
        NVM_E_INTEGRITY_FAILED: DemEventID=66, DemEventKind=DEM_EVENT_KIND_BSW, DemImportedEvent=false, DemDTCClassRef=DtcClass18
          DemEventClass:
            DemEventPriority = 0
            DemFFPrestorageSupported = false
            DemHealingAllowed = false
            DemHealingCycleCounter = 1
            DemHealingCycleRef = (unset)
            DemOperationCycleRef = DEM_IGNITION
            DemPredebounceAlgorithmClass
              DemPreDebounceCounterBased: DemCountInStepSize=1, DemCountOutStepSize=1, DemJumpDown=false, DemJumpUp=true, DemPreDebounceName=DEM_PRE_DEBOUNCE_COUNTER_BASED
        WDGM_E_SET_MODE: DemEventID=75, DemEventKind=DEM_EVENT_KIND_BSW, DemImportedEvent=false, DemDTCClassRef=DtcClass27
          DemEventClass:
            DemEventPriority = 0
            DemFFPrestorageSupported = false
            DemHealingAllowed = false
            DemHealingCycleCounter = 1
            DemHealingCycleRef = (unset)
            DemOperationCycleRef = DEM_IGNITION
            DemPredebounceAlgorithmClass
              DemPreDebounceCounterBased: DemCountInStepSize=1, DemCountOutStepSize=1, DemJumpDown=false, DemJumpUp=true, DemPreDebounceName=DEM_PRE_DEBOUNCE_COUNTER_BASED
        WDGM_E_ALIVE_SUPERVISION: DemEventID=76, DemEventKind=DEM_EVENT_KIND_BSW, DemImportedEvent=false, DemDTCClassRef=DtcClass28
          DemEventClass:
            DemEventPriority = 0
            DemFFPrestorageSupported = false
            DemHealingAllowed = false
            DemHealingCycleCounter = 1
            DemHealingCycleRef = (unset)
            DemOperationCycleRef = DEM_IGNITION
            DemPredebounceAlgorithmClass
              DemPreDebounceCounterBased: DemCountInStepSize=1, DemCountOutStepSize=1, DemJumpDown=false, DemJumpUp=true, DemPreDebounceName=DEM_PRE_DEBOUNCE_COUNTER_BASED
        CTC_0x563A8F: DemEventID=25, DemEventKind=DEM_EVENT_KIND_SWC, DemImportedEvent=true, DemDTCClassRef=DtcClass29, DemFreezeFrameClassRef=Snapshot_22
          DemEventClass:
            DemEventPriority = 0
            DemFFPrestorageSupported = false
            DemHealingAllowed = true
            DemEventDestination = DEM_DTC_ORIGIN_PRIMARY_MEMORY
            DemHealingCycleCounter = 40
            DemHealingCycleRef = DEM_IGNITION
            DemOperationCycleRef = DEM_IGNITION
            DemPredebounceAlgorithmClass
              DemPreDebounceCounterBased: DemCountInStepSize=0, DemCountOutStepSize=0, DemJumpDown=false, DemJumpUp=true, DemPreDebounceName=DEM_PRE_DEBOUNCE_COUNTER_BASED
        CTC_0x540698: DemEventID=30, DemEventKind=DEM_EVENT_KIND_SWC, DemImportedEvent=true, DemDTCClassRef=DtcClass30, DemFreezeFrameClassRef=Snapshot_17
          DemEventClass:
            DemEventPriority = 0
            DemFFPrestorageSupported = false
            DemHealingAllowed = true
            DemEventDestination = DEM_DTC_ORIGIN_PRIMARY_MEMORY
            DemHealingCycleCounter = 40
            DemHealingCycleRef = DEM_IGNITION
            DemOperationCycleRef = DEM_IGNITION
            DemIndicator0 (DemIndicatorAttribute): DemIndicatorBehaviour=1, DemLinkedIndicator=ETATDA2
            DemPredebounceAlgorithmClass
              DemPreDebounceCounterBased: DemCountInStepSize=0, DemCountOutStepSize=0, DemJumpDown=false, DemJumpUp=true, DemPreDebounceName=DEM_PRE_DEBOUNCE_COUNTER_BASED
        CTC_0x540B16: DemEventID=29, DemEventKind=DEM_EVENT_KIND_SWC, DemImportedEvent=true, DemDTCClassRef=DtcClass31, DemFreezeFrameClassRef=Snapshot_18
          DemEventClass:
            DemEventPriority = 0
            DemFFPrestorageSupported = false
            DemHealingAllowed = true
            DemEventDestination = DEM_DTC_ORIGIN_PRIMARY_MEMORY
            DemHealingCycleCounter = 40
            DemHealingCycleRef = DEM_IGNITION
            DemOperationCycleRef = DEM_IGNITION
            DemPredebounceAlgorithmClass
              DemPreDebounceCounterBased: DemCountInStepSize=0, DemCountOutStepSize=0, DemJumpDown=false, DemJumpUp=true, DemPreDebounceName=DEM_PRE_DEBOUNCE_COUNTER_BASED
        CTC_0x520901: DemEventID=34, DemEventKind=DEM_EVENT_KIND_SWC, DemImportedEvent=true, DemDTCClassRef=DtcClass32, DemFreezeFrameClassRef=Snapshot_13
          DemEventClass:
            DemEventPriority = 0
            DemFFPrestorageSupported = false
            DemHealingAllowed = true
            DemEventDestination = DEM_DTC_ORIGIN_PRIMARY_MEMORY
            DemHealingCycleCounter = 40
            DemHealingCycleRef = DEM_IGNITION
            DemOperationCycleRef = DEM_IGNITION
            DemPredebounceAlgorithmClass
              DemPreDebounceCounterBased: DemCountInStepSize=0, DemCountOutStepSize=0, DemJumpDown=false, DemJumpUp=true, DemPreDebounceName=DEM_PRE_DEBOUNCE_COUNTER_BASED
        CTC_0xD00388: DemEventID=22, DemEventKind=DEM_EVENT_KIND_SWC, DemImportedEvent=true, DemDTCClassRef=DtcClass33, DemFreezeFrameClassRef=Snapshot_25
          DemEventClass:
            DemEventPriority = 0
            DemFFPrestorageSupported = false
            DemHealingAllowed = true
            DemEventDestination = DEM_DTC_ORIGIN_PRIMARY_MEMORY
            DemHealingCycleCounter = 40
            DemHealingCycleRef = DEM_IGNITION
            DemOperationCycleRef = DEM_IGNITION
            DemPredebounceAlgorithmClass
              DemPreDebounceCounterBased: DemCountInStepSize=0, DemCountOutStepSize=0, DemJumpDown=false, DemJumpUp=true, DemPreDebounceName=DEM_PRE_DEBOUNCE_COUNTER_BASED
        CTC_0xD11887: DemEventID=18, DemEventKind=DEM_EVENT_KIND_SWC, DemImportedEvent=true, DemDTCClassRef=DtcClass34, DemFreezeFrameClassRef=Snapshot_29
          DemEventClass:
            DemEventPriority = 0
            DemFFPrestorageSupported = false
            DemHealingAllowed = true
            DemEventDestination = DEM_DTC_ORIGIN_PRIMARY_MEMORY
            DemHealingCycleCounter = 40
            DemHealingCycleRef = DEM_IGNITION
            DemOperationCycleRef = DEM_IGNITION
            DemPredebounceAlgorithmClass
              DemPreDebounceCounterBased: DemCountInStepSize=0, DemCountOutStepSize=0, DemJumpDown=false, DemJumpUp=true, DemPreDebounceName=DEM_PRE_DEBOUNCE_COUNTER_BASED
        CTC_0xD21381: DemEventID=14, DemEventKind=DEM_EVENT_KIND_SWC, DemImportedEvent=true, DemDTCClassRef=DtcClass35, DemFreezeFrameClassRef=Snapshot_33
          DemEventClass:
            DemEventPriority = 0
            DemFFPrestorageSupported = false
            DemHealingAllowed = true
            DemEventDestination = DEM_DTC_ORIGIN_PRIMARY_MEMORY
            DemHealingCycleCounter = 40
            DemHealingCycleRef = DEM_IGNITION
            DemOperationCycleRef = DEM_IGNITION
            DemPredebounceAlgorithmClass
              DemPreDebounceCounterBased: DemCountInStepSize=0, DemCountOutStepSize=0, DemJumpDown=false, DemJumpUp=true, DemPreDebounceName=DEM_PRE_DEBOUNCE_COUNTER_BASED
        CTC_0xD31382: DemEventID=6, DemEventKind=DEM_EVENT_KIND_SWC, DemImportedEvent=true, DemDTCClassRef=DtcClass36, DemFreezeFrameClassRef=Snapshot_41
          DemEventClass:
            DemEventPriority = 0
            DemFFPrestorageSupported = false
            DemHealingAllowed = true
            DemEventDestination = DEM_DTC_ORIGIN_PRIMARY_MEMORY
            DemHealingCycleCounter = 40
            DemHealingCycleRef = DEM_IGNITION
            DemOperationCycleRef = DEM_IGNITION
            DemPredebounceAlgorithmClass
              DemPreDebounceCounterBased: DemCountInStepSize=0, DemCountOutStepSize=0, DemJumpDown=false, DemJumpUp=true, DemPreDebounceName=DEM_PRE_DEBOUNCE_COUNTER_BASED
        CTC_0xD31383: DemEventID=5, DemEventKind=DEM_EVENT_KIND_SWC, DemImportedEvent=true, DemDTCClassRef=DtcClass37, DemFreezeFrameClassRef=Snapshot_42
          DemEventClass:
            DemEventPriority = 0
            DemFFPrestorageSupported = false
            DemHealingAllowed = true
            DemEventDestination = DEM_DTC_ORIGIN_PRIMARY_MEMORY
            DemHealingCycleCounter = 40
            DemHealingCycleRef = DEM_IGNITION
            DemOperationCycleRef = DEM_IGNITION
            DemPredebounceAlgorithmClass
              DemPreDebounceCounterBased: DemCountInStepSize=0, DemCountOutStepSize=0, DemJumpDown=false, DemJumpUp=true, DemPreDebounceName=DEM_PRE_DEBOUNCE_COUNTER_BASED
        CTC_0xD00008: DemEventID=23, DemEventKind=DEM_EVENT_KIND_SWC, DemImportedEvent=true, DemDTCClassRef=DtcClass38, DemFreezeFrameClassRef=Snapshot_24
          DemEventClass:
            DemEventPriority = 0
            DemFFPrestorageSupported = false
            DemHealingAllowed = true
            DemEventDestination = DEM_DTC_ORIGIN_PRIMARY_MEMORY
            DemHealingCycleCounter = 40
            DemHealingCycleRef = DEM_IGNITION
            DemOperationCycleRef = DEM_IGNITION
            DemPredebounceAlgorithmClass
              DemPreDebounceCounterBased: DemCountInStepSize=0, DemCountOutStepSize=0, DemJumpDown=false, DemJumpUp=true, DemPreDebounceName=DEM_PRE_DEBOUNCE_COUNTER_BASED
        CTC_0xD10887: DemEventID=20, DemEventKind=DEM_EVENT_KIND_SWC, DemImportedEvent=true, DemDTCClassRef=DtcClass39, DemFreezeFrameClassRef=Snapshot_27
          DemEventClass:
            DemEventPriority = 0
            DemFFPrestorageSupported = false
            DemHealingAllowed = true
            DemEventDestination = DEM_DTC_ORIGIN_PRIMARY_MEMORY
            DemHealingCycleCounter = 40
            DemHealingCycleRef = DEM_IGNITION
            DemOperationCycleRef = DEM_IGNITION
            DemPredebounceAlgorithmClass
              DemPreDebounceCounterBased: DemCountInStepSize=0, DemCountOutStepSize=0, DemJumpDown=false, DemJumpUp=true, DemPreDebounceName=DEM_PRE_DEBOUNCE_COUNTER_BASED
        CTC_0xD11387: DemEventID=19, DemEventKind=DEM_EVENT_KIND_SWC, DemImportedEvent=true, DemDTCClassRef=DtcClass40, DemFreezeFrameClassRef=Snapshot_28
          DemEventClass:
            DemEventPriority = 0
            DemFFPrestorageSupported = false
            DemHealingAllowed = true
            DemEventDestination = DEM_DTC_ORIGIN_PRIMARY_MEMORY
            DemHealingCycleCounter = 40
            DemHealingCycleRef = DEM_IGNITION
            DemOperationCycleRef = DEM_IGNITION
            DemPredebounceAlgorithmClass
              DemPreDebounceCounterBased: DemCountInStepSize=0, DemCountOutStepSize=0, DemJumpDown=false, DemJumpUp=true, DemPreDebounceName=DEM_PRE_DEBOUNCE_COUNTER_BASED
        CTC_0xD20881: DemEventID=15, DemEventKind=DEM_EVENT_KIND_SWC, DemImportedEvent=true, DemDTCClassRef=DtcClass41, DemFreezeFrameClassRef=Snapshot_32
          DemEventClass:
            DemEventPriority = 0
            DemFFPrestorageSupported = false
            DemHealingAllowed = true
            DemEventDestination = DEM_DTC_ORIGIN_PRIMARY_MEMORY
            DemHealingCycleCounter = 40
            DemHealingCycleRef = DEM_IGNITION
            DemOperationCycleRef = DEM_IGNITION
            DemPredebounceAlgorithmClass
              DemPreDebounceCounterBased: DemCountInStepSize=0, DemCountOutStepSize=0, DemJumpDown=false, DemJumpUp=true, DemPreDebounceName=DEM_PRE_DEBOUNCE_COUNTER_BASED
        CTC_0xD10587: DemEventID=21, DemEventKind=DEM_EVENT_KIND_SWC, DemImportedEvent=true, DemDTCClassRef=DtcClass42, DemFreezeFrameClassRef=Snapshot_26
          DemEventClass:
            DemEventPriority = 0
            DemFFPrestorageSupported = false
            DemHealingAllowed = true
            DemEventDestination = DEM_DTC_ORIGIN_PRIMARY_MEMORY
            DemHealingCycleCounter = 40
            DemHealingCycleRef = DEM_IGNITION
            DemOperationCycleRef = DEM_IGNITION
            DemPredebounceAlgorithmClass
              DemPreDebounceCounterBased: DemCountInStepSize=0, DemCountOutStepSize=0, DemJumpDown=false, DemJumpUp=true, DemPreDebounceName=DEM_PRE_DEBOUNCE_COUNTER_BASED
        CTC_0xD20581: DemEventID=16, DemEventKind=DEM_EVENT_KIND_SWC, DemImportedEvent=true, DemDTCClassRef=DtcClass43, DemFreezeFrameClassRef=Snapshot_31
          DemEventClass:
            DemEventPriority = 0
            DemFFPrestorageSupported = false
            DemHealingAllowed = true
            DemEventDestination = DEM_DTC_ORIGIN_PRIMARY_MEMORY
            DemHealingCycleCounter = 40
            DemHealingCycleRef = DEM_IGNITION
            DemOperationCycleRef = DEM_IGNITION
            DemPredebounceAlgorithmClass
              DemPreDebounceCounterBased: DemCountInStepSize=0, DemCountOutStepSize=0, DemJumpDown=false, DemJumpUp=true, DemPreDebounceName=DEM_PRE_DEBOUNCE_COUNTER_BASED
        CTC_0xD30582: DemEventID=10, DemEventKind=DEM_EVENT_KIND_SWC, DemImportedEvent=true, DemDTCClassRef=DtcClass44, DemFreezeFrameClassRef=Snapshot_37
          DemEventClass:
            DemEventPriority = 0
            DemFFPrestorageSupported = false
            DemHealingAllowed = true
            DemEventDestination = DEM_DTC_ORIGIN_PRIMARY_MEMORY
            DemHealingCycleCounter = 40
            DemHealingCycleRef = DEM_IGNITION
            DemOperationCycleRef = DEM_IGNITION
            DemPredebounceAlgorithmClass
              DemPreDebounceCounterBased: DemCountInStepSize=0, DemCountOutStepSize=0, DemJumpDown=false, DemJumpUp=true, DemPreDebounceName=DEM_PRE_DEBOUNCE_COUNTER_BASED
        CTC_0xD30583: DemEventID=9, DemEventKind=DEM_EVENT_KIND_SWC, DemImportedEvent=true, DemDTCClassRef=DtcClass45, DemFreezeFrameClassRef=Snapshot_38
          DemEventClass:
            DemEventPriority = 0
            DemFFPrestorageSupported = false
            DemHealingAllowed = true
            DemEventDestination = DEM_DTC_ORIGIN_PRIMARY_MEMORY
            DemHealingCycleCounter = 40
            DemHealingCycleRef = DEM_IGNITION
            DemOperationCycleRef = DEM_IGNITION
            DemPredebounceAlgorithmClass
              DemPreDebounceCounterBased: DemCountInStepSize=0, DemCountOutStepSize=0, DemJumpDown=false, DemJumpUp=true, DemPreDebounceName=DEM_PRE_DEBOUNCE_COUNTER_BASED
        CTC_0xD21881: DemEventID=13, DemEventKind=DEM_EVENT_KIND_SWC, DemImportedEvent=true, DemDTCClassRef=DtcClass46, DemFreezeFrameClassRef=Snapshot_34
          DemEventClass:
            DemEventPriority = 0
            DemFFPrestorageSupported = false
            DemHealingAllowed = true
            DemEventDestination = DEM_DTC_ORIGIN_PRIMARY_MEMORY
            DemHealingCycleCounter = 40
            DemHealingCycleRef = DEM_IGNITION
            DemOperationCycleRef = DEM_IGNITION
            DemPredebounceAlgorithmClass
              DemPreDebounceCounterBased: DemCountInStepSize=0, DemCountOutStepSize=0, DemJumpDown=false, DemJumpUp=true, DemPreDebounceName=DEM_PRE_DEBOUNCE_COUNTER_BASED
        CTC_0xD11D87: DemEventID=17, DemEventKind=DEM_EVENT_KIND_SWC, DemImportedEvent=true, DemDTCClassRef=DtcClass47, DemFreezeFrameClassRef=Snapshot_30
          DemEventClass:
            DemEventPriority = 0
            DemFFPrestorageSupported = false
            DemHealingAllowed = true
            DemEventDestination = DEM_DTC_ORIGIN_PRIMARY_MEMORY
            DemHealingCycleCounter = 40
            DemHealingCycleRef = DEM_IGNITION
            DemOperationCycleRef = DEM_IGNITION
            DemPredebounceAlgorithmClass
              DemPreDebounceCounterBased: DemCountInStepSize=0, DemCountOutStepSize=0, DemJumpDown=false, DemJumpUp=true, DemPreDebounceName=DEM_PRE_DEBOUNCE_COUNTER_BASED
        CTC_0xD21D81: DemEventID=12, DemEventKind=DEM_EVENT_KIND_SWC, DemImportedEvent=true, DemDTCClassRef=DtcClass48, DemFreezeFrameClassRef=Snapshot_35
          DemEventClass:
            DemEventPriority = 0
            DemFFPrestorageSupported = false
            DemHealingAllowed = true
            DemEventDestination = DEM_DTC_ORIGIN_PRIMARY_MEMORY
            DemHealingCycleCounter = 40
            DemHealingCycleRef = DEM_IGNITION
            DemOperationCycleRef = DEM_IGNITION
            DemPredebounceAlgorithmClass
              DemPreDebounceCounterBased: DemCountInStepSize=0, DemCountOutStepSize=0, DemJumpDown=false, DemJumpUp=true, DemPreDebounceName=DEM_PRE_DEBOUNCE_COUNTER_BASED
        CTC_0xD31D82: DemEventID=2, DemEventKind=DEM_EVENT_KIND_SWC, DemImportedEvent=true, DemDTCClassRef=DtcClass49, DemFreezeFrameClassRef=Snapshot_45
          DemEventClass:
            DemEventPriority = 0
            DemFFPrestorageSupported = false
            DemHealingAllowed = true
            DemEventDestination = DEM_DTC_ORIGIN_PRIMARY_MEMORY
            DemHealingCycleCounter = 40
            DemHealingCycleRef = DEM_IGNITION
            DemOperationCycleRef = DEM_IGNITION
            DemPredebounceAlgorithmClass
              DemPreDebounceCounterBased: DemCountInStepSize=0, DemCountOutStepSize=0, DemJumpDown=false, DemJumpUp=true, DemPreDebounceName=DEM_PRE_DEBOUNCE_COUNTER_BASED
        CTC_0xD31D83: DemEventID=1, DemEventKind=DEM_EVENT_KIND_SWC, DemImportedEvent=true, DemDTCClassRef=DtcClass50, DemFreezeFrameClassRef=Snapshot_46
          DemEventClass:
            DemEventPriority = 0
            DemFFPrestorageSupported = false
            DemHealingAllowed = true
            DemEventDestination = DEM_DTC_ORIGIN_PRIMARY_MEMORY
            DemHealingCycleCounter = 40
            DemHealingCycleRef = DEM_IGNITION
            DemOperationCycleRef = DEM_IGNITION
            DemPredebounceAlgorithmClass
              DemPreDebounceCounterBased: DemCountInStepSize=0, DemCountOutStepSize=0, DemJumpDown=false, DemJumpUp=true, DemPreDebounceName=DEM_PRE_DEBOUNCE_COUNTER_BASED
        CANTRCV_E_NO_TRCV_CONTROL: DemEventID=48, DemEventKind=DEM_EVENT_KIND_BSW, DemImportedEvent=false, DemDTCClassRef=DtcClass0
          DemEventClass:
            DemEventPriority = 0
            DemFFPrestorageSupported = false
            DemHealingAllowed = false
            DemHealingCycleCounter = 1
            DemHealingCycleRef = (unset)
            DemOperationCycleRef = DEM_IGNITION
            DemPredebounceAlgorithmClass
              DemPreDebounceCounterBased: DemCountInStepSize=1, DemCountOutStepSize=1, DemJumpDown=false, DemJumpUp=true, DemPreDebounceName=DEM_PRE_DEBOUNCE_COUNTER_BASED
        PDUR_E_PDU_INSTANCE_LOST: DemEventID=49, DemEventKind=DEM_EVENT_KIND_BSW, DemImportedEvent=false, DemDTCClassRef=DtcClass1
          DemEventClass:
            DemEventPriority = 0
            DemFFPrestorageSupported = false
            DemHealingAllowed = false
            DemHealingCycleCounter = 1
            DemHealingCycleRef = (unset)
            DemOperationCycleRef = DEM_IGNITION
            DemPredebounceAlgorithmClass
              DemPreDebounceCounterBased: DemCountInStepSize=1, DemCountOutStepSize=1, DemJumpDown=false, DemJumpUp=true, DemPreDebounceName=DEM_PRE_DEBOUNCE_COUNTER_BASED
        PDUR_E_INIT_FAILED: DemEventID=50, DemEventKind=DEM_EVENT_KIND_BSW, DemImportedEvent=false, DemDTCClassRef=DtcClass2
          DemEventClass:
            DemEventPriority = 0
            DemFFPrestorageSupported = false
            DemHealingAllowed = false
            DemHealingCycleCounter = 1
            DemHealingCycleRef = (unset)
            DemOperationCycleRef = DEM_IGNITION
            DemPredebounceAlgorithmClass
              DemPreDebounceCounterBased: DemCountInStepSize=1, DemCountOutStepSize=1, DemJumpDown=false, DemJumpUp=true, DemPreDebounceName=DEM_PRE_DEBOUNCE_COUNTER_BASED
        COMM_E_NET_START_IND_CHANNEL_0: DemEventID=51, DemEventKind=DEM_EVENT_KIND_BSW, DemImportedEvent=false, DemDTCClassRef=DtcClass3
          DemEventClass:
            DemEventPriority = 0
            DemFFPrestorageSupported = false
            DemHealingAllowed = false
            DemHealingCycleCounter = 1
            DemHealingCycleRef = (unset)
            DemOperationCycleRef = DEM_IGNITION
            DemPredebounceAlgorithmClass
              DemPreDebounceCounterBased: DemCountInStepSize=1, DemCountOutStepSize=1, DemJumpDown=false, DemJumpUp=true, DemPreDebounceName=DEM_PRE_DEBOUNCE_COUNTER_BASED
        CAN_E_TIMEOUT: DemEventID=52, DemEventKind=DEM_EVENT_KIND_BSW, DemImportedEvent=false, DemDTCClassRef=DtcClass4
          DemEventClass:
            DemEventPriority = 0
            DemFFPrestorageSupported = false
            DemHealingAllowed = false
            DemHealingCycleCounter = 1
            DemHealingCycleRef = (unset)
            DemOperationCycleRef = DEM_IGNITION
            DemPredebounceAlgorithmClass
              DemPreDebounceCounterBased: DemCountInStepSize=1, DemCountOutStepSize=1, DemJumpDown=false, DemJumpUp=true, DemPreDebounceName=DEM_PRE_DEBOUNCE_COUNTER_BASED
        CANIF_E_INVALID_DLC: DemEventID=53, DemEventKind=DEM_EVENT_KIND_BSW, DemImportedEvent=false, DemDTCClassRef=DtcClass5
          DemEventClass:
            DemEventPriority = 0
            DemFFPrestorageSupported = false
            DemHealingAllowed = false
            DemHealingCycleCounter = 1
            DemHealingCycleRef = (unset)
            DemOperationCycleRef = DEM_IGNITION
            DemPredebounceAlgorithmClass
              DemPreDebounceCounterBased: DemCountInStepSize=1, DemCountOutStepSize=1, DemJumpDown=false, DemJumpUp=true, DemPreDebounceName=DEM_PRE_DEBOUNCE_COUNTER_BASED
        CANSM_E_MODE_CHANGE_NETWORK_0: DemEventID=54, DemEventKind=DEM_EVENT_KIND_BSW, DemImportedEvent=false, DemDTCClassRef=DtcClass6
          DemEventClass:
            DemEventPriority = 0
            DemFFPrestorageSupported = false
            DemHealingAllowed = false
            DemHealingCycleCounter = 1
            DemHealingCycleRef = (unset)
            DemOperationCycleRef = DEM_IGNITION
            DemPredebounceAlgorithmClass
              DemPreDebounceCounterBased: DemCountInStepSize=1, DemCountOutStepSize=1, DemJumpDown=false, DemJumpUp=true, DemPreDebounceName=DEM_PRE_DEBOUNCE_COUNTER_BASED
        CANSM_E_MODE_CHANGE_NETWORK_1: DemEventID=55, DemEventKind=DEM_EVENT_KIND_BSW, DemImportedEvent=false, DemDTCClassRef=DtcClass7
          DemEventClass:
            DemEventPriority = 0
            DemFFPrestorageSupported = false
            DemHealingAllowed = false
            DemHealingCycleCounter = 1
            DemHealingCycleRef = (unset)
            DemOperationCycleRef = DEM_IGNITION
            DemPredebounceAlgorithmClass
              DemPreDebounceCounterBased: DemCountInStepSize=1, DemCountOutStepSize=1, DemJumpDown=false, DemJumpUp=true, DemPreDebounceName=DEM_PRE_DEBOUNCE_COUNTER_BASED
        CANSM_E_BUSOFF_NETWORK_0: DemEventID=56, DemEventKind=DEM_EVENT_KIND_BSW, DemImportedEvent=false, DemDTCClassRef=DtcClass8
          DemEventClass:
            DemEventPriority = 0
            DemFFPrestorageSupported = false
            DemHealingAllowed = false
            DemHealingCycleCounter = 1
            DemHealingCycleRef = (unset)
            DemOperationCycleRef = DEM_IGNITION
            DemPredebounceAlgorithmClass
              DemPreDebounceCounterBased: DemCountInStepSize=1, DemCountOutStepSize=1, DemJumpDown=false, DemJumpUp=true, DemPreDebounceName=DEM_PRE_DEBOUNCE_COUNTER_BASED
        CANSM_E_BUSOFF_NETWORK_1: DemEventID=57, DemEventKind=DEM_EVENT_KIND_BSW, DemImportedEvent=false, DemDTCClassRef=DtcClass9
          DemEventClass:
            DemEventPriority = 0
            DemFFPrestorageSupported = false
            DemHealingAllowed = false
            DemHealingCycleCounter = 1
            DemHealingCycleRef = (unset)
            DemOperationCycleRef = DEM_IGNITION
            DemPredebounceAlgorithmClass
              DemPreDebounceCounterBased: DemCountInStepSize=1, DemCountOutStepSize=1, DemJumpDown=false, DemJumpUp=true, DemPreDebounceName=DEM_PRE_DEBOUNCE_COUNTER_BASED
        CANSM_E_SETTRANSCEIVERMODE_NETWORK_0: DemEventID=58, DemEventKind=DEM_EVENT_KIND_BSW, DemImportedEvent=false, DemDTCClassRef=DtcClass10
          DemEventClass:
            DemEventPriority = 0
            DemFFPrestorageSupported = false
            DemHealingAllowed = false
            DemHealingCycleCounter = 1
            DemHealingCycleRef = (unset)
            DemOperationCycleRef = DEM_IGNITION
            DemPredebounceAlgorithmClass
              DemPreDebounceCounterBased: DemCountInStepSize=1, DemCountOutStepSize=1, DemJumpDown=false, DemJumpUp=true, DemPreDebounceName=DEM_PRE_DEBOUNCE_COUNTER_BASED
        CANSM_E_SETTRANSCEIVERMODE_NETWORK_1: DemEventID=59, DemEventKind=DEM_EVENT_KIND_BSW, DemImportedEvent=false, DemDTCClassRef=DtcClass11
          DemEventClass:
            DemEventPriority = 0
            DemFFPrestorageSupported = false
            DemHealingAllowed = false
            DemHealingCycleCounter = 1
            DemHealingCycleRef = (unset)
            DemOperationCycleRef = DEM_IGNITION
            DemPredebounceAlgorithmClass
              DemPreDebounceCounterBased: DemCountInStepSize=1, DemCountOutStepSize=1, DemJumpDown=false, DemJumpUp=true, DemPreDebounceName=DEM_PRE_DEBOUNCE_COUNTER_BASED
        LINSM_E_CONFIRMATION_TIMEOUT: DemEventID=60, DemEventKind=DEM_EVENT_KIND_BSW, DemImportedEvent=false, DemDTCClassRef=DtcClass12
          DemEventClass:
            DemEventPriority = 0
            DemFFPrestorageSupported = false
            DemHealingAllowed = false
            DemHealingCycleCounter = 1
            DemHealingCycleRef = (unset)
            DemOperationCycleRef = DEM_IGNITION
            DemPredebounceAlgorithmClass
              DemPreDebounceCounterBased: DemCountInStepSize=1, DemCountOutStepSize=1, DemJumpDown=false, DemJumpUp=true, DemPreDebounceName=DEM_PRE_DEBOUNCE_COUNTER_BASED
        COMM_E_NET_START_IND_CHANNEL_1: DemEventID=61, DemEventKind=DEM_EVENT_KIND_BSW, DemImportedEvent=false, DemDTCClassRef=DtcClass13
          DemEventClass:
            DemEventPriority = 0
            DemFFPrestorageSupported = false
            DemHealingAllowed = false
            DemHealingCycleCounter = 1
            DemHealingCycleRef = (unset)
            DemOperationCycleRef = DEM_IGNITION
            DemPredebounceAlgorithmClass
              DemPreDebounceCounterBased: DemCountInStepSize=1, DemCountOutStepSize=1, DemJumpDown=false, DemJumpUp=true, DemPreDebounceName=DEM_PRE_DEBOUNCE_COUNTER_BASED
        COMM_E_NET_START_IND_CHANNEL_2: DemEventID=62, DemEventKind=DEM_EVENT_KIND_BSW, DemImportedEvent=false, DemDTCClassRef=DtcClass14
          DemEventClass:
            DemEventPriority = 0
            DemFFPrestorageSupported = false
            DemHealingAllowed = false
            DemHealingCycleCounter = 1
            DemHealingCycleRef = (unset)
            DemOperationCycleRef = DEM_IGNITION
            DemPredebounceAlgorithmClass
              DemPreDebounceCounterBased: DemCountInStepSize=1, DemCountOutStepSize=1, DemJumpDown=false, DemJumpUp=true, DemPreDebounceName=DEM_PRE_DEBOUNCE_COUNTER_BASED
        ECUM_E_ALL_RUN_REQUESTS_KILLED: DemEventID=63, DemEventKind=DEM_EVENT_KIND_BSW, DemImportedEvent=false, DemDTCClassRef=DtcClass15
          DemEventClass:
            DemEventPriority = 0
            DemFFPrestorageSupported = false
            DemHealingAllowed = false
            DemHealingCycleCounter = 1
            DemHealingCycleRef = (unset)
            DemOperationCycleRef = DEM_IGNITION
            DemPredebounceAlgorithmClass
              DemPreDebounceCounterBased: DemCountInStepSize=1, DemCountOutStepSize=1, DemJumpDown=false, DemJumpUp=true, DemPreDebounceName=DEM_PRE_DEBOUNCE_COUNTER_BASED
        ECUM_E_RAM_CHECKED_FAILED: DemEventID=64, DemEventKind=DEM_EVENT_KIND_BSW, DemImportedEvent=false, DemDTCClassRef=DtcClass16
          DemEventClass:
            DemEventPriority = 0
            DemFFPrestorageSupported = false
            DemHealingAllowed = false
            DemHealingCycleCounter = 1
            DemHealingCycleRef = (unset)
            DemOperationCycleRef = DEM_IGNITION
            DemPredebounceAlgorithmClass
              DemPreDebounceCounterBased: DemCountInStepSize=1, DemCountOutStepSize=1, DemJumpDown=false, DemJumpUp=true, DemPreDebounceName=DEM_PRE_DEBOUNCE_COUNTER_BASED
        FLS_E_ERASE_FAILED: DemEventID=67, DemEventKind=DEM_EVENT_KIND_BSW, DemImportedEvent=false, DemDTCClassRef=DtcClass19
          DemEventClass:
            DemEventPriority = 0
            DemFFPrestorageSupported = false
            DemHealingAllowed = false
            DemHealingCycleCounter = 1
            DemHealingCycleRef = (unset)
            DemOperationCycleRef = DEM_IGNITION
            DemPredebounceAlgorithmClass
              DemPreDebounceCounterBased: DemCountInStepSize=1, DemCountOutStepSize=1, DemJumpDown=false, DemJumpUp=true, DemPreDebounceName=DEM_PRE_DEBOUNCE_COUNTER_BASED
        FLS_E_WRITE_FAILED: DemEventID=68, DemEventKind=DEM_EVENT_KIND_BSW, DemImportedEvent=false, DemDTCClassRef=DtcClass20
          DemEventClass:
            DemEventPriority = 0
            DemFFPrestorageSupported = false
            DemHealingAllowed = false
            DemHealingCycleCounter = 1
            DemHealingCycleRef = (unset)
            DemOperationCycleRef = DEM_IGNITION
            DemPredebounceAlgorithmClass
              DemPreDebounceCounterBased: DemCountInStepSize=1, DemCountOutStepSize=1, DemJumpDown=false, DemJumpUp=true, DemPreDebounceName=DEM_PRE_DEBOUNCE_COUNTER_BASED
        FLS_E_READ_FAILED: DemEventID=69, DemEventKind=DEM_EVENT_KIND_BSW, DemImportedEvent=false, DemDTCClassRef=DtcClass21
          DemEventClass:
            DemEventPriority = 0
            DemFFPrestorageSupported = false
            DemHealingAllowed = false
            DemHealingCycleCounter = 1
            DemHealingCycleRef = (unset)
            DemOperationCycleRef = DEM_IGNITION
            DemPredebounceAlgorithmClass
              DemPreDebounceCounterBased: DemCountInStepSize=1, DemCountOutStepSize=1, DemJumpDown=false, DemJumpUp=true, DemPreDebounceName=DEM_PRE_DEBOUNCE_COUNTER_BASED
        FLS_E_COMPARE_FAILED: DemEventID=70, DemEventKind=DEM_EVENT_KIND_BSW, DemImportedEvent=false, DemDTCClassRef=DtcClass22
          DemEventClass:
            DemEventPriority = 0
            DemFFPrestorageSupported = false
            DemHealingAllowed = false
            DemHealingCycleCounter = 1
            DemHealingCycleRef = (unset)
            DemOperationCycleRef = DEM_IGNITION
            DemPredebounceAlgorithmClass
              DemPreDebounceCounterBased: DemCountInStepSize=1, DemCountOutStepSize=1, DemJumpDown=false, DemJumpUp=true, DemPreDebounceName=DEM_PRE_DEBOUNCE_COUNTER_BASED
        FRIF_E_JLE_SYNC: DemEventID=71, DemEventKind=DEM_EVENT_KIND_BSW, DemImportedEvent=false, DemDTCClassRef=DtcClass23
          DemEventClass:
            DemEventPriority = 0
            DemFFPrestorageSupported = false
            DemHealingAllowed = false
            DemHealingCycleCounter = 1
            DemHealingCycleRef = (unset)
            DemOperationCycleRef = DEM_IGNITION
            DemPredebounceAlgorithmClass
              DemPreDebounceCounterBased: DemCountInStepSize=1, DemCountOutStepSize=1, DemJumpDown=false, DemJumpUp=true, DemPreDebounceName=DEM_PRE_DEBOUNCE_COUNTER_BASED
        FRNM_E_INIT_FAILED: DemEventID=72, DemEventKind=DEM_EVENT_KIND_BSW, DemImportedEvent=false, DemDTCClassRef=DtcClass24
          DemEventClass:
            DemEventPriority = 0
            DemFFPrestorageSupported = false
            DemHealingAllowed = false
            DemHealingCycleCounter = 1
            DemHealingCycleRef = (unset)
            DemOperationCycleRef = DEM_IGNITION
            DemPredebounceAlgorithmClass
              DemPreDebounceCounterBased: DemCountInStepSize=1, DemCountOutStepSize=1, DemJumpDown=false, DemJumpUp=true, DemPreDebounceName=DEM_PRE_DEBOUNCE_COUNTER_BASED
        FRSM_E_CLUSTER_STARTUP: DemEventID=73, DemEventKind=DEM_EVENT_KIND_BSW, DemImportedEvent=false, DemDTCClassRef=DtcClass25
          DemEventClass:
            DemEventPriority = 0
            DemFFPrestorageSupported = false
            DemHealingAllowed = false
            DemHealingCycleCounter = 1
            DemHealingCycleRef = (unset)
            DemOperationCycleRef = DEM_IGNITION
            DemPredebounceAlgorithmClass
              DemPreDebounceCounterBased: DemCountInStepSize=1, DemCountOutStepSize=1, DemJumpDown=false, DemJumpUp=true, DemPreDebounceName=DEM_PRE_DEBOUNCE_COUNTER_BASED
        FRTRCV_E_FR_NO_TRCV_CONTROL: DemEventID=74, DemEventKind=DEM_EVENT_KIND_BSW, DemImportedEvent=false, DemDTCClassRef=DtcClass26
          DemEventClass:
            DemEventPriority = 0
            DemFFPrestorageSupported = false
            DemHealingAllowed = false
            DemHealingCycleCounter = 1
            DemHealingCycleRef = (unset)
            DemOperationCycleRef = DEM_IGNITION
            DemPredebounceAlgorithmClass
              DemPreDebounceCounterBased: DemCountInStepSize=1, DemCountOutStepSize=1, DemJumpDown=false, DemJumpUp=true, DemPreDebounceName=DEM_PRE_DEBOUNCE_COUNTER_BASED
        CTC_0x050192: DemEventID=47, DemEventKind=DEM_EVENT_KIND_SWC, DemImportedEvent=true, DemDTCClassRef=DtcClass51, DemFreezeFrameClassRef=Snapshot
          DemEventClass:
            DemEventPriority = 0
            DemFFPrestorageSupported = false
            DemHealingAllowed = true
            DemEventDestination = DEM_DTC_ORIGIN_PRIMARY_MEMORY
            DemHealingCycleCounter = 40
            DemHealingCycleRef = DEM_IGNITION
            DemOperationCycleRef = DEM_IGNITION
            DemPredebounceAlgorithmClass
              DemPreDebounceCounterBased: DemCountInStepSize=0, DemCountOutStepSize=0, DemJumpDown=false, DemJumpUp=true, DemPreDebounceName=DEM_PRE_DEBOUNCE_COUNTER_BASED
      DEM_DTC_GROUP_EMISSION_REL_DTCS (DemGroupOfDTC): DemGroupDTCs=(unset)
      DEM_DTC_GROUP_POWERTRAIN_DTCS (DemGroupOfDTC): DemGroupDTCs=1
      24 x DemEventParameter, all with DemEventKind=DEM_EVENT_KIND_SWC, DemImportedEvent=true:
        CTC_0x510A51: DemEventID=46, DemInitMonitorName=(unset), DemExtendedDataRef=(unset), DemDTCClassRef=DtcClass52, DemFreezeFrameClassRef=Snapshot_1
          DemEventClass:
            DemEventPriority = 0
            DemFFPrestorageSupported = false
            DemHealingAllowed = true
            DemEventDestination = DEM_DTC_ORIGIN_PRIMARY_MEMORY
            DemHealingCycleCounter = 40
            DemHealingCycleRef = DEM_IGNITION
            DemOperationCycleRef = DEM_IGNITION
            DemPredebounceAlgorithmClass
              DemPreDebounceCounterBased: DemJumpUp=true, DemJumpDown=false, DemCountOutStepSize=0, DemCountInStepSize=0, DemPreDebounceName=DEM_PRE_DEBOUNCE_COUNTER_BASED
            DemIndicator0 (DemIndicatorAttribute): DemIndicatorBehaviour=1, DemLinkedIndicator=ETATDA2
        CTC_0x510BA1: DemEventID=45, DemInitMonitorName=(unset), DemExtendedDataRef=(unset), DemDTCClassRef=DtcClass53, DemFreezeFrameClassRef=Snapshot_2
          DemEventClass:
            DemEventPriority = 0
            DemFFPrestorageSupported = false
            DemHealingAllowed = true
            DemEventDestination = DEM_DTC_ORIGIN_PRIMARY_MEMORY
            DemHealingCycleCounter = 40
            DemHealingCycleRef = DEM_IGNITION
            DemOperationCycleRef = DEM_IGNITION
            DemPredebounceAlgorithmClass
              DemPreDebounceCounterBased: DemJumpUp=true, DemJumpDown=false, DemCountOutStepSize=0, DemCountInStepSize=0, DemPreDebounceName=DEM_PRE_DEBOUNCE_COUNTER_BASED
        CTC_0x510BA2: DemEventID=44, DemInitMonitorName=(unset), DemExtendedDataRef=(unset), DemDTCClassRef=DtcClass54, DemFreezeFrameClassRef=Snapshot_3
          DemEventClass:
            DemEventPriority = 0
            DemFFPrestorageSupported = false
            DemHealingAllowed = true
            DemEventDestination = DEM_DTC_ORIGIN_PRIMARY_MEMORY
            DemHealingCycleCounter = 40
            DemHealingCycleRef = DEM_IGNITION
            DemOperationCycleRef = DEM_IGNITION
            DemPredebounceAlgorithmClass
              DemPreDebounceCounterBased: DemJumpUp=true, DemJumpDown=false, DemCountOutStepSize=0, DemCountInStepSize=0, DemPreDebounceName=DEM_PRE_DEBOUNCE_COUNTER_BASED
            DemIndicator0 (DemIndicatorAttribute): DemIndicatorBehaviour=1, DemLinkedIndicator=ETATDA2
        CTC_0x510BA3: DemEventID=43, DemInitMonitorName=(unset), DemExtendedDataRef=(unset), DemDTCClassRef=DtcClass55, DemFreezeFrameClassRef=Snapshot_4
          DemEventClass:
            DemEventPriority = 0
            DemFFPrestorageSupported = false
            DemHealingAllowed = true
            DemEventDestination = DEM_DTC_ORIGIN_PRIMARY_MEMORY
            DemHealingCycleCounter = 40
            DemHealingCycleRef = DEM_IGNITION
            DemOperationCycleRef = DEM_IGNITION
            DemPredebounceAlgorithmClass
              DemPreDebounceCounterBased: DemJumpUp=true, DemJumpDown=false, DemCountOutStepSize=0, DemCountInStepSize=0, DemPreDebounceName=DEM_PRE_DEBOUNCE_COUNTER_BASED
            DemIndicator0 (DemIndicatorAttribute): DemIndicatorBehaviour=1, DemLinkedIndicator=ETATDA2
        CTC_0x510C01: DemEventID=42, DemInitMonitorName=(unset), DemExtendedDataRef=(unset), DemDTCClassRef=DtcClass56, DemFreezeFrameClassRef=Snapshot_5
          DemEventClass:
            DemEventPriority = 0
            DemFFPrestorageSupported = false
            DemHealingAllowed = true
            DemEventDestination = DEM_DTC_ORIGIN_PRIMARY_MEMORY
            DemHealingCycleCounter = 40
            DemHealingCycleRef = DEM_IGNITION
            DemOperationCycleRef = DEM_IGNITION
            DemPredebounceAlgorithmClass
              DemPreDebounceCounterBased: DemJumpUp=true, DemJumpDown=false, DemCountOutStepSize=0, DemCountInStepSize=0, DemPreDebounceName=DEM_PRE_DEBOUNCE_COUNTER_BASED
            DemIndicator0 (DemIndicatorAttribute): DemIndicatorBehaviour=1, DemLinkedIndicator=ETATDA2
        CTC_0x510C04: DemEventID=41, DemInitMonitorName=(unset), DemExtendedDataRef=(unset), DemDTCClassRef=DtcClass57, DemFreezeFrameClassRef=Snapshot_6
          DemEventClass:
            DemEventPriority = 0
            DemFFPrestorageSupported = false
            DemHealingAllowed = true
            DemEventDestination = DEM_DTC_ORIGIN_PRIMARY_MEMORY
            DemHealingCycleCounter = 40
            DemHealingCycleRef = DEM_IGNITION
            DemOperationCycleRef = DEM_IGNITION
            DemPredebounceAlgorithmClass
              DemPreDebounceCounterBased: DemJumpUp=true, DemJumpDown=false, DemCountOutStepSize=0, DemCountInStepSize=0, DemPreDebounceName=DEM_PRE_DEBOUNCE_COUNTER_BASED
            DemIndicator0 (DemIndicatorAttribute): DemIndicatorBehaviour=1, DemLinkedIndicator=ETATDA2
        CTC_0x510C1C: DemEventID=40, DemInitMonitorName=(unset), DemExtendedDataRef=(unset), DemDTCClassRef=DtcClass58, DemFreezeFrameClassRef=Snapshot_7
          DemEventClass:
            DemEventPriority = 0
            DemFFPrestorageSupported = false
            DemHealingAllowed = true
            DemEventDestination = DEM_DTC_ORIGIN_PRIMARY_MEMORY
            DemHealingCycleCounter = 40
            DemHealingCycleRef = DEM_IGNITION
            DemOperationCycleRef = DEM_IGNITION
            DemPredebounceAlgorithmClass
              DemPreDebounceCounterBased: DemJumpUp=true, DemJumpDown=false, DemCountOutStepSize=0, DemCountInStepSize=0, DemPreDebounceName=DEM_PRE_DEBOUNCE_COUNTER_BASED
            DemIndicator0 (DemIndicatorAttribute): DemIndicatorBehaviour=1, DemLinkedIndicator=ETATDA2
        CTC_0x510C43: DemEventID=39, DemInitMonitorName=(unset), DemExtendedDataRef=(unset), DemDTCClassRef=DtcClass59, DemFreezeFrameClassRef=Snapshot_8
          DemEventClass:
            DemEventPriority = 0
            DemFFPrestorageSupported = false
            DemHealingAllowed = true
            DemEventDestination = DEM_DTC_ORIGIN_PRIMARY_MEMORY
            DemHealingCycleCounter = 40
            DemHealingCycleRef = DEM_IGNITION
            DemOperationCycleRef = DEM_IGNITION
            DemPredebounceAlgorithmClass
              DemPreDebounceCounterBased: DemJumpUp=true, DemJumpDown=false, DemCountOutStepSize=0, DemCountInStepSize=0, DemPreDebounceName=DEM_PRE_DEBOUNCE_COUNTER_BASED
            DemIndicator0 (DemIndicatorAttribute): DemIndicatorBehaviour=1, DemLinkedIndicator=ETATDA2
        CTC_0x510C62: DemEventID=38, DemInitMonitorName=(unset), DemExtendedDataRef=(unset), DemDTCClassRef=DtcClass60, DemFreezeFrameClassRef=Snapshot_9
          DemEventClass:
            DemEventPriority = 0
            DemFFPrestorageSupported = false
            DemHealingAllowed = true
            DemEventDestination = DEM_DTC_ORIGIN_PRIMARY_MEMORY
            DemHealingCycleCounter = 40
            DemHealingCycleRef = DEM_IGNITION
            DemOperationCycleRef = DEM_IGNITION
            DemPredebounceAlgorithmClass
              DemPreDebounceCounterBased: DemJumpUp=true, DemJumpDown=false, DemCountOutStepSize=0, DemCountInStepSize=0, DemPreDebounceName=DEM_PRE_DEBOUNCE_COUNTER_BASED
            DemIndicator0 (DemIndicatorAttribute): DemIndicatorBehaviour=1, DemLinkedIndicator=ETATDA2
        CTC_0x510C96: DemEventID=37, DemInitMonitorName=(unset), DemExtendedDataRef=(unset), DemDTCClassRef=DtcClass61, DemFreezeFrameClassRef=Snapshot_10
          DemEventClass:
            DemEventPriority = 0
            DemFFPrestorageSupported = false
            DemHealingAllowed = true
            DemEventDestination = DEM_DTC_ORIGIN_PRIMARY_MEMORY
            DemHealingCycleCounter = 40
            DemHealingCycleRef = DEM_IGNITION
            DemOperationCycleRef = DEM_IGNITION
            DemPredebounceAlgorithmClass
              DemPreDebounceCounterBased: DemJumpUp=true, DemJumpDown=false, DemCountOutStepSize=0, DemCountInStepSize=0, DemPreDebounceName=DEM_PRE_DEBOUNCE_COUNTER_BASED
            DemIndicator0 (DemIndicatorAttribute): DemIndicatorBehaviour=1, DemLinkedIndicator=ETATDA2
        CTC_0x510C98: DemEventID=36, DemInitMonitorName=(unset), DemExtendedDataRef=(unset), DemDTCClassRef=DtcClass62, DemFreezeFrameClassRef=Snapshot_11
          DemEventClass:
            DemEventPriority = 0
            DemFFPrestorageSupported = false
            DemHealingAllowed = true
            DemEventDestination = DEM_DTC_ORIGIN_PRIMARY_MEMORY
            DemHealingCycleCounter = 40
            DemHealingCycleRef = DEM_IGNITION
            DemOperationCycleRef = DEM_IGNITION
            DemPredebounceAlgorithmClass
              DemPreDebounceCounterBased: DemJumpUp=true, DemJumpDown=false, DemCountOutStepSize=0, DemCountInStepSize=0, DemPreDebounceName=DEM_PRE_DEBOUNCE_COUNTER_BASED
            DemIndicator0 (DemIndicatorAttribute): DemIndicatorBehaviour=1, DemLinkedIndicator=ETATDA2
        CTC_0x539855: DemEventID=31, DemInitMonitorName=(unset), DemExtendedDataRef=(unset), DemDTCClassRef=DtcClass63, DemFreezeFrameClassRef=Snapshot_16
          DemEventClass:
            DemEventPriority = 0
            DemFFPrestorageSupported = false
            DemHealingAllowed = true
            DemEventDestination = DEM_DTC_ORIGIN_PRIMARY_MEMORY
            DemHealingCycleCounter = 40
            DemHealingCycleRef = DEM_IGNITION
            DemOperationCycleRef = DEM_IGNITION
            DemPredebounceAlgorithmClass
              DemPreDebounceCounterBased: DemJumpUp=true, DemJumpDown=false, DemCountOutStepSize=0, DemCountInStepSize=0, DemPreDebounceName=DEM_PRE_DEBOUNCE_COUNTER_BASED
            DemIndicator0 (DemIndicatorAttribute): DemIndicatorBehaviour=1, DemLinkedIndicator=ETATDA2
        CTC_0x540C00: DemEventID=28, DemInitMonitorName=(unset), DemExtendedDataRef=(unset), DemDTCClassRef=DtcClass64, DemFreezeFrameClassRef=Snapshot_19
          DemEventClass:
            DemEventPriority = 0
            DemFFPrestorageSupported = false
            DemHealingAllowed = true
            DemEventDestination = DEM_DTC_ORIGIN_PRIMARY_MEMORY
            DemHealingCycleCounter = 40
            DemHealingCycleRef = DEM_IGNITION
            DemOperationCycleRef = DEM_IGNITION
            DemPredebounceAlgorithmClass
              DemPreDebounceCounterBased: DemJumpUp=true, DemJumpDown=false, DemCountOutStepSize=0, DemCountInStepSize=0, DemPreDebounceName=DEM_PRE_DEBOUNCE_COUNTER_BASED
        CTC_0x55668F: DemEventID=26, DemInitMonitorName=(unset), DemExtendedDataRef=(unset), DemDTCClassRef=DtcClass65, DemFreezeFrameClassRef=Snapshot_21
          DemEventClass:
            DemEventPriority = 0
            DemFFPrestorageSupported = false
            DemHealingAllowed = true
            DemEventDestination = DEM_DTC_ORIGIN_PRIMARY_MEMORY
            DemHealingCycleCounter = 40
            DemHealingCycleRef = DEM_IGNITION
            DemOperationCycleRef = DEM_IGNITION
            DemPredebounceAlgorithmClass
              DemPreDebounceCounterBased: DemJumpUp=true, DemJumpDown=false, DemCountOutStepSize=0, DemCountInStepSize=0, DemPreDebounceName=DEM_PRE_DEBOUNCE_COUNTER_BASED
        CTC_0x540D00: DemEventID=27, DemInitMonitorName=(unset), DemExtendedDataRef=(unset), DemDTCClassRef=DtcClass66, DemFreezeFrameClassRef=Snapshot_20
          DemEventClass:
            DemEventPriority = 0
            DemFFPrestorageSupported = false
            DemHealingAllowed = true
            DemEventDestination = DEM_DTC_ORIGIN_PRIMARY_MEMORY
            DemHealingCycleCounter = 40
            DemHealingCycleRef = DEM_IGNITION
            DemOperationCycleRef = DEM_IGNITION
            DemPredebounceAlgorithmClass
              DemPreDebounceCounterBased: DemJumpUp=true, DemJumpDown=false, DemCountOutStepSize=0, DemCountInStepSize=0, DemPreDebounceName=DEM_PRE_DEBOUNCE_COUNTER_BASED
        CTC_0x564404: DemEventID=24, DemInitMonitorName=(unset), DemExtendedDataRef=(unset), DemDTCClassRef=DtcClass67, DemFreezeFrameClassRef=Snapshot_23
          DemEventClass:
            DemEventPriority = 0
            DemFFPrestorageSupported = false
            DemHealingAllowed = true
            DemEventDestination = DEM_DTC_ORIGIN_PRIMARY_MEMORY
            DemHealingCycleCounter = 40
            DemHealingCycleRef = DEM_IGNITION
            DemOperationCycleRef = DEM_IGNITION
            DemPredebounceAlgorithmClass
              DemPreDebounceCounterBased: DemJumpUp=true, DemJumpDown=false, DemCountOutStepSize=0, DemCountInStepSize=0, DemPreDebounceName=DEM_PRE_DEBOUNCE_COUNTER_BASED
        CTC_0x513662: DemEventID=35, DemInitMonitorName=(unset), DemExtendedDataRef=(unset), DemDTCClassRef=DtcClass68, DemFreezeFrameClassRef=Snapshot_12
          DemEventClass:
            DemEventPriority = 0
            DemFFPrestorageSupported = false
            DemHealingAllowed = true
            DemEventDestination = DEM_DTC_ORIGIN_PRIMARY_MEMORY
            DemHealingCycleCounter = 40
            DemHealingCycleRef = DEM_IGNITION
            DemOperationCycleRef = DEM_IGNITION
            DemPredebounceAlgorithmClass
              DemPreDebounceCounterBased: DemJumpUp=true, DemJumpDown=false, DemCountOutStepSize=0, DemCountInStepSize=0, DemPreDebounceName=DEM_PRE_DEBOUNCE_COUNTER_BASED
        CTC_0x520DA2: DemEventID=33, DemInitMonitorName=(unset), DemExtendedDataRef=(unset), DemDTCClassRef=DtcClass69, DemFreezeFrameClassRef=Snapshot_14
          DemEventClass:
            DemEventPriority = 0
            DemFFPrestorageSupported = false
            DemHealingAllowed = true
            DemEventDestination = DEM_DTC_ORIGIN_PRIMARY_MEMORY
            DemHealingCycleCounter = 40
            DemHealingCycleRef = DEM_IGNITION
            DemOperationCycleRef = DEM_IGNITION
            DemPredebounceAlgorithmClass
              DemPreDebounceCounterBased: DemJumpUp=true, DemJumpDown=false, DemCountOutStepSize=0, DemCountInStepSize=0, DemPreDebounceName=DEM_PRE_DEBOUNCE_COUNTER_BASED
        CTC_0x520E00: DemEventID=32, DemInitMonitorName=(unset), DemExtendedDataRef=(unset), DemDTCClassRef=DtcClass70, DemFreezeFrameClassRef=Snapshot_15
          DemEventClass:
            DemEventPriority = 0
            DemFFPrestorageSupported = false
            DemHealingAllowed = true
            DemEventDestination = DEM_DTC_ORIGIN_PRIMARY_MEMORY
            DemHealingCycleCounter = 40
            DemHealingCycleRef = DEM_IGNITION
            DemOperationCycleRef = DEM_IGNITION
            DemPredebounceAlgorithmClass
              DemPreDebounceCounterBased: DemJumpUp=true, DemJumpDown=false, DemCountOutStepSize=0, DemCountInStepSize=0, DemPreDebounceName=DEM_PRE_DEBOUNCE_COUNTER_BASED
        CTC_0xD31308: DemEventID=7, DemInitMonitorName=(unset), DemExtendedDataRef=(unset), DemDTCClassRef=DtcClass71, DemFreezeFrameClassRef=Snapshot_40
          DemEventClass:
            DemEventPriority = 0
            DemFFPrestorageSupported = false
            DemHealingAllowed = true
            DemEventDestination = DEM_DTC_ORIGIN_PRIMARY_MEMORY
            DemHealingCycleCounter = 40
            DemHealingCycleRef = DEM_IGNITION
            DemOperationCycleRef = DEM_IGNITION
            DemPredebounceAlgorithmClass
              DemPreDebounceCounterBased: DemJumpUp=true, DemJumpDown=false, DemCountOutStepSize=0, DemCountInStepSize=0, DemPreDebounceName=DEM_PRE_DEBOUNCE_COUNTER_BASED
        CTC_0xD30508: DemEventID=11, DemDTCClassRef=DtcClass72, DemFreezeFrameClassRef=Snapshot_36
          DemEventClass:
            DemEventPriority = 0
            DemFFPrestorageSupported = false
            DemHealingAllowed = true
            DemEventDestination = DEM_DTC_ORIGIN_PRIMARY_MEMORY
            DemHealingCycleCounter = 40
            DemHealingCycleRef = DEM_IGNITION
            DemOperationCycleRef = DEM_IGNITION
            DemPredebounceAlgorithmClass
              DemPreDebounceCounterBased: DemJumpUp=true, DemJumpDown=false, DemCountOutStepSize=0, DemCountInStepSize=0, DemPreDebounceName=DEM_PRE_DEBOUNCE_COUNTER_BASED
        CTC_0xD30808: DemEventID=8, DemDTCClassRef=DtcClass73, DemFreezeFrameClassRef=Snapshot_39
          DemEventClass:
            DemEventPriority = 0
            DemFFPrestorageSupported = false
            DemHealingAllowed = true
            DemEventDestination = DEM_DTC_ORIGIN_PRIMARY_MEMORY
            DemHealingCycleCounter = 40
            DemHealingCycleRef = DEM_IGNITION
            DemOperationCycleRef = DEM_IGNITION
            DemPredebounceAlgorithmClass
              DemPreDebounceCounterBased: DemJumpUp=true, DemJumpDown=false, DemCountOutStepSize=0, DemCountInStepSize=0, DemPreDebounceName=DEM_PRE_DEBOUNCE_COUNTER_BASED
        CTC_0xD31808: DemEventID=4, DemDTCClassRef=DtcClass74, DemFreezeFrameClassRef=Snapshot_43
          DemEventClass:
            DemEventPriority = 0
            DemFFPrestorageSupported = false
            DemHealingAllowed = true
            DemEventDestination = DEM_DTC_ORIGIN_PRIMARY_MEMORY
            DemHealingCycleCounter = 40
            DemHealingCycleRef = DEM_IGNITION
            DemOperationCycleRef = DEM_IGNITION
            DemPredebounceAlgorithmClass
              DemPreDebounceCounterBased: DemJumpUp=true, DemJumpDown=false, DemCountOutStepSize=0, DemCountInStepSize=0, DemPreDebounceName=DEM_PRE_DEBOUNCE_COUNTER_BASED
        CTC_0xD31D08: DemEventID=3, DemDTCClassRef=DtcClass75, DemFreezeFrameClassRef=Snapshot_44
          DemEventClass:
            DemEventPriority = 0
            DemFFPrestorageSupported = false
            DemHealingAllowed = true
            DemEventDestination = DEM_DTC_ORIGIN_PRIMARY_MEMORY
            DemHealingCycleCounter = 40
            DemHealingCycleRef = DEM_IGNITION
            DemOperationCycleRef = DEM_IGNITION
            DemPredebounceAlgorithmClass
              DemPreDebounceCounterBased: DemJumpUp=true, DemJumpDown=false, DemCountOutStepSize=0, DemCountInStepSize=0, DemPreDebounceName=DEM_PRE_DEBOUNCE_COUNTER_BASED
    DemGeneral:
      DemBswErrorBufferSize = 52
      DemDevErrorDetect = true
      DemDtcStatusAvailabilityMask = 255
      DemFFDataIDLength = 2
      DemMaxNumberEventEntryMir = 20
      DemMaxNumberEventEntryPrm = 35
      DemMaxNumberEventEntrySec = 0
      DemNvmAccessRetry = 0
      DemNvmAccessRetryTimeDelay = 0
      DemVersionInfoApi = true
      DemAddErrorBufferSize = 1
      DemSnapshotsPerDTC = 1
      DemUseRte = true
      DemPostbuildStartAddress = 0
      DemUseDcmCompatiblePorts = false
      DemUserConfigFile = (unset)
      DemVariantModeSelection = SIMPLE_ECU
      DemPreInitHasConfigParam = false
      DemSoftwareComponentName = Dem
      DemSupportGetEventIdApi = false
      DemMaxNumberPrestoredFF = 0
      DemTaskTime = 10
      DemTypeOfDTCSupported = 1
      DemTimeBasedDebouncingDataType = TIME_BASED_DEBOUNCING_16_BIT
      Snapshot (DemFreezeFrameClass):
        DemFreezeFrameKind = (unset)
        DemFreezeFrameRecordNum = 1
        DemFreezeFrameIdClassRef = DID_0xd401
        DemFreezeFrameIdClassRef = DID_0xd{403..405}
        DemFreezeFrameIdClassRef = DID_0xd{407..409}
        DemFreezeFrameIdClassRef = DID_0xd40b
        DemFreezeFrameIdClassRef = DID_0xd40c
        DemFreezeFrameIdClassRef = DID_0xd40d
        DemFreezeFrameIdClassRef = DID_0xd40f
        DemFreezeFrameIdClassRef = DID_0xd410
        DemFreezeFrameIdClassRef = DID_0xd412
        DemFreezeFrameIdClassRef = DID_0xd414
        DemFreezeFrameIdClassRef = DID_0xd415
        DemFreezeFrameIdClassRef = DID_0xd418
        DemFreezeFrameIdClassRef = DID_0xd41b
      4 x DemOperationCycleTgt:
        DEM_IGNITION: DemOperationCycle=DEM_IGNITION
        DEM_OBD_DCY: DemOperationCycle=DEM_OBD_DCY
        DEM_POWER: DemOperationCycle=DEM_POWER
        DEM_WARMUP: DemOperationCycle=DEM_WARMUP
      46 x DemFreezeFrameClass, all with DemFreezeFrameKind=(unset), DemFreezeFrameRecordNum=1, DemFreezeFrameIdClassRef=DID_0xd401, DemFreezeFrameIdClassRef=DID_0xd403, DemFreezeFrameIdClassRef=DID_0xd404, DemFreezeFrameIdClassRef=DID_0xd405, DemFreezeFrameIdClassRef=DID_0xd407, DemFreezeFrameIdClassRef=DID_0xd408, DemFreezeFrameIdClassRef=DID_0xd409, DemFreezeFrameIdClassRef=DID_0xd40b, DemFreezeFrameIdClassRef=DID_0xd40c, DemFreezeFrameIdClassRef=DID_0xd40d, DemFreezeFrameIdClassRef=DID_0xd40f, DemFreezeFrameIdClassRef=DID_0xd410, DemFreezeFrameIdClassRef=DID_0xd412, DemFreezeFrameIdClassRef=DID_0xd414, DemFreezeFrameIdClassRef=DID_0xd415, DemFreezeFrameIdClassRef=DID_0xd418, DemFreezeFrameIdClassRef=DID_0xd41b:
        Snapshot_{1..46}
      12 x DemFreezeFrameIdClass, all with DemCreatePortInterface=true:
        DID_0xd401: DemDataID=54273, DemFreezeFrameIdDataSize=3
          DemGetDataValByDataIdTgt: DemGetDataValByDataIdTgtRef=CBValByDID_0xd401
        DID_0xd403: DemDataID=54275, DemFreezeFrameIdDataSize=2
          DemGetDataValByDataIdTgt: DemGetDataValByDataIdTgtRef=CBValByDID_0xd403
        DID_0xd404: DemDataID=54276, DemFreezeFrameIdDataSize=1
          DemGetDataValByDataIdTgt: DemGetDataValByDataIdTgtRef=CBValByDID_0xd404
        DID_0xd405: DemDataID=54277, DemFreezeFrameIdDataSize=1
          DemGetDataValByDataIdTgt: DemGetDataValByDataIdTgtRef=CBValByDID_0xd405
        DID_0xd407: DemDataID=54279, DemFreezeFrameIdDataSize=1
          DemGetDataValByDataIdTgt: DemGetDataValByDataIdTgtRef=CBValByDID_0xd407
        DID_0xd408: DemDataID=54280, DemFreezeFrameIdDataSize=1
          DemGetDataValByDataIdTgt: DemGetDataValByDataIdTgtRef=CBValByDID_0xd408
        DID_0xd409: DemDataID=54281, DemFreezeFrameIdDataSize=1
          DemGetDataValByDataIdTgt: DemGetDataValByDataIdTgtRef=CBValByDID_0xd409
        DID_0xd40b: DemDataID=54283, DemFreezeFrameIdDataSize=3
          DemGetDataValByDataIdTgt: DemGetDataValByDataIdTgtRef=CBValByDID_0xd40b
        DID_0xd40d: DemDataID=54285, DemFreezeFrameIdDataSize=2
          DemGetDataValByDataIdTgt: DemGetDataValByDataIdTgtRef=CBValByDID_0xd40d
        DID_0xd40f: DemDataID=54287, DemFreezeFrameIdDataSize=1
          DemGetDataValByDataIdTgt: DemGetDataValByDataIdTgtRef=CBValByDID_0xd40f
        DID_0xd410: DemDataID=54288, DemFreezeFrameIdDataSize=1
          DemGetDataValByDataIdTgt: DemGetDataValByDataIdTgtRef=CBValByDID_0xd410
        DID_0xd414: DemDataID=54292, DemFreezeFrameIdDataSize=1
          DemGetDataValByDataIdTgt: DemGetDataValByDataIdTgtRef=CBValByDID_0xd414
      12 x DemGetDataValByDataId:
        CBValByDID_0xd401: DemGetDataValByDataIdListFnc=CBValByDID_0xd401
        CBValByDID_0xd{403..405}: DemGetDataValByDataIdListFnc=CBValByDID_0xd{403..405}
        CBValByDID_0xd{407..409}: DemGetDataValByDataIdListFnc=CBValByDID_0xd{407..409}
        CBValByDID_0xd40b: DemGetDataValByDataIdListFnc=CBValByDID_0xd40b
        CBValByDID_0xd40d: DemGetDataValByDataIdListFnc=CBValByDID_0xd40d
        CBValByDID_0xd40f: DemGetDataValByDataIdListFnc=CBValByDID_0xd40f
        CBValByDID_0xd410: DemGetDataValByDataIdListFnc=CBValByDID_0xd410
        CBValByDID_0xd414: DemGetDataValByDataIdListFnc=CBValByDID_0xd414
      ETATDA2 (DemIndicator): DemIndicatorID=0
      NVM_BLOCK_DEM_CTCSTRG (DemNvramBlockId): DemNvramBlockIdUsageType=DEM_NVRAM_BLOCK_CORE, DemNvramBlockIdRef=NvM/NVM_BLOCK_DEM_CTCSTRG
      CBDTCStatusChange_FaultLog (DemTriggerOnDTCStatusTgt): DemTrigOnDTCStatusFnc=CBDTCStatusChange_FaultLog
      CBDTCStatusChange_DemIf (DemTriggerOnDTCStatusTgt): DemTrigOnDTCStatusFnc=CBDTCStatusChange_DemIf
      5 x DemFreezeFrameIdClass, all with DemCreatePortInterface=true:
        DID_0xd40c: DemFreezeFrameIdDataSize=1, DemDataID=54284
          DemGetDataValByDataIdTgt: DemGetDataValByDataIdTgtRef=CBValByDID_0xd40c
        DID_0xd412: DemFreezeFrameIdDataSize=1, DemDataID=54290
          DemGetDataValByDataIdTgt: DemGetDataValByDataIdTgtRef=CBValByDID_0xd412
        DID_0xd415: DemFreezeFrameIdDataSize=1, DemDataID=54293
          DemGetDataValByDataIdTgt: DemGetDataValByDataIdTgtRef=CBValByDID_0xd415
        DID_0xd418: DemFreezeFrameIdDataSize=2, DemDataID=54296
          DemGetDataValByDataIdTgt: DemGetDataValByDataIdTgtRef=CBValByDID_0xd418
        DID_0xd41b: DemFreezeFrameIdDataSize=1, DemDataID=54299
          DemGetDataValByDataIdTgt: DemGetDataValByDataIdTgtRef=CBValByDID_0xd41b
      5 x DemGetDataValByDataId:
        CBValByDID_0xd40c: DemGetDataValByDataIdListFnc=CBValByDID_0xd40c
        CBValByDID_0xd412: DemGetDataValByDataIdListFnc=CBValByDID_0xd412
        CBValByDID_0xd415: DemGetDataValByDataIdListFnc=CBValByDID_0xd415
        CBValByDID_0xd418: DemGetDataValByDataIdListFnc=CBValByDID_0xd418
        CBValByDID_0xd41b: DemGetDataValByDataIdListFnc=CBValByDID_0xd41b
    VectorCommonData: BswmdVersion=2.14.00
  module config Mcu: implementation-config-variant=VARIANT-POST-BUILD, module-description=Mcu_Impl  # Configuration of the Mcu (Microcontroler Unit) module.
    McuGeneralConfiguration:
      McuBank0Pwr = ActiveMode
      McuBank1Pwr = ActiveMode
      McuBank{2..6}Pwr = SleepMode
      McuBank7Pwr = ActiveMode
      McuDevErrorDetect = false
      McuPerformResetApi = true
      McuVersionInfoApi = true
      McuDoParamCheck = true
      McuCheckParamConfig = true
      McuCheckParamMode = true
      McuCheckParamClock = true
      McuCheckParamRamSection = true
      McuCheckVersionInfo = true
      McuCheckUninit = true
      McuCheckPllStatus = true
      McuDevErrorReport = true
      McuErrorHook = Det_ReportError
      McuIncludeDet = Det.h
      McuProdErrorReport = true
      McuUseInitRamApi = false
      McuCopyTrimFromOtp = true
      McuSraEnabled = true
      McuSraOnlyForWrite = true
      McuSraOnlyForPrivModeRegs = true
      McuSraNotInInit = false
      McuErrataFmzPll17Workaround = false
      McuIrqHandling = SuspendAllInterrupts
      McuMemInit:
        McuInitMibSpiP1Ram = true
        McuInitMibSpiP3Ram = true
        McuInitMibSpiP5Ram = true
        McuInitDcan{1..3}Ram = true
        McuInitMibAdc1Ram = true
        McuInitMibAdc2Ram = true
        McuInitNhet1Ram = true
        McuInitNhet2Ram = true
        McuInitHetTu1Ram = true
        McuInitHetTu2Ram = true
        McuInitDmaRam = true
        McuInitVimRam = false
        McuInitFlexRayTuRam = true
      McuPeripheralSelect:
        McuUseMibSpiP1 = true
        McuUseSpiP2 = true
        McuUseMibSpiP3 = true
        McuUseSpiP4 = true
        McuUseMibSpiP5 = true
        McuUseLin = true
        McuUseSci = true
        McuUseDcan{1..3} = true
        McuUseI2c = true
        McuUseFlexRay = true
        McuUseFlexRayTu = true
        McuUseMibAdc1 = true
        McuUseMibAdc2 = true
        McuUseGio = true
        McuUseNhet1 = true
        McuUseNhet2 = true
        McuUseHetTu1 = true
        McuUseHetTu2 = true
        McuUseDmm = false
    McuModuleConfiguration: McuClockSrcFailureNotification=DISABLED
      McuClockSettingConfig
        McuClockReferencePoint: McuClockReferencePointFrequency=20
        McuLpo:
          McuLpoEnableBias = true
          McuLpoTrimLow = Trim100Comma00Percent
          McuLpoTrimHigh = Trim100Comma00Percent
          McuLpoLowref = 80
          McuLpoHighref = 100
          McuLpoLowfreq = 0.08
          McuLpoHighfreq = 10
        PLL (McuPllConfig):
          McuPllRefClkDiv = 6
          McuPllOdDiv = 2
          McuPllRDiv = 1
          McuPllMul = 96
          McuPllIntClk = 2.5
          McuPllOutputClk = 320
          McuPllFreq = 160
          McuPllFmBwadj = 8
          McuPllFmMode = FM_Disabled
          McuPllFmNs = 1
          McuPllFmFs = 1.667
          McuPllFmNv = 1
          McuPllFmDepth = 0
          McuPllResetOnPllSlip = true
          McuPllBypassOnPllSlip = true
          McuPllResetOnOsciFail = true
        PLL2 (McuPll2Config): McuPll2RefClkDiv=5, McuPll2OdDiv=5, McuPll2RDiv=1, McuPll2Mul=100, McuPll2IntClk=4, McuPll2OutputClk=400, McuPll2Freq=80
        ExtClkIn (McuExtClocks): McuExtClk1Freq=80, McuExtClk2Freq=80
        McuClocks
          McuClockSrc:
            McuUseOsciClk = true
            McuUsePllClk = true
            McuUse32KhzOsciClk = false
            McuUseExtClk1 = false
            McuUseLpoLow = true
            McuUseLpoHigh = true
            McuUsePll2Clk = false
            McuUseExtClk2 = false
            McuUseGclk = true
            McuUseHclk = true
            McuUseVclkp = true
            McuUseVclk2 = true
            McuUseVclka1 = true
            McuUseVclka2 = true
            McuUseRtiClk1 = true
            McuUseVclk3 = true
            McuUseVclka4 = true
            McuUseVclka4Pre = false
            McuVclka1 = Vclk
            McuVclka2 = Vclk
            McuVclka4 = Vclk
            McuVclka4r = DivderbyOne
            McuRti1Div = DivderbyOne
            McuAVclk1Freq = 80
            McuAVclk2Freq = 80
            McuAVclk4sFreq = 80
            McuAVclk4divrFreq = 80
            McuRTI1Freq = 80
            McuRti1Src = Vclk
          ClockDomains (McuClockDomains):
            McuEclkSelector = VCLK
            McuEclkPrescaler = 0
            McuEclkSuspendMode = true
            McuGclkFreq = 160
            McuHclkFreq = 160
            McuVclkFreq = 80
            McuVclk2Freq = 80
            McuVclk3Freq = 80
            McuFrdCntlAswsten = 1
            McuFrdCntlRwait = 3
            McuGhvwake = PLL
            McuHvlpm = PLL
            McuGhvsrc = PLL
            McuTreeVclkDiv = 2
            McuTreeVclk2Div = 2
            McuTreeVclk3Div = 2
      McuModeConf (McuModeSettingConf): McuPowerMode=DozeMode, McuMode=0
      McuRamConf (McuRamSectorSettingConf): McuRamDefaultValue=0, McuRamBaseAddress=134217728, McuRamSectionSize=81920, McuCopyRomToRam=false, McuRomBaseAddress=0
  module config EtDmpFw: implementation-config-variant=VARIANT-POST-BUILD  # Configuration of the Nexteer EtDmpFw module.
    EtDmpFwGeneral
    CommonPublishedInformation: ArMajorVersion=3, ArMinorVersion=2, ArPatchVersion=0, SwMajorVersion=0, SwMinorVersion=0, SwPatchVersion=0, ModuleId=0, VendorId=0
  module config BkCpPc: implementation-config-variant=VARIANT-POST-BUILD  # Configuration of the Nexteer BkCpPc module.
    BkCpPcGeneral: BkCpPcPwrDiscConfiguration=1
    CommonPublishedInformation: ArMajorVersion=3, ArMinorVersion=2, ArPatchVersion=0, SwMajorVersion=0, SwMinorVersion=0, SwPatchVersion=0, ModuleId=0, VendorId=0
  module config NvMMgr: implementation-config-variant=VARIANT-POST-BUILD  # Configuration of the Nexteer NvM Manager module.
    NvMMgrGeneral: EcuStartupApp=Ap_6, NvMandMemIfApp=Ap_6
    CommonPublishedInformation: ArMajorVersion=3, ArMinorVersion=2, ArPatchVersion=0, SwMajorVersion=0, SwMinorVersion=0, SwPatchVersion=0, ModuleId=0, VendorId=0
  module config DigMSB: implementation-config-variant=VARIANT-POST-BUILD  # Configuration of the Nexteer DigMSB module.
    DigMSBGeneral
    CommonPublishedInformation: ArMajorVersion=3, ArMinorVersion=2, ArPatchVersion=0, SwMajorVersion=0, SwMinorVersion=0, SwPatchVersion=0, ModuleId=0, VendorId=0
  module config DigMSBSigCorr: implementation-config-variant=VARIANT-POST-BUILD  # Configuration of the Nexteer DigMSBSigCorr module.
    DigMSBSigCorrGeneral
    CommonPublishedInformation: ArMajorVersion=3, ArMinorVersion=2, ArPatchVersion=0, SwMajorVersion=0, SwMinorVersion=0, SwPatchVersion=0, ModuleId=0, VendorId=0
  module config DigHwTrqSENT: implementation-config-variant=VARIANT-POST-BUILD  # Configuration of the Nexteer DigHwTrqSENT module.
    DigHwTrqSENTGeneral
    CommonPublishedInformation: ArMajorVersion=3, ArMinorVersion=2, ArPatchVersion=0, SwMajorVersion=0, SwMinorVersion=0, SwPatchVersion=0, ModuleId=0, VendorId=0
  module config AbsHwPos: implementation-config-variant=VARIANT-POST-BUILD  # Configuration of the Nexteer AbsHwPos module.
    AbsHwPosGeneral
    CommonPublishedInformation: ArMajorVersion=3, ArMinorVersion=2, ArPatchVersion=0, SwMajorVersion=0, SwMinorVersion=0, SwPatchVersion=0, ModuleId=0, VendorId=0
  module config Sweep: implementation-config-variant=VARIANT-POST-BUILD  # Configuration of the Nexteer Sweep module.
    SweepGeneral
    CommonPublishedInformation: ArMajorVersion=3, ArMinorVersion=2, ArPatchVersion=0, SwMajorVersion=0, SwMinorVersion=0, SwPatchVersion=0, ModuleId=0, VendorId=0
  module config Sweep2: implementation-config-variant=VARIANT-POST-BUILD  # Configuration of the Nexteer Sweep2 module.
    Sweep2General
    CommonPublishedInformation: ArMajorVersion=3, ArMinorVersion=2, ArPatchVersion=0, SwMajorVersion=0, SwMinorVersion=0, SwPatchVersion=0, ModuleId=0, VendorId=0
  module config SpiNxt: implementation-config-variant=VARIANT-PRE-COMPILE  # Configuration of the Nexteer SPI handler driver module
    SpiNxtGeneral: SpiNxtUseWith=D_SPINXT_USEWITHDIGMSB, SpiNxtUseDMA=STD_ON
  module config ComplErr: implementation-config-variant=VARIANT-POST-BUILD  # Configuration of the Nexteer ComplErr module.
    ComplErrGeneral
    CommonPublishedInformation: ArMajorVersion=3, ArMinorVersion=2, ArPatchVersion=0, SwMajorVersion=0, SwMinorVersion=0, SwPatchVersion=0, ModuleId=0, VendorId=0
  module config VehDyn: implementation-config-variant=VARIANT-POST-BUILD  # Configuration of the Nexteer VehDyn module.
    VehDynGeneral
    CommonPublishedInformation: ArMajorVersion=3, ArMinorVersion=2, ArPatchVersion=0, SwMajorVersion=0, SwMinorVersion=0, SwPatchVersion=0, ModuleId=0, VendorId=0
  module config ApXcp: implementation-config-variant=VARIANT-POST-BUILD  # Configuration of the Nexteer Xcp module.
    XcpGeneral: ExternalEEPROMAccess=STD_OFF, XcpIncludes=NtWrap.h, XcpRteEvents=XcpEventChannel_2ms_DAQ_2
    XcpMemoryAccess
      Flash (InternalMemoryRng): IntMemRngLow=0, IntMemRngHigh=786431
      RAM (InternalMemoryRng): IntMemRngLow=134217728, IntMemRngHigh=134348799
    RamCopy
    TuneOnTheFly: TuneOnTheFlySupport=STD_ON, RamBlockSize=9216, TuneOnTheFlyIncludes=CalConstants.h
      Seg0_Pers: Seg0Enable=STD_OFF, MaxPerCopy=1, CalConstNumOfPerSymbol=D_NUMOFPERS_CNT_U16, TuneOnTheFlyPersLkup=STD_OFF
      Seg1_Sets: Seg1Enable=STD_ON, MaxSetCopy=1, CalConstNumOfSetSymbol=D_NUMOFTUNSETS_CNT_U16, TuneOnTheFlySetLkup=STD_OFF
      Seg2_Common: Seg2Enable=STD_OFF
      Seg3_SetAndPer: Seg3Enable=STD_OFF
      Seg4_SetAndPerAndCommon: Seg4Enable=STD_OFF
    CommonPublishedInformation: ArMajorVersion=3, ArMinorVersion=2, ArPatchVersion=0, SwMajorVersion=0, SwMinorVersion=0, SwPatchVersion=0, ModuleId=0, VendorId=0
  module config NvMProxy: implementation-config-variant=VARIANT-PRE-COMPILE  # Configuration of the NvM Proxy module
    NvMProxyConfigSet
      23 x NvMProxyBlock:
        ShCurrCal: NvmRamBlockDataAddressSecure=Rte_CmMtrCurr_ShCurrCal, InitBlockHandling=CRC16, InitCheckFailResponse=SetNTC_0x07_LoadROMDefaults, ROMDefault_Or_NotificationFunction_Symbol=T_ShCurrCalInit_Cnt_str, NvMRamGlobalShared=false, NvmBlockDescriptorRef=Rte_NvmBlock_CmMtrCurr_ShCurrCal
        TorqueCmdSF: NvmRamBlockDataAddressSecure=Rte_TrqCmdScl_TorqueCmdSF_Uls_f32, InitBlockHandling=Redundant, InitCheckFailResponse=SetNTC_0x07_LoadROMDefaults, ROMDefault_Or_NotificationFunction_Symbol=T_TorqueCmdSFInit_Uls_f32, NvMRamGlobalShared=false, NvmBlockDescriptorRef=Rte_NvmBlock_TrqCmdScl_TorqueCmdSF_Uls_f32
        Polarity: NvmRamBlockDataAddressSecure=Rte_Ap_CtrlPolarityBrshlss_Polarity_Cnt_Str, InitBlockHandling=None, InitCheckFailResponse=N/A, ROMDefault_Or_NotificationFunction_Symbol=NULL_PTR, NvMRamGlobalShared=false, NvmBlockDescriptorRef=Rte_NvmBlock_Polarity_Polarity_Cnt_Str
        CloseCheckData: NvmRamBlockDataAddressSecure=CloseCheck_Cnt_u32, InitBlockHandling=None, InitCheckFailResponse=N/A, ROMDefault_Or_NotificationFunction_Symbol=NULL_PTR, NvMRamGlobalShared=false, NvmBlockDescriptorRef=Rte_NvmBlock_StaMd_CloseCheckData
        TypeHRamBuffer: NvmRamBlockDataAddressSecure=TypeHData_Cnt_u08, InitBlockHandling=None, InitCheckFailResponse=N/A, ROMDefault_Or_NotificationFunction_Symbol=NULL_PTR, NvMRamGlobalShared=true, NvmBlockDescriptorRef=Rte_NvmBlock_StaMd_TypeHRamBuffer
        CogTrqCal: NvmRamBlockDataAddressSecure=Rte_TrqCanc_CogTrqCal, InitBlockHandling=CRC16, InitCheckFailResponse=SetNTC_0x07_LoadROMDefaults, ROMDefault_Or_NotificationFunction_Symbol=T_CogTrqCalInit_Cnt_u16, NvMRamGlobalShared=false, NvmBlockDescriptorRef=Rte_NvmBlock_TrqCanc_CogTrqCal
        EOLNomMtrParam: NvmRamBlockDataAddressSecure=Rte_CurrParamComp_EOLNomMtrParam, InitBlockHandling=None, InitCheckFailResponse=N/A, ROMDefault_Or_NotificationFunction_Symbol=NULL_PTR, NvMRamGlobalShared=false, NvmBlockDescriptorRef=Rte_NvmBlock_CurrParamComp_EOLNomMtrParam
        DigMSBEOLData: NvmRamBlockDataAddressSecure=Rte_DigMSB_DigMSBEOLData, InitBlockHandling=None, InitCheckFailResponse=N/A, ROMDefault_Or_NotificationFunction_Symbol=NULL_PTR, NvMRamGlobalShared=false, NvmBlockDescriptorRef=Rte_NvmBlock_Sa_DigMSB_DigMSBEOLData
        EOLVehCntrOffset: NvmRamBlockDataAddressSecure=Rte_AbsHwPos_EOLVehCntrOffset, InitBlockHandling=ZeroData, InitCheckFailResponse=N/A, ROMDefault_Or_NotificationFunction_Symbol=NULL_PTR, NvMRamGlobalShared=false, NvmBlockDescriptorRef=Rte_NvmBlock_AbsHwPos_EOLVehCntrOffset
        CogTrqRplComp: NvmRamBlockDataAddressSecure=Rte_TrqCanc_CogTrqRplComp, InitBlockHandling=CRC16, InitCheckFailResponse=SetNTC_0x07_LoadROMDefaults, ROMDefault_Or_NotificationFunction_Symbol=T_CogTrqRplCompInit_Cnt_u16, NvMRamGlobalShared=false, NvmBlockDescriptorRef=Rte_NvmBlock_TrqCanc_CogTrqRplComp
        CurrTempOffset: NvmRamBlockDataAddressSecure=Rte_CmMtrCurr_CurrTempOffset, InitBlockHandling=ZeroData, InitCheckFailResponse=N/A, ROMDefault_Or_NotificationFunction_Symbol=NULL_PTR, NvMRamGlobalShared=false, NvmBlockDescriptorRef=Rte_NvmBlock_CmMtrCurr_CurrTempOffset
        LearnedEOT: NvmRamBlockDataAddressSecure=Rte_LrnEOT_LearnedEOT, InitBlockHandling=CRC16, InitCheckFailResponse=SetNTC_0x06_LoadROMDefaults, ROMDefault_Or_NotificationFunction_Symbol=T_LearnedEOTInit_Cnt_str, NvMRamGlobalShared=false, NvmBlockDescriptorRef=Rte_NvmBlock_LrnEOT_LearnedEOT
        AvgFricLrnData: NvmRamBlockDataAddressSecure=Rte_AvgFricLrn_AvgFricLrnData, InitBlockHandling=CRC16, InitCheckFailResponse=SetNTC_0x06_LoadROMDefaults, ROMDefault_Or_NotificationFunction_Symbol=T_AvgFricLrnDataInit_Cnt_str, NvMRamGlobalShared=false, NvmBlockDescriptorRef=Rte_NvmBlock_AvgFricLrn_AvgFricLrnData
        OvervoltageData: NvmRamBlockDataAddressSecure=Rte_BatteryVoltage_OvervoltageData, InitBlockHandling=None, InitCheckFailResponse=N/A, ROMDefault_Or_NotificationFunction_Symbol=NULL_PTR, NvMRamGlobalShared=false, NvmBlockDescriptorRef=Rte_NvmBlock_BatteryVoltage_OvervoltageData
        FltStVal: NvmRamBlockDataAddressSecure=Rte_ThrmlDutyCycle_ThrmlDutyCycle_FltStVal, InitBlockHandling=None, InitCheckFailResponse=N/A, ROMDefault_Or_NotificationFunction_Symbol=NULL_PTR, NvMRamGlobalShared=false, NvmBlockDescriptorRef=Rte_NvmBlock_ThrmlDutyCycle_ThrmlDutyCycle_FltStVal
        MotPosReset: NvmRamBlockDataAddressSecure=Rte_VehDyn_MotPosReset, InitBlockHandling=None, InitCheckFailResponse=N/A, ROMDefault_Or_NotificationFunction_Symbol=NULL_PTR, NvMRamGlobalShared=false, NvmBlockDescriptorRef=Rte_NvmBlock_VehDyn_MotPosReset
        VVHTYPEData: NvmRamBlockDataAddressSecure=Rte_SrlComInput_VVHTYPEData, InitBlockHandling=None, InitCheckFailResponse=N/A, ROMDefault_Or_NotificationFunction_Symbol=NULL_PTR, NvMRamGlobalShared=false, NvmBlockDescriptorRef=Rte_NvmBlock_SrlComInput_VVHTYPEData
        ElecIntData: NvmRamBlockDataAddressSecure=Rte_SrlComInput_ElecIntData, InitBlockHandling=None, InitCheckFailResponse=N/A, ROMDefault_Or_NotificationFunction_Symbol=NULL_PTR, NvMRamGlobalShared=false, NvmBlockDescriptorRef=Rte_NvmBlock_SrlComInput_ElecIntData
        ShutdownTimeData: NvmRamBlockDataAddressSecure=Rte_SrlComInput_ShutdownTimeData, InitBlockHandling=None, InitCheckFailResponse=N/A, ROMDefault_Or_NotificationFunction_Symbol=NULL_PTR, NvMRamGlobalShared=false, NvmBlockDescriptorRef=Rte_NvmBlock_SrlComInput_ShutdownTimeData
        HwTqCorrlnCh1CMCLPFSvData: NvmRamBlockDataAddressSecure=Rte_HwTqCorrln_HwTqCorrlnCh1CMCLPFSvData, InitBlockHandling=None, InitCheckFailResponse=N/A, ROMDefault_Or_NotificationFunction_Symbol=NULL_PTR, NvMRamGlobalShared=false, NvmBlockDescriptorRef=Rte_NvmBlock_HwTqCorrln_HwTqCorrlnCh1CMCLPFSvData
        HwTqArbnEOLCh1OffsetTrimData: NvmRamBlockDataAddressSecure=Rte_HwTqArbn_HwTqArbnEOLCh1OffsetTrimData, InitBlockHandling=CRC16, InitCheckFailResponse=SetNTC_0x0A, ROMDefault_Or_NotificationFunction_Symbol=NULL_PTR, NvMRamGlobalShared=false, NvmBlockDescriptorRef=Rte_NvmBlock_HwTqArbn_HwTqArbnEOLCh1OffsetTrimData
        PsaAgArbnPsaAgArbnLrndOffsData: NvmRamBlockDataAddressSecure=Rte_PsaAgArbn_PsaAgArbnLrndOffsData, InitBlockHandling=None, InitCheckFailResponse=N/A, ROMDefault_Or_NotificationFunction_Symbol=NULL_PTR, NvMRamGlobalShared=false, NvmBlockDescriptorRef=Rte_NvmBlock_PsaAgArbn_PsaAgArbnLrndOffsData
        ActivePullPullCmpLTComp: NvmRamBlockDataAddressSecure=Rte_ActivePull_PullCmpLTComp_HwNm_f32, InitBlockHandling=None, InitCheckFailResponse=N/A, ROMDefault_Or_NotificationFunction_Symbol=NULL_PTR, NvMRamGlobalShared=false, NvmBlockDescriptorRef=Rte_NvmBlock_ActivePull_PullCmpLTComp_HwNm_f32
    NvMProxyGeneral: NvMProxyIncludes=Ap_StaMd_Cfg.h, FailureAPI=NxtrDiagMgr10_ReportNTCStatus, NvMProxyDevErrorDetect=false
    CommonPublishedInformation: ArMajorVersion=1, ArMinorVersion=2, ArPatchVersion=0, SwMajorVersion=1, SwMinorVersion=0, SwPatchVersion=0, ModuleId=104, VendorId=0
  module config GenyBaseEnv: module-description=GenyBaseEnv_Impl
    GenyBaseEnvGeneral: GenyBaseEnvUserConfigFile=..\..\..\Tools\AsrProject\Config\User\Dem_User.cfg, ProjectType=2, NumberOfSubProjects=1
  module config PosServo: implementation-config-variant=VARIANT-POST-BUILD  # Configuration of the Nexteer PosServo module.
    PosServoGeneral
    CommonPublishedInformation: ArMajorVersion=3, ArMinorVersion=2, ArPatchVersion=0, SwMajorVersion=0, SwMinorVersion=0, SwPatchVersion=0, ModuleId=0, VendorId=0
  module config EcuC_Cfg: definition=EcuC
    PduCollection
  module config HOWDetect: implementation-config-variant=VARIANT-POST-BUILD  # Configuration of the Nexteer HOWDetect module.
    HOWDetectGeneral
    CommonPublishedInformation: ArMajorVersion=3, ArMinorVersion=2, ArPatchVersion=0, SwMajorVersion=0, SwMinorVersion=0, SwPatchVersion=0, ModuleId=0, VendorId=0
