[part 1 of 3: package /ActiveEcuC]
AUTOSAR XML (schema 3.0.2)
package /ActiveEcuC
  ecu configuration ActiveEcuC: ecu-extract=System, module=[EcuM, Board, ActivePull, Assist, AssistFirewall, AstLmt, AvgFricLrn, BatteryVoltage, BVDiag, CmMtrCurr, Crc, CtrldDisShtdn, CtrlTemp, CurrCmd, CurrParamComp, Damping, DampingFirewall, DiagMgr, DigPhsReasDiag, Dio, ElePwr, EOTActuatorMng, Fee, FlsTst, FrqDepDmpnInrtCmp, Gpt, HighFreqAssist, HiLoadStall, HwPwUp, HystComp, IoHwAb, LmtCod, LrnEOT, MemIf, MtrDrvDiag, MtrTempEst, MtrVel, MtrVel2, NvM, Os, OvrVoltMon, PeakCurrEst, PICurrCntrl, Port, PwrLmtFuncCr, QuadDet, Return, ReturnFirewall, Rte, ShtdnMech, SignlCondn, StabilityComp, StabilityComp2, StaMd, StOpCtrl, ThrmlDutyCycle, TmprlMon, TmprlMon2, TqRsDg, TrqCanc, TrqCmdScl, TuningSelAuth, uDiag, VehSpdLmt, WdgIf, WdgM, Wdg_internal_TMS570LS3x, Dem, Mcu, EtDmpFw, BkCpPc, NvMMgr, DigMSB, DigMSBSigCorr, DigHwTrqSENT, AbsHwPos, Sweep, Sweep2, SpiNxt, ComplErr, VehDyn, ApXcp, NvMProxy, GenyBaseEnv, PosServo, EcuC_Cfg, HOWDetect]
  module config Board: implementation-config-variant=VARIANT-PRE-COMPILE, module-description=Board_Impl  # Contains all controller-specific parameters for the generator
    BoardGeneral:
      BoardOscillator = 20
      BoardPinsetting = Pin_144
      BoardAtomicBitAccessInBitfield = false
      BoardAtomicVariableAccess = Atomic32BitAccess
      BoardWidthOfPointer = 4
      BoardStructAlignment = Auto
      BoardArrayAlignment = Byte
      BoardStructInArrayAlignment = Byte
      BoardAlignmentFillPattern = 0
      BoardSizeOfPduIdType = Two_Byte
      BoardSizeOfPduLengthType = Two_Byte
      BoardSizeOfEnum = One_Byte
      BoardSizeOfIdType = Two_Byte
      BoardMinObjectSize = 1
      BoardGlobalGPageBehaviour = false
      BoardUseExtendedAsrVersionCheck = false
      BoardPCAndLTCRCCheck = false
      systemVersion = (unset)
      ecuExtractVersion = (unset)
      BoardOsType = Autosar
      BoardDummyFunction = false
      BoardDummyStatement = true
      BoardConditionalGenerating = true
      BoardEnableSnvPrefixes = false
      BoardNhetUnitUsed = NHET1
    InterruptFunctionality: BoardIncludeIsrList=Os.h, BoardUseSchm=true, BoardGlobalReEnableCat1=(unset), BoardGlobalReEnableCat2=(unset)
      4 x InterruptFunctionSet:
        SuspendAllInterrupts: BoardGlobalSuspend=SuspendAllInterrupts(), BoardGlobalRestore=ResumeAllInterrupts(), BoardIncludeFile=Os.h
        SuspendOSInterrupts: BoardGlobalSuspend=SuspendOSInterrupts(), BoardGlobalRestore=ResumeOSInterrupts(), BoardIncludeFile=Os.h
        DisableAllInterrupts: BoardGlobalSuspend=DisableAllInterrupts(), BoardGlobalRestore=EnableAllInterrupts(), BoardIncludeFile=Os.h
        NoCriticalSectionHandling: BoardGlobalSuspend=(unset), BoardGlobalRestore=(unset), BoardIncludeFile=(unset)
  module config ActivePull: implementation-config-variant=VARIANT-PRE-COMPILE  # Configuration of the Nexteer ActivePull module.
    ActivePullGeneral
    CommonPublishedInformation: ArMajorVersion=3, ArMinorVersion=2, ArPatchVersion=0, SwMajorVersion=0, SwMinorVersion=0, SwPatchVersion=0, ModuleId=0, VendorId=0
  module config Assist: implementation-config-variant=VARIANT-PRE-COMPILE  # Configuration of the Nexteer Assist module.
    AssistGeneral
    CommonPublishedInformation: ArMajorVersion=3, ArMinorVersion=2, ArPatchVersion=0, SwMajorVersion=0, SwMinorVersion=0, SwPatchVersion=0, ModuleId=0, VendorId=0
  module config AssistFirewall: implementation-config-variant=VARIANT-PRE-COMPILE  # Configuration of the Nexteer AssistFirewall module.
    AssistFirewallGeneral
    CommonPublishedInformation: ArMajorVersion=3, ArMinorVersion=2, ArPatchVersion=0, SwMajorVersion=0, SwMinorVersion=0, SwPatchVersion=0, ModuleId=0, VendorId=0
  module config AstLmt: implementation-config-variant=VARIANT-PRE-COMPILE  # Configuration of the Nexteer AstLmt module.
    AstLmtGeneral
    CommonPublishedInformation: ArMajorVersion=3, ArMinorVersion=2, ArPatchVersion=0, SwMajorVersion=0, SwMinorVersion=0, SwPatchVersion=0, ModuleId=0, VendorId=0
  module config AvgFricLrn: implementation-config-variant=VARIANT-PRE-COMPILE  # Configuration of the Nexteer AvgFricLrn module.
    AvgFricLrnGeneral
    CommonPublishedInformation: ArMajorVersion=3, ArMinorVersion=2, ArPatchVersion=0, SwMajorVersion=0, SwMinorVersion=0, SwPatchVersion=0, ModuleId=0, VendorId=0
  module config BatteryVoltage: implementation-config-variant=VARIANT-PRE-COMPILE  # Configuration of the Nexteer BatteryVoltage module.
    BatteryVoltageGeneral
    CommonPublishedInformation: ArMajorVersion=3, ArMinorVersion=2, ArPatchVersion=0, SwMajorVersion=0, SwMinorVersion=0, SwPatchVersion=0, ModuleId=0, VendorId=0
  module config BVDiag: implementation-config-variant=VARIANT-PRE-COMPILE  # Configuration of the Nexteer BVDiag module.
    BVDiagGeneral: BC_B1_BATTVOLTDIAG=STD_OFF, BC_B1_BATTVOLTDIAG_ELPW=STD_OFF
    CommonPublishedInformation: ArMajorVersion=3, ArMinorVersion=2, ArPatchVersion=0, SwMajorVersion=0, SwMinorVersion=0, SwPatchVersion=0, ModuleId=0, VendorId=0
  module config CmMtrCurr: implementation-config-variant=VARIANT-PRE-COMPILE  # Configuration of the Nexteer CmMtrCurr module.
    CmMtrCurrGeneral
    CommonPublishedInformation: ArMajorVersion=3, ArMinorVersion=2, ArPatchVersion=0, SwMajorVersion=0, SwMinorVersion=0, SwPatchVersion=0, ModuleId=0, VendorId=0
    CmMtrCurrPhaseConfig: CmMtrCurrConfig=MTRCURRPHASEBA
  module config Crc: implementation-config-variant=VARIANT-PRE-COMPILE, module-description=Bswmd_Crc  # Configuration of the Crc (Crc routines) module.
    CrcPublishedInformation: CrcInitialValue8=0, CrcInitialValue16=65535, CrcInitialValue32=4294967295
    CrcGeneral: Crc8Mode=CRC_8_RUNTIME, Crc16Mode=CRC_16_RUNTIME, Crc32Mode=CRC_32_RUNTIME, CrcVersionInfoApi=true
  module config CtrldDisShtdn: implementation-config-variant=VARIANT-PRE-COMPILE  # Configuration of the Nexteer CtrldDisShtdn module.
    CtrldDisShtdnGeneral
    CommonPublishedInformation: ArMajorVersion=3, ArMinorVersion=2, ArPatchVersion=0, SwMajorVersion=0, SwMinorVersion=0, SwPatchVersion=0, ModuleId=0, VendorId=0
  module config CtrlTemp: implementation-config-variant=VARIANT-PRE-COMPILE  # Configuration of the Nexteer CtrlTemp module.
    CtrlTempGeneral
    CommonPublishedInformation: ArMajorVersion=3, ArMinorVersion=2, ArPatchVersion=0, SwMajorVersion=0, SwMinorVersion=0, SwPatchVersion=0, ModuleId=0, VendorId=0
  module config CurrCmd: implementation-config-variant=VARIANT-PRE-COMPILE  # Configuration of the Nexteer CurrCmd module.
    CurrCmdGeneral
    CommonPublishedInformation: ArMajorVersion=3, ArMinorVersion=2, ArPatchVersion=0, SwMajorVersion=0, SwMinorVersion=0, SwPatchVersion=0, ModuleId=0, VendorId=0
  module config CurrParamComp: implementation-config-variant=VARIANT-PRE-COMPILE  # Configuration of the Nexteer CurrParamComp module.
    CurrParamCompGeneral
    CommonPublishedInformation: ArMajorVersion=3, ArMinorVersion=2, ArPatchVersion=0, SwMajorVersion=0, SwMinorVersion=0, SwPatchVersion=0, ModuleId=0, VendorId=0
  module config Damping: implementation-config-variant=VARIANT-PRE-COMPILE  # Configuration of the Nexteer Damping module.
    DampingGeneral
    CommonPublishedInformation: ArMajorVersion=3, ArMinorVersion=2, ArPatchVersion=0, SwMajorVersion=0, SwMinorVersion=0, SwPatchVersion=0, ModuleId=0, VendorId=0
  module config DampingFirewall: implementation-config-variant=VARIANT-PRE-COMPILE  # Configuration of the Nexteer DampingFirewall module.
    DampingFirewallGeneral
    CommonPublishedInformation: ArMajorVersion=3, ArMinorVersion=2, ArPatchVersion=0, SwMajorVersion=0, SwMinorVersion=0, SwPatchVersion=0, ModuleId=0, VendorId=0
  module config DiagMgr: implementation-config-variant=VARIANT-PRE-COMPILE  # Configuration of the Nexteer DiagMgr (Diagnostic Event Manager) module.
    DiagMgrConfigSet
      185 x DiagMgrEventParameter, all with DiagMgrEventID=(unset):
        NTC_Num_FlashWrapperLgcFlt: DiagMgrNTC=1, DiagMgrEventKind=DIAGMGR_EVENT_KIND_SWC, OsApplicationRef=Ap_10
        NTC_Num_FlashECCCorr: DiagMgrNTC=2, DiagMgrEventKind=DIAGMGR_EVENT_KIND_SWC, OsApplicationRef=Ap_10
        NTC_Num_FlashECCMemFlt: DiagMgrNTC=3, DiagMgrEventKind=DIAGMGR_EVENT_KIND_SWC, OsApplicationRef=Ap_10
        NTC_Num_FlashCRCMemFault: DiagMgrNTC=4, DiagMgrEventKind=DIAGMGR_EVENT_KIND_BSW, OsApplicationRef=Ap_10
        NTC_Num_NvMBlkDftActA: DiagMgrNTC=6, DiagMgrEventKind=DIAGMGR_EVENT_KIND_BSW, OsApplicationRef=Ap_10
        NTC_Num_NvMBlkDftActB: DiagMgrNTC=7, DiagMgrEventKind=DIAGMGR_EVENT_KIND_BSW, OsApplicationRef=Ap_10
        NTC_Num_NvMBlkDftActC: DiagMgrNTC=8, DiagMgrEventKind=DIAGMGR_EVENT_KIND_BSW, OsApplicationRef=Ap_10
        NTC_Num_EEPROMDiag: DiagMgrNTC=10, DiagMgrEventKind=DIAGMGR_EVENT_KIND_BSW, OsApplicationRef=Ap_10
        NTC_Num_EEPROMDiagMtrStr: DiagMgrNTC=11, DiagMgrEventKind=DIAGMGR_EVENT_KIND_SWC, OsApplicationRef=Ap_10
        NTC_Num_PriSnsrTrqStorFlt: DiagMgrNTC=12, DiagMgrEventKind=DIAGMGR_EVENT_KIND_SWC, OsApplicationRef=Ap_10
        NTC_Num_RAMDiag_GeneralFlt: DiagMgrNTC=16, DiagMgrEventKind=DIAGMGR_EVENT_KIND_SWC, OsApplicationRef=Ap_10
        NTC_Num_RAMDiag_WrprLgcFlt: DiagMgrNTC=17, DiagMgrEventKind=DIAGMGR_EVENT_KIND_SWC, OsApplicationRef=Ap_10
        NTC_Num_RAMDiag_ECCCorrIndFlt: DiagMgrNTC=18, DiagMgrEventKind=DIAGMGR_EVENT_KIND_SWC, OsApplicationRef=Ap_10
        NTC_Num_RAMDiag_ECCMemFlt: DiagMgrNTC=19, DiagMgrEventKind=DIAGMGR_EVENT_KIND_SWC, OsApplicationRef=Ap_10
        NTC_Num_RAMDiag_VIMRamFlt: DiagMgrNTC=23, DiagMgrEventKind=DIAGMGR_EVENT_KIND_SWC, OsApplicationRef=Ap_10
        NTC_Num_RAMDiag_NHET1RamFlt: DiagMgrNTC=24, DiagMgrEventKind=DIAGMGR_EVENT_KIND_SWC, OsApplicationRef=Ap_10
        NTC_Num_RAMDiag_NHET2RamFlt: DiagMgrNTC=25, DiagMgrEventKind=DIAGMGR_EVENT_KIND_SWC, OsApplicationRef=Ap_10
        NTC_Num_RAMDiag_ADC1RamFlt: DiagMgrNTC=26, DiagMgrEventKind=DIAGMGR_EVENT_KIND_SWC, OsApplicationRef=Ap_10
        NTC_Num_RAMDiag_DCANRamFault: DiagMgrNTC=27, DiagMgrEventKind=DIAGMGR_EVENT_KIND_SWC, OsApplicationRef=Ap_10
        NTC_Num_RAMDiag_ADC2RamFlt: DiagMgrNTC=28, DiagMgrEventKind=DIAGMGR_EVENT_KIND_SWC, OsApplicationRef=Ap_10
        NTC_Num_RAMDiag_HETTU1RamFlt: DiagMgrNTC=29, DiagMgrEventKind=DIAGMGR_EVENT_KIND_BSW, OsApplicationRef=Ap_10
        NTC_Num_RAMDiag_HETTU2RamFlt: DiagMgrNTC=30, DiagMgrEventKind=DIAGMGR_EVENT_KIND_SWC, OsApplicationRef=Ap_10
        NTC_Num_CPU_RegVer: DiagMgrNTC=32, DiagMgrEventKind=DIAGMGR_EVENT_KIND_SWC, OsApplicationRef=Ap_10
        NTC_Num_CPU_CoreInitFlt: DiagMgrNTC=33, DiagMgrEventKind=DIAGMGR_EVENT_KIND_BSW, OsApplicationRef=Ap_10
        NTC_Num_CPU_CoreRunTimeFlt: DiagMgrNTC=34, DiagMgrEventKind=DIAGMGR_EVENT_KIND_SWC, OsApplicationRef=Ap_10
        NTC_Num_CPU_ClockMon: DiagMgrNTC=35, DiagMgrEventKind=DIAGMGR_EVENT_KIND_SWC, OsApplicationRef=Ap_10
        NTC_Num_CPU_eFuseFlt: DiagMgrNTC=36, DiagMgrEventKind=DIAGMGR_EVENT_KIND_SWC, OsApplicationRef=Ap_10
        NTC_Num_CPU_MPUViolation: DiagMgrNTC=37, DiagMgrEventKind=DIAGMGR_EVENT_KIND_SWC, OsApplicationRef=Ap_10
        NTC_Num_CPU_FactPrcsErr: DiagMgrNTC=40, DiagMgrEventKind=DIAGMGR_EVENT_KIND_SWC, OsApplicationRef=Ap_10
        NTC_Num_PrgFlwDeadlnFlt: DiagMgrNTC=42, DiagMgrEventKind=DIAGMGR_EVENT_KIND_BSW, OsApplicationRef=Ap_10
        NTC_Num_PropExeDiag_RunTimeDiag: DiagMgrNTC=43, DiagMgrEventKind=DIAGMGR_EVENT_KIND_SWC, OsApplicationRef=Ap_10
        NTC_Num_PropExeDiag_COPTimeout: DiagMgrNTC=44, DiagMgrEventKind=DIAGMGR_EVENT_KIND_SWC, OsApplicationRef=Ap_10
        NTC_Num_PropExeDiag_PrefetchAbort: DiagMgrNTC=48, DiagMgrEventKind=DIAGMGR_EVENT_KIND_SWC, OsApplicationRef=Ap_10
        NTC_Num_PropExeDiag_DataAbort: DiagMgrNTC=49, DiagMgrEventKind=DIAGMGR_EVENT_KIND_SWC, OsApplicationRef=Ap_10
        NTC_Num_PerDiag_ADC1Flt: DiagMgrNTC=50, DiagMgrEventKind=DIAGMGR_EVENT_KIND_SWC, OsApplicationRef=Ap_10
        NTC_Num_PerDiag_ADC2Flt: DiagMgrNTC=51, DiagMgrEventKind=DIAGMGR_EVENT_KIND_SWC, OsApplicationRef=Ap_10
        NTC_Num_PerDiag_IllegalAccess: DiagMgrNTC=53, DiagMgrEventKind=DIAGMGR_EVENT_KIND_SWC, OsApplicationRef=Ap_10
        NTC_Num_PerDiag_DMAFlt: DiagMgrNTC=54, DiagMgrEventKind=DIAGMGR_EVENT_KIND_SWC, OsApplicationRef=Ap_10
        NTC_Num_PeripheralStartupFlt: DiagMgrNTC=55, DiagMgrEventKind=DIAGMGR_EVENT_KIND_SWC, OsApplicationRef=Ap_10
        NTC_Num_TmpMonFunc: DiagMgrNTC=64, DiagMgrEventKind=DIAGMGR_EVENT_KIND_SWC, OsApplicationRef=Ap_9
        NTC_Num_TmpMonRunTimeFlt: DiagMgrNTC=65, DiagMgrEventKind=DIAGMGR_EVENT_KIND_SWC, OsApplicationRef=Ap_9
        NTC_Num_PowerRelayInitFlt: DiagMgrNTC=66, DiagMgrEventKind=DIAGMGR_EVENT_KIND_SWC, OsApplicationRef=Ap_9
        NTC_Num_PrechargeFailure: DiagMgrNTC=67, DiagMgrEventKind=DIAGMGR_EVENT_KIND_SWC, OsApplicationRef=Ap_9
        NTC_Num_PowerRelayRunFlt: DiagMgrNTC=68, DiagMgrEventKind=DIAGMGR_EVENT_KIND_SWC, OsApplicationRef=Ap_9
        NTC_Num_Thermistor: DiagMgrNTC=69, DiagMgrEventKind=DIAGMGR_EVENT_KIND_SWC, OsApplicationRef=Ap_11
        NTC_Num_RefSupplyVltg: DiagMgrNTC=70, DiagMgrEventKind=DIAGMGR_EVENT_KIND_SWC, OsApplicationRef=Ap_10
        NTC_Num_CPUSupplyOvervoltage: DiagMgrNTC=72, DiagMgrEventKind=DIAGMGR_EVENT_KIND_SWC, OsApplicationRef=Ap_10
        NTC_Num_GateDrvFlt: DiagMgrNTC=77, DiagMgrEventKind=DIAGMGR_EVENT_KIND_SWC, OsApplicationRef=Ap_10
        NTC_Num_OnStateSingleFET: DiagMgrNTC=78, DiagMgrEventKind=DIAGMGR_EVENT_KIND_SWC, OsApplicationRef=Ap_10
        NTC_Num_OnStateMultiFET: DiagMgrNTC=79, DiagMgrEventKind=DIAGMGR_EVENT_KIND_SWC, OsApplicationRef=Ap_10
        NTC_Num_DigPhaseVoltageVerf: DiagMgrNTC=82, DiagMgrEventKind=DIAGMGR_EVENT_KIND_SWC, OsApplicationRef=Ap_10
        NTC_Num_CurrentMeasCrossChk: DiagMgrNTC=86, DiagMgrEventKind=DIAGMGR_EVENT_KIND_SWC, OsApplicationRef=Ap_11
        NTC_Num_T1vsT2: DiagMgrNTC=101, DiagMgrEventKind=DIAGMGR_EVENT_KIND_SWC, OsApplicationRef=Ap_10
        NTC_Num_T1OutofRange: DiagMgrNTC=102, DiagMgrEventKind=DIAGMGR_EVENT_KIND_SWC, OsApplicationRef=Ap_9
        NTC_Num_T2OutofRange: DiagMgrNTC=103, DiagMgrEventKind=DIAGMGR_EVENT_KIND_SWC, OsApplicationRef=Ap_9
        NTC_Num_PriMSB_SinCosCorr: DiagMgrNTC=112, DiagMgrEventKind=DIAGMGR_EVENT_KIND_SWC, OsApplicationRef=Ap_10
        NTC_Num_SecMSB_SinCosCorr: DiagMgrNTC=113, DiagMgrEventKind=DIAGMGR_EVENT_KIND_SWC, OsApplicationRef=Ap_10
        NTC_Num_PriVsSec_SinCosCorr: DiagMgrNTC=114, DiagMgrEventKind=DIAGMGR_EVENT_KIND_SWC, OsApplicationRef=Ap_10
        NTC_Num_HWAtoMtrAngleCorr: DiagMgrNTC=117, DiagMgrEventKind=DIAGMGR_EVENT_KIND_SWC, OsApplicationRef=Ap_10
        NTC_Num_TurnCntr_PosLoss: DiagMgrNTC=128, DiagMgrEventKind=DIAGMGR_EVENT_KIND_SWC, OsApplicationRef=Ap_10
        NTC_Num_TurnCntr_SensorPosFlt: DiagMgrNTC=130, DiagMgrEventKind=DIAGMGR_EVENT_KIND_SWC, OsApplicationRef=Ap_10
        NTC_Num_TurnCntr_MainResets: DiagMgrNTC=133, DiagMgrEventKind=DIAGMGR_EVENT_KIND_SWC, OsApplicationRef=Ap_10
        NTC_Num_KinematicIntDiag: DiagMgrNTC=144, DiagMgrEventKind=DIAGMGR_EVENT_KIND_SWC, OsApplicationRef=Ap_10
        NTC_Num_HighFriction: DiagMgrNTC=145, DiagMgrEventKind=DIAGMGR_EVENT_KIND_SWC, OsApplicationRef=Ap_9
        NTC_Num_DutyCycleExceeded: DiagMgrNTC=148, DiagMgrEventKind=DIAGMGR_EVENT_KIND_SWC, OsApplicationRef=Ap_9
        NTC_Num_AbsTempThermLimit: DiagMgrNTC=149, DiagMgrEventKind=DIAGMGR_EVENT_KIND_SWC, OsApplicationRef=Ap_9
        NTC_Num_LatchActive: DiagMgrNTC=160, DiagMgrEventKind=DIAGMGR_EVENT_KIND_BSW, OsApplicationRef=Ap_6
        NTC_Num_CurrentReas: DiagMgrNTC=169, DiagMgrEventKind=DIAGMGR_EVENT_KIND_SWC, OsApplicationRef=Ap_10
        NTC_Num_OpVoltage: DiagMgrNTC=176, DiagMgrEventKind=DIAGMGR_EVENT_KIND_SWC, OsApplicationRef=Ap_9
        NTC_Num_ReducedAsstLowVoltage: DiagMgrNTC=178, DiagMgrEventKind=DIAGMGR_EVENT_KIND_SWC, OsApplicationRef=Ap_10
        NTC_Num_OpVoltageOvrMax: DiagMgrNTC=181, DiagMgrEventKind=DIAGMGR_EVENT_KIND_SWC, OsApplicationRef=Ap_9
        NTC_Num_BattTransOverVolt: DiagMgrNTC=182, DiagMgrEventKind=DIAGMGR_EVENT_KIND_BSW, OsApplicationRef=Ap_9
        NTC_Num_TurnCntr_LowBattery: DiagMgrNTC=185, DiagMgrEventKind=DIAGMGR_EVENT_KIND_SWC, OsApplicationRef=Ap_10
        NTC_Num_EEPROMCloseFailed: DiagMgrNTC=191, DiagMgrEventKind=DIAGMGR_EVENT_KIND_SWC, OsApplicationRef=Ap_10
        NTC_Num_SigPath1CrossChk: DiagMgrNTC=192, DiagMgrEventKind=DIAGMGR_EVENT_KIND_SWC, OsApplicationRef=Ap_10
        NTC_Num_SigPath5CrossChk: DiagMgrNTC=196, DiagMgrEventKind=DIAGMGR_EVENT_KIND_SWC, OsApplicationRef=Ap_10
        NTC_Num_DampingFWReached: DiagMgrNTC=197, DiagMgrEventKind=DIAGMGR_EVENT_KIND_SWC, OsApplicationRef=Ap_10
        NTC_Num_AssistFWReached: DiagMgrNTC=198, DiagMgrEventKind=DIAGMGR_EVENT_KIND_SWC, OsApplicationRef=Ap_10
        NTC_Num_ReturnFWReached: DiagMgrNTC=199, DiagMgrEventKind=DIAGMGR_EVENT_KIND_SWC, OsApplicationRef=Ap_10
        NTC_Num_DampingFWFltMode: DiagMgrNTC=200, DiagMgrEventKind=DIAGMGR_EVENT_KIND_SWC, OsApplicationRef=Ap_10
        NTC_Num_AssistFWFltMode: DiagMgrNTC=201, DiagMgrEventKind=DIAGMGR_EVENT_KIND_SWC, OsApplicationRef=Ap_10
        NTC_Num_VBICFltMode: DiagMgrNTC=202, DiagMgrEventKind=DIAGMGR_EVENT_KIND_SWC, OsApplicationRef=Ap_10
        NTC_Num_StaMdsSysC: DiagMgrNTC=203, DiagMgrEventKind=DIAGMGR_EVENT_KIND_SWC, OsApplicationRef=Ap_11
        NTC_NUM_SysFailureForRotVel: DiagMgrNTC=204, DiagMgrEventKind=DIAGMGR_EVENT_KIND_BSW, OsApplicationRef=Ap_10
        NTC_NUM_SysFailForRedntRotVel: DiagMgrNTC=205, DiagMgrEventKind=DIAGMGR_EVENT_KIND_BSW, OsApplicationRef=Ap_11
        NTC_NUM_SysFailureForCtrlVolt: DiagMgrNTC=209, DiagMgrEventKind=DIAGMGR_EVENT_KIND_SWC, OsApplicationRef=Ap_9
        NTC_Num_VLF_00: DiagMgrNTC=224, DiagMgrEventKind=DIAGMGR_EVENT_KIND_SWC, OsApplicationRef=Ap_9
        NTC_Num_VLF_01: DiagMgrNTC=225, DiagMgrEventKind=DIAGMGR_EVENT_KIND_SWC, OsApplicationRef=Ap_9
        NTC_Num_VLF_02: DiagMgrNTC=226, DiagMgrEventKind=DIAGMGR_EVENT_KIND_SWC, OsApplicationRef=Ap_9
        NTC_Num_VLF_03: DiagMgrNTC=227, DiagMgrEventKind=DIAGMGR_EVENT_KIND_SWC, OsApplicationRef=Ap_9
        NTC_Num_VLF_04: DiagMgrNTC=228, DiagMgrEventKind=DIAGMGR_EVENT_KIND_SWC, OsApplicationRef=Ap_9
        NTC_Num_VLF_05: DiagMgrNTC=229, DiagMgrEventKind=DIAGMGR_EVENT_KIND_SWC, OsApplicationRef=Ap_9
        NTC_Num_VLF_06: DiagMgrNTC=230, DiagMgrEventKind=DIAGMGR_EVENT_KIND_SWC, OsApplicationRef=Ap_9
        NTC_Num_VLF_07: DiagMgrNTC=231, DiagMgrEventKind=DIAGMGR_EVENT_KIND_SWC, OsApplicationRef=Ap_9
        NTC_Num_VLF_08: DiagMgrNTC=232, DiagMgrEventKind=DIAGMGR_EVENT_KIND_SWC, OsApplicationRef=Ap_9
        NTC_Num_VLF_09: DiagMgrNTC=233, DiagMgrEventKind=DIAGMGR_EVENT_KIND_SWC, OsApplicationRef=Ap_9
        NTC_Num_VLF_16: DiagMgrNTC=240, DiagMgrEventKind=DIAGMGR_EVENT_KIND_SWC, OsApplicationRef=Ap_6
        NTC_Num_VLF_17: DiagMgrNTC=241, DiagMgrEventKind=DIAGMGR_EVENT_KIND_BSW, OsApplicationRef=Ap_6
        NTC_Num_BusOffCh1: DiagMgrNTC=256, DiagMgrEventKind=DIAGMGR_EVENT_KIND_SWC, OsApplicationRef=Ap_6
        NTC_Num_BusOffCh1NodeMute: DiagMgrNTC=257, DiagMgrEventKind=DIAGMGR_EVENT_KIND_SWC, OsApplicationRef=Ap_10
        NTC_Num_InvalidMsg_M: DiagMgrNTC=288, DiagMgrEventKind=DIAGMGR_EVENT_KIND_SWC, OsApplicationRef=Ap_10
        NTC_Num_MissingMsg_M: DiagMgrNTC=289, DiagMgrEventKind=DIAGMGR_EVENT_KIND_SWC, OsApplicationRef=Ap_10
        NTC_Num_InvalidMsg_N: DiagMgrNTC=296, DiagMgrEventKind=DIAGMGR_EVENT_KIND_SWC, OsApplicationRef=Ap_10
        NTC_Num_MissingMsg_N: DiagMgrNTC=297, DiagMgrEventKind=DIAGMGR_EVENT_KIND_SWC, OsApplicationRef=Ap_10
        NTC_Num_DataRngFltMsg_N: DiagMgrNTC=300, DiagMgrEventKind=DIAGMGR_EVENT_KIND_SWC, OsApplicationRef=Ap_10
        NTC_Num_InvalidMsg_O: DiagMgrNTC=304, DiagMgrEventKind=DIAGMGR_EVENT_KIND_SWC, OsApplicationRef=Ap_10
        NTC_Num_MissingMsg_O: DiagMgrNTC=305, DiagMgrEventKind=DIAGMGR_EVENT_KIND_SWC, OsApplicationRef=Ap_10
        NTC_Num_CRCFltMsg_O: DiagMgrNTC=306, DiagMgrEventKind=DIAGMGR_EVENT_KIND_SWC, OsApplicationRef=Ap_10
        NTC_Num_PgrsCntFltMsg_O: DiagMgrNTC=307, DiagMgrEventKind=DIAGMGR_EVENT_KIND_SWC, OsApplicationRef=Ap_10
        NTC_Num_DataRngFltMsg_O: DiagMgrNTC=308, DiagMgrEventKind=DIAGMGR_EVENT_KIND_SWC, OsApplicationRef=Ap_10
        NTC_Num_InvalidMsg_P: DiagMgrNTC=312, DiagMgrEventKind=DIAGMGR_EVENT_KIND_SWC, OsApplicationRef=Ap_10
        NTC_Num_MissingMsg_P: DiagMgrNTC=313, DiagMgrEventKind=DIAGMGR_EVENT_KIND_SWC, OsApplicationRef=Ap_10
        NTC_Num_InvalidMsg_Q: DiagMgrNTC=320, DiagMgrEventKind=DIAGMGR_EVENT_KIND_SWC, OsApplicationRef=Ap_10
        NTC_Num_MissingMsg_Q: DiagMgrNTC=321, DiagMgrEventKind=DIAGMGR_EVENT_KIND_SWC, OsApplicationRef=Ap_10
        NTC_Num_DataOtherFltMsg_Q: DiagMgrNTC=326, DiagMgrEventKind=DIAGMGR_EVENT_KIND_SWC, OsApplicationRef=Ap_10
        NTC_Num_InvalidMsg_R: DiagMgrNTC=328, DiagMgrEventKind=DIAGMGR_EVENT_KIND_SWC, OsApplicationRef=Ap_10
        NTC_Num_MissingMsg_R: DiagMgrNTC=329, DiagMgrEventKind=DIAGMGR_EVENT_KIND_SWC, OsApplicationRef=Ap_10
        NTC_Num_CRCFltMsg_R: DiagMgrNTC=330, DiagMgrEventKind=DIAGMGR_EVENT_KIND_SWC, OsApplicationRef=Ap_10
        NTC_Num_PgrsCntFltMsg_R: DiagMgrNTC=331, DiagMgrEventKind=DIAGMGR_EVENT_KIND_SWC, OsApplicationRef=Ap_10
        NTC_Num_DataRngFltMsg_R: DiagMgrNTC=332, DiagMgrEventKind=DIAGMGR_EVENT_KIND_SWC, OsApplicationRef=Ap_10
        NTC_Num_DataRateFltMsg_R: DiagMgrNTC=333, DiagMgrEventKind=DIAGMGR_EVENT_KIND_SWC, OsApplicationRef=Ap_10
        NTC_Num_DataOtherFltMsg_R: DiagMgrNTC=334, DiagMgrEventKind=DIAGMGR_EVENT_KIND_SWC, OsApplicationRef=Ap_10
        NTC_Num_InvalidMsg_S: DiagMgrNTC=336, DiagMgrEventKind=DIAGMGR_EVENT_KIND_SWC, OsApplicationRef=Ap_10
        NTC_Num_MissingMsg_S: DiagMgrNTC=337, DiagMgrEventKind=DIAGMGR_EVENT_KIND_SWC, OsApplicationRef=Ap_10
        NTC_Num_CRCFltMsg_S: DiagMgrNTC=338, DiagMgrEventKind=DIAGMGR_EVENT_KIND_SWC, OsApplicationRef=Ap_10
        NTC_Num_PgrsCntFltMsg_S: DiagMgrNTC=339, DiagMgrEventKind=DIAGMGR_EVENT_KIND_SWC, OsApplicationRef=Ap_10
        NTC_Num_DataRngFltMsg_S: DiagMgrNTC=340, DiagMgrEventKind=DIAGMGR_EVENT_KIND_SWC, OsApplicationRef=Ap_10
        NTC_Num_DataRateFltMsg_S: DiagMgrNTC=341, DiagMgrEventKind=DIAGMGR_EVENT_KIND_SWC, OsApplicationRef=Ap_10
        NTC_Num_InvalidMsg_T: DiagMgrNTC=344, DiagMgrEventKind=DIAGMGR_EVENT_KIND_SWC, OsApplicationRef=Ap_10
        NTC_Num_MissingMsg_T: DiagMgrNTC=345, DiagMgrEventKind=DIAGMGR_EVENT_KIND_SWC, OsApplicationRef=Ap_10
        NTC_Num_InvalidMsg_U: DiagMgrNTC=352, DiagMgrEventKind=DIAGMGR_EVENT_KIND_SWC, OsApplicationRef=Ap_10
        NTC_Num_MissingMsg_U: DiagMgrNTC=353, DiagMgrEventKind=DIAGMGR_EVENT_KIND_SWC, OsApplicationRef=Ap_10
        NTC_Num_DataRngFltMsg_U: DiagMgrNTC=356, DiagMgrEventKind=DIAGMGR_EVENT_KIND_SWC, OsApplicationRef=Ap_10
        NTC_Num_DataRateFltMsg_U: DiagMgrNTC=357, DiagMgrEventKind=DIAGMGR_EVENT_KIND_SWC, OsApplicationRef=Ap_10
        NTC_Num_InvalidMsg_V: DiagMgrNTC=360, DiagMgrEventKind=DIAGMGR_EVENT_KIND_SWC, OsApplicationRef=Ap_10
        NTC_Num_MissingMsg_V: DiagMgrNTC=361, DiagMgrEventKind=DIAGMGR_EVENT_KIND_SWC, OsApplicationRef=Ap_10
        NTC_Num_DataRngFltMsg_V: DiagMgrNTC=364, DiagMgrEventKind=DIAGMGR_EVENT_KIND_SWC, OsApplicationRef=Ap_10
        NTC_Num_DataRateFltMsg_V: DiagMgrNTC=365, DiagMgrEventKind=DIAGMGR_EVENT_KIND_SWC, OsApplicationRef=Ap_10
        NTC_Num_EOLVehTunNtPerf: DiagMgrNTC=501, DiagMgrEventKind=DIAGMGR_EVENT_KIND_SWC, OsApplicationRef=Ap_6
        NTC_Num_HWASensorNotTrimmed: DiagMgrNTC=504, DiagMgrEventKind=DIAGMGR_EVENT_KIND_SWC, OsApplicationRef=Ap_10
        NTC_Num_TrqSensorNotTrimmed: DiagMgrNTC=507, DiagMgrEventKind=DIAGMGR_EVENT_KIND_SWC, OsApplicationRef=Ap_10
        NTC_Num_DataOtherFltMsg_U: DiagMgrNTC=358, DiagMgrEventKind=DIAGMGR_EVENT_KIND_SWC, OsApplicationRef=Ap_10
        NTC_Num_MissingMsg_W: DiagMgrNTC=369, DiagMgrEventKind=DIAGMGR_EVENT_KIND_SWC, OsApplicationRef=Ap_10
        NTC_Num_MissingMsg_X: DiagMgrNTC=377, DiagMgrEventKind=DIAGMGR_EVENT_KIND_SWC, OsApplicationRef=Ap_10
        NTC_Num_MissingMsg_AA: DiagMgrNTC=401, DiagMgrEventKind=DIAGMGR_EVENT_KIND_SWC, OsApplicationRef=Ap_10
        NTC_Num_InvalidMsg_W: DiagMgrNTC=368, DiagMgrEventKind=DIAGMGR_EVENT_KIND_SWC, OsApplicationRef=Ap_10
        NTC_Num_InvalidMsg_AA: DiagMgrNTC=400, DiagMgrEventKind=DIAGMGR_EVENT_KIND_SWC, OsApplicationRef=Ap_10
        NTC_Num_DataRngFltMsg_AA: DiagMgrNTC=404, DiagMgrEventKind=DIAGMGR_EVENT_KIND_SWC, OsApplicationRef=Ap_10
        NTC_Num_DataOtherFlt2Msg_Q: DiagMgrNTC=327, DiagMgrEventKind=DIAGMGR_EVENT_KIND_SWC, OsApplicationRef=Ap_10
        NTC_Num_DataRngFltMsg_Q: DiagMgrNTC=324, DiagMgrEventKind=DIAGMGR_EVENT_KIND_SWC, OsApplicationRef=Ap_10
        NTC_Num_AnaHWDiffTqOfstNotTrmd: DiagMgrNTC=508, DiagMgrEventKind=DIAGMGR_EVENT_KIND_SWC, OsApplicationRef=Ap_10
        NTC_Num_LoaRpdShutdn: DiagMgrNTC=170, DiagMgrEventKind=DIAGMGR_EVENT_KIND_SWC, OsApplicationRef=Ap_10
        NTC_Num_LoaCtrldShutdn: DiagMgrNTC=171, DiagMgrEventKind=DIAGMGR_EVENT_KIND_SWC, OsApplicationRef=Ap_10
        NTC_Num_LoaMgr_HwTqIdptSigTooLow: DiagMgrNTC=172, DiagMgrEventKind=DIAGMGR_EVENT_KIND_SWC, OsApplicationRef=Ap_10
        NTC_Num_LoaMgr_MotAgIdptSigTooLow: DiagMgrNTC=173, DiagMgrEventKind=DIAGMGR_EVENT_KIND_SWC, OsApplicationRef=Ap_10
        NTC_Num_LoaMgr_MotCurrIdptSigTooLow: DiagMgrNTC=174, DiagMgrEventKind=DIAGMGR_EVENT_KIND_SWC, OsApplicationRef=Ap_10
        NTC_Num_LoaMgr_IvtrIdptSigTooLow: DiagMgrNTC=175, DiagMgrEventKind=DIAGMGR_EVENT_KIND_SWC, OsApplicationRef=Ap_10
        NTC_Num_LxaTrqOvMode: DiagMgrNTC=235, DiagMgrEventKind=DIAGMGR_EVENT_KIND_SWC, OsApplicationRef=Ap_10
        NTC_Num_LxaHwTrqMode: DiagMgrNTC=236, DiagMgrEventKind=DIAGMGR_EVENT_KIND_SWC, OsApplicationRef=Ap_10
        NTC_Num_LxaHwVelMode: DiagMgrNTC=237, DiagMgrEventKind=DIAGMGR_EVENT_KIND_SWC, OsApplicationRef=Ap_10
        NTC_Num_DigT1OutofRange: DiagMgrNTC=105, DiagMgrEventKind=DIAGMGR_EVENT_KIND_SWC, OsApplicationRef=Ap_9
        NTC_Num_DigT2OutofRange: DiagMgrNTC=106, DiagMgrEventKind=DIAGMGR_EVENT_KIND_SWC, OsApplicationRef=Ap_9
        NTC_Num_InvalidMsg_X: DiagMgrNTC=376, DiagMgrEventKind=DIAGMGR_EVENT_KIND_SWC, OsApplicationRef=Ap_10
        NTC_Num_DataRngFltMsg_T: DiagMgrNTC=348, DiagMgrEventKind=DIAGMGR_EVENT_KIND_SWC, OsApplicationRef=Ap_10
        NTC_Num_DataRateFltMsg_Q: DiagMgrNTC=325, DiagMgrEventKind=DIAGMGR_EVENT_KIND_SWC, OsApplicationRef=Ap_10
        NTC_Num_InvalidMsg_Y: DiagMgrNTC=384, DiagMgrEventKind=DIAGMGR_EVENT_KIND_SWC, OsApplicationRef=Ap_10
        NTC_Num_MissingMsg_Y: DiagMgrNTC=385, DiagMgrEventKind=DIAGMGR_EVENT_KIND_SWC, OsApplicationRef=Ap_10
        NTC_Num_DataRngFltMsg_Y: DiagMgrNTC=388, DiagMgrEventKind=DIAGMGR_EVENT_KIND_SWC, OsApplicationRef=Ap_10
        NTC_Num_InvalidMsg_Z: DiagMgrNTC=392, DiagMgrEventKind=DIAGMGR_EVENT_KIND_SWC, OsApplicationRef=Ap_10
        NTC_Num_MissingMsg_Z: DiagMgrNTC=393, DiagMgrEventKind=DIAGMGR_EVENT_KIND_SWC, OsApplicationRef=Ap_10
        NTC_Num_CRCFltMsg_Z: DiagMgrNTC=394, DiagMgrEventKind=DIAGMGR_EVENT_KIND_SWC, OsApplicationRef=Ap_10
        NTC_Num_PgrsCntFltMsg_Z: DiagMgrNTC=395, DiagMgrEventKind=DIAGMGR_EVENT_KIND_SWC, OsApplicationRef=Ap_10
        NTC_Num_DataRngFltMsg_Z: DiagMgrNTC=396, DiagMgrEventKind=DIAGMGR_EVENT_KIND_SWC, OsApplicationRef=Ap_10
        NTC_Num_DataRateFltMsg_Z: DiagMgrNTC=397, DiagMgrEventKind=DIAGMGR_EVENT_KIND_SWC, OsApplicationRef=Ap_10
        NTC_Num_DataOtherFltMsg_Z: DiagMgrNTC=398, DiagMgrEventKind=DIAGMGR_EVENT_KIND_SWC, OsApplicationRef=Ap_10
        NTC_Num_TunSetNotPrgmd: DiagMgrNTC=499, DiagMgrEventKind=DIAGMGR_EVENT_KIND_SWC, OsApplicationRef=Ap_6
        NTC_Num_PLLSlipNrcvrl: DiagMgrNTC=22, DiagMgrEventKind=DIAGMGR_EVENT_KIND_SWC, OsApplicationRef=Ap_10
        NTC_Num_VLF_15: DiagMgrNTC=239, DiagMgrEventKind=DIAGMGR_EVENT_KIND_SWC, OsApplicationRef=Ap_10
        NTC_Num_VLF_14: DiagMgrNTC=238, DiagMgrEventKind=DIAGMGR_EVENT_KIND_SWC, OsApplicationRef=Ap_10
        NTC_Num_VLF_10: DiagMgrNTC=234, DiagMgrEventKind=DIAGMGR_EVENT_KIND_SWC, OsApplicationRef=Ap_10
        NTC_Num_VLF_20: DiagMgrNTC=244, DiagMgrEventKind=DIAGMGR_EVENT_KIND_SWC, OsApplicationRef=Ap_9
        NTC_Num_MotBasdHwAgFlt: DiagMgrNTC=153, DiagMgrEventKind=DIAGMGR_EVENT_KIND_SWC, OsApplicationRef=Ap_9
        NTC_Num_EEPROMDiagPolarityStr: DiagMgrNTC=15, DiagMgrEventKind=DIAGMGR_EVENT_KIND_SWC, OsApplicationRef=Ap_10
        NTC_Num_DSTXORActive: DiagMgrNTC=399, DiagMgrEventKind=DIAGMGR_EVENT_KIND_SWC, OsApplicationRef=Ap_10
        NTC_Num_GateDrvFltInProcess: DiagMgrNTC=76, DiagMgrEventKind=DIAGMGR_EVENT_KIND_SWC, OsApplicationRef=Ap_10
    DiagMgrGeneral:
      DiagMgrIsMtoProgram = false
      DiagMgrDevErrorDetect = true
      DiagMgrVersionInfoApi = false
      DiagMgrRecoverPeriod = 0.1
      DiagMgrFailPeriod = 0.002
      DiagMgrDemIfPeriod = 0.1
      NumOfDemEvents = 60
      NumOfInverters = 1
      DiagMgrDemIfOsAppRef = Ap_6
      DiagMgrFailActionOsAppRef = Ap_10
    CommonPublishedInformation: ArMajorVersion=3, ArMinorVersion=2, ArPatchVersion=0, SwMajorVersion=0, SwMinorVersion=0, SwPatchVersion=0, ModuleId=0, VendorId=0
  module config DigPhsReasDiag: implementation-config-variant=VARIANT-PRE-COMPILE  # Configuration of the Nexteer DigPhsReasDiag module.
    DigPhsReasDiagGeneral: NHETFREQUENCY_HZ=80000000, MAXPWMFREQ_HZ=18000
    CommonPublishedInformation: ArMajorVersion=3, ArMinorVersion=2, ArPatchVersion=0, SwMajorVersion=0, SwMinorVersion=0, SwPatchVersion=0, ModuleId=0, VendorId=0
  module config Dio: implementation-config-variant=VARIANT-LINK-TIME, module-description=Dio_Impl  # Configuration of the Dio (Digital IO) module.
    DioGeneral:
      DioDevErrorDetect = true
      DioVersionInfoApi = true
      DioMaskedWritePortApi = false
      DioCfgSupportGio = true
      DioCfgSupportCan = true
      DioCfgDoParamCheck = true
      DioCfgReportDet = true
      DioCfgChkParamChannel = true
      DioCfgChkParamPort = true
      DioCfgChkParamGroup = true
      DioCfgChkParamVinfo = true
      DioReportDet = Det_ReportError
      DioCfgIncludeDet = Det.h
      DioCfgChannelApi = true
      DioCfgPortApi = true
      DioCfgGroupApi = true
      DioSpecialRegisterAccessEnabled = true
      DioSpecialRegisterAccessOnlyForWrite = true
      DioSpecialRegisterAccessOnlyForPrivilegedModeRegisters = true
    DioVectorCommonData (VectorCommonData): BswmdVersion=2.01.00
    DioPackageMapping337 (DioPackageMapping): DioPackageName=Pin_337, DioPortDefMaskName=DIO_PORT_DEF_MASK_IN_PKG_A
    DioPortGioA (DioPortDefinition):
      DioPortDefName = GIOA
      DioPortDefPortId = 12046
      DioPortDefMaskInPkgA = 255
      DioPortDefMaskInPkgB = 231
      DioPortDefMaskInPkgC = 0
      DioPortDefMaskInPkgD = 0
      DioPortDefMaskInPkgE = 0
      DioPortDefMaskInPkgF = 0
      DioPortDefMaskInPkgG = 0
      DioPortDefMaskInPkgH = 0
      DioPortDefMaskInPkgI = 0
      DioPortDefMaskInPkgJ = 0
    NHet (DioPort): DioPortId=0, DioPortDefRef=DioPortNHet1
      NHet_Ch4 (DioChannel): DioChannelId=4
      DioChGrpNHet (DioChannelGroup): DioChannelGroupIdentification=&DioChGrpNHet, DioPortMask=1, DioPortOffset=0
      6 x DioChannel:
        NHet_Ch8: DioChannelId=8
        NHet_Ch15: DioChannelId=15
        NHet_Ch20: DioChannelId=20
        NHet_Ch22: DioChannelId=22
        NHet_Ch24: DioChannelId=24
        NHet_Ch26: DioChannelId=26
    DioPackageMapping144 (DioPackageMapping): DioPackageName=Pin_144, DioPortDefMaskName=DIO_PORT_DEF_MASK_IN_PKG_B
    23 x DioPortDefinition, all with DioPortDefMaskInPkgC=0, DioPortDefMaskInPkgD=0, DioPortDefMaskInPkgE=0, DioPortDefMaskInPkgF=0, DioPortDefMaskInPkgG=0, DioPortDefMaskInPkgH=0, DioPortDefMaskInPkgI=0, DioPortDefMaskInPkgJ=0:
      DioPortGioB: DioPortDefName=GIOB, DioPortDefPortId=12054, DioPortDefMaskInPkgA=255, DioPortDefMaskInPkgB=255
      DioPortNHet1: DioPortDefName=NHET1, DioPortDefPortId=11796, DioPortDefMaskInPkgA=4294967295, DioPortDefMaskInPkgB=4292870143
      DioPortNHet2: DioPortDefName=NHET2, DioPortDefPortId=11860, DioPortDefMaskInPkgA=393215, DioPortDefMaskInPkgB=2796171
      DioPortCan1Tx: DioPortDefName=CAN1, DioPortDefPortId=79736, DioPortDefMaskInPkgA=1, DioPortDefMaskInPkgB=1
      DioPortCan1Rx: DioPortDefName=CAN1, DioPortDefPortId=79737, DioPortDefMaskInPkgA=1, DioPortDefMaskInPkgB=1
      DioPortCan2Tx: DioPortDefName=CAN2, DioPortDefPortId=79864, DioPortDefMaskInPkgA=1, DioPortDefMaskInPkgB=1
      DioPortCan2Rx: DioPortDefName=CAN2, DioPortDefPortId=79865, DioPortDefMaskInPkgA=1, DioPortDefMaskInPkgB=1
      DioPortCan3Tx: DioPortDefName=CAN3, DioPortDefPortId=79992, DioPortDefMaskInPkgA=1, DioPortDefMaskInPkgB=1
      DioPortCan3Rx: DioPortDefName=CAN3, DioPortDefPortId=79993, DioPortDefMaskInPkgA=1, DioPortDefMaskInPkgB=1
      DioPortAdc1: DioPortDefName=ADC1, DioPortDefPortId=274496, DioPortDefMaskInPkgA=1, DioPortDefMaskInPkgB=1
      DioPortAdc2: DioPortDefName=ADC2, DioPortDefPortId=274624, DioPortDefMaskInPkgA=1, DioPortDefMaskInPkgB=1
      DioPortLin: DioPortDefName=LIN, DioPortDefPortId=14609, DioPortDefMaskInPkgA=6, DioPortDefMaskInPkgB=6
      DioPortSci: DioPortDefName=SCI, DioPortDefPortId=14673, DioPortDefMaskInPkgA=6, DioPortDefMaskInPkgB=6
      DioPortIic: DioPortDefName=IIC, DioPortDefPortId=13588, DioPortDefMaskInPkgA=3, DioPortDefMaskInPkgB=3
      DioPortSpi1: DioPortDefName=SPI1, DioPortDefPortId=15623, DioPortDefMaskInPkgA=33689407, DioPortDefMaskInPkgB=33689399
      DioPortSpi2: DioPortDefName=SPI2, DioPortDefPortId=15751, DioPortDefMaskInPkgA=3843, DioPortDefMaskInPkgB=0
      DioPortSpi3: DioPortDefName=SPI3, DioPortDefPortId=15879, DioPortDefMaskInPkgA=3903, DioPortDefMaskInPkgB=3903
      DioPortSpi4: DioPortDefName=SPI4, DioPortDefPortId=16007, DioPortDefMaskInPkgA=3841, DioPortDefMaskInPkgB=3841
      DioPortSpi5: DioPortDefName=SPI5, DioPortDefPortId=16135, DioPortDefMaskInPkgA=235802383, DioPortDefMaskInPkgB=3841
      DioPortRtp: DioPortDefName=RTP, DioPortDefPortId=147087, DioPortDefMaskInPkgA=524287, DioPortDefMaskInPkgB=0
      DioPortEclk: DioPortDefName=SYS, DioPortDefPortId=147394, DioPortDefMaskInPkgA=1, DioPortDefMaskInPkgB=1
      DioPortDmm: DioPortDefName=DMMDATA, DioPortDefPortId=146909, DioPortDefMaskInPkgA=524287, DioPortDefMaskInPkgB=36224
      DioPortEsm: DioPortDefName=ESMEPSR, DioPortDefPortId=146761, DioPortDefMaskInPkgA=1, DioPortDefMaskInPkgB=1
    5 x DioPort, all with DioPortId=0:
      Adc1: DioPortDefRef=DioPortAdc1
        ADC1_Ch0 (DioChannel): DioChannelId=0
        DioChannelGroupAdc1 (DioChannelGroup): DioChannelGroupIdentification=&DioChannelGroupAdc1, DioPortMask=1, DioPortOffset=0
      Spi3: DioPortDefRef=DioPortSpi3
        SPI3_NCS1 (DioChannel): DioChannelId=1
        DioChannelGroupSpi3 (DioChannelGroup): DioChannelGroupIdentification=&DioChannelGroupSpi3, DioPortMask=1, DioPortOffset=0
      CAN3_Rx: DioPortDefRef=DioPortCan3Rx
        Can3Rx (DioChannel): DioChannelId=0
        DioChannelGroupCan3Rx (DioChannelGroup): DioChannelGroupIdentification=&DioChannelGroupCan3Rx, DioPortMask=1, DioPortOffset=0
      CAN3_Tx: DioPortDefRef=DioPortCan3Tx
        Can3Tx (DioChannel): DioChannelId=0
        DioChannelGroupCan3Tx (DioChannelGroup): DioChannelGroupIdentification=&DioChannelGroupCanTx, DioPortMask=1, DioPortOffset=0
      Esm: DioPortDefRef=DioPortEsm
        nERROR (DioChannel): DioChannelId=0
        DioChannelGroupEsm (DioChannelGroup): DioChannelGroupIdentification=&DioChannelGroupEsm, DioPortMask=1, DioPortOffset=0
  module config ElePwr: implementation-config-variant=VARIANT-PRE-COMPILE  # Configuration of the Nexteer ElePwr module.
    ElePwrGeneral
    CommonPublishedInformation: ArMajorVersion=3, ArMinorVersion=2, ArPatchVersion=0, SwMajorVersion=0, SwMinorVersion=0, SwPatchVersion=0, ModuleId=0, VendorId=0
  module config EOTActuatorMng: implementation-config-variant=VARIANT-PRE-COMPILE  # Configuration of the Nexteer EOTActuatorMng module.
    EOTActuatorMngGeneral
    CommonPublishedInformation: ArMajorVersion=3, ArMinorVersion=2, ArPatchVersion=0, SwMajorVersion=0, SwMinorVersion=0, SwPatchVersion=0, ModuleId=0, VendorId=0
  module config Fee: implementation-config-variant=VARIANT-PRE-COMPILE, module-description=Fee_Implementation  # Flash EEPROM Emulation Configuration
    FeePublishedInformation:
      FeeBlockOverhead = 24
      FeeMaximumBlockingTime = 600
      FeePageOverhead = 0
      FeeVirtualSectorOverhead = 16
      FeeIncludeFile = Fee.h
      FeeSetModeApi = Fee_SetMode
      FeeReadApi = Fee_Read
      FeeWriteApi = Fee_Write
      FeeCancelApi = Fee_Cancel
      FeeGetStatusApi = Fee_GetStatus
      FeeGetJobResultApi = Fee_GetJobResult
      FeeEraseImmediateBlockApi = Fee_EraseImmediateBlock
      FeeInvalidateBlockApi = Fee_InvalidateBlock
    FeeGeneral:
      FeeDevErrorDetect = false
      FeeDeviceIndex = 0
      FeeNvmJobEndNotification = NvM_JobEndNotification
      FeeNvmJobErrorNotification = NvM_JobErrorNotification
      FeePollingMode = true
      FeeVersionInfoApi = false
      FeeEnableErrorCorrection = true
      FeeVirtualPageSize = 8
      FeeFrequency = 160
      FeeCRCEnable = false
      FeeWriteCounterSave = false
      FeeNumberOfVirtualSectors = 4
      FeeNumberOfVirtualSectorsEEP1 = 2
      FeeNumberOfUnconfiguredBlocksToCopy = 0
      FeeNumberOfEightByteWrites = 128
      FeeCheckBank7Access = false
      FeeGenerateDeviceandvirtualsectorstruc = true
      FeeVirtualsectorSize = VS_16
      FeePhysicalsectorSize = PS_4
    FeeBlockConfiguration42 (FeeBlockConfiguration):
      FeeDataset = 2
      FeeBlockNumber = 2
      FeeBlockSize = 4
      FeeImmediateData = false
      FeeNumberOfWriteCycles = 1
      FeeBlockName = Fee_Block_ConfigBlock
      FeeDeviceIndex = 0
      FeeBlockConfiguration = 1
      FeeEEPNumber = 0
      Fee
        FeeBlockConfiguration: FeeNvmBlockName=ConfigBlock
    FeeTypes: FeeFlashErrCorrHandlingType=Fee_Fix
    FeeFlashConfiguration: FeeDeviceName=TMS570LS07xx
    53 x FeeBlockConfiguration, all with FeeDataset=1, FeeImmediateData=false, FeeNumberOfWriteCycles=1, FeeDeviceIndex=0:
      FeeBlockConfiguration4: FeeBlockNumber=4, FeeBlockSize=10, FeeBlockName=Fee_Block_Polarity_Polarity_Cnt_Str, FeeBlockConfiguration=2, FeeEEPNumber=0
        Fee
          FeeBlockConfiguration: FeeNvmBlockName=Rte_NvmBlock_Polarity_Polarity_Cnt_Str
      FeeBlockConfiguration44: FeeBlockNumber=6, FeeBlockSize=4102, FeeBlockName=Fee_Block_DigMSB_DigMSBEOLData, FeeBlockConfiguration=3, FeeEEPNumber=0
        Fee
          FeeBlockConfiguration: FeeNvmBlockName=Rte_NvmBlock_Sa_DigMSB_DigMSBEOLData
      FeeBlockConfiguration13: FeeBlockNumber=8, FeeBlockSize=8, FeeBlockName=Fee_Block_CurrParamComp_EOLNomMtrParam, FeeBlockConfiguration=4, FeeEEPNumber=0
        Fee
          FeeBlockConfiguration: FeeNvmBlockName=Rte_NvmBlock_CurrParamComp_EOLNomMtrParam
      FeeBlockConfiguration7: FeeBlockNumber=10, FeeBlockSize=4, FeeBlockName=Fee_Block_EpsDefeats, FeeBlockConfiguration=5, FeeEEPNumber=0
        Fee
          FeeBlockConfiguration: FeeNvmBlockName=NVM_BLOCK_EPSDEFEATS
      FeeBlockConfiguration33: FeeBlockNumber=12, FeeBlockSize=1, FeeBlockName=Fee_Block_CMS_NxtrMEC, FeeBlockConfiguration=6, FeeEEPNumber=0
        Fee
          FeeBlockConfiguration: FeeNvmBlockName=NVM_BLOCK_CMS_NXTRMEC
      FeeBlockConfiguration34: FeeBlockNumber=14, FeeBlockSize=4, FeeBlockName=Fee_Block_CMS_EcuSrlNum, FeeBlockConfiguration=7, FeeEEPNumber=0
        Fee
          FeeBlockConfiguration: FeeNvmBlockName=NVM_BLOCK_CMS_ECUSRLNUM
      FeeBlockConfiguration35: FeeBlockNumber=16, FeeBlockSize=4, FeeBlockName=Fee_Block_CMS_EpsSrlNum, FeeBlockConfiguration=8, FeeEEPNumber=0
        Fee
          FeeBlockConfiguration: FeeNvmBlockName=NVM_BLOCK_CMS_EPSSRLNUM
      FeeBlockConfiguration36: FeeBlockNumber=18, FeeBlockSize=12, FeeBlockName=Fee_Block_CMS_EcuHwPN, FeeBlockConfiguration=9, FeeEEPNumber=0
        Fee
          FeeBlockConfiguration: FeeNvmBlockName=NVM_BLOCK_CMS_ECUHWPN
      FeeBlockConfiguration37: FeeBlockNumber=20, FeeBlockSize=64, FeeBlockName=Fee_Block_CMS_NxtrManufScratchpad, FeeBlockConfiguration=10, FeeEEPNumber=0
        Fee
          FeeBlockConfiguration: FeeNvmBlockName=NVM_BLOCK_CMS_NXTRMANUFSCRATCHPAD
      FeeBlockConfiguration38: FeeBlockNumber=22, FeeBlockSize=2, FeeBlockName=Fee_Block_CMS_IgnCntr, FeeBlockConfiguration=11, FeeEEPNumber=1
        Fee
          FeeBlockConfiguration: FeeNvmBlockName=NVM_BLOCK_CMS_IGNCNTR
      FeeBlockConfiguration6: FeeBlockNumber=24, FeeBlockSize=60, FeeBlockName=Fee_Block_DiagMgr_NTCStrg, FeeBlockConfiguration=12, FeeEEPNumber=1
        Fee
          FeeBlockConfiguration: FeeNvmBlockName=NVM_BLOCK_DIAGMGR_NTCSTRG
      FeeBlockConfiguration40: FeeBlockNumber=26, FeeBlockSize=192, FeeBlockName=Fee_Block_DiagMgr_Blackbox, FeeBlockConfiguration=13, FeeEEPNumber=1
        Fee
          FeeBlockConfiguration: FeeNvmBlockName=NVM_BLOCK_DIAGMGR_BLACKBOX
      FeeBlockConfiguration43: FeeBlockNumber=28, FeeBlockSize=6, FeeBlockName=Fee_Block_BatteryVoltage_OvervoltageData, FeeBlockConfiguration=14, FeeEEPNumber=1
        Fee
          FeeBlockConfiguration: FeeNvmBlockName=Rte_NvmBlock_BatteryVoltage_OvervoltageData
      FeeBlockConfiguration39: FeeBlockNumber=30, FeeBlockSize=4, FeeBlockName=Fee_Block_StaMd_CloseCheckData, FeeBlockConfiguration=15, FeeEEPNumber=1
        Fee
          FeeBlockConfiguration: FeeNvmBlockName=Rte_NvmBlock_StaMd_CloseCheckData
      FeeBlockConfiguration51: FeeBlockNumber=32, FeeBlockSize=4, FeeBlockName=Fee_Block_ThrmlDutyCycle_FltStVal, FeeBlockConfiguration=16, FeeEEPNumber=1
        Fee
          FeeBlockConfiguration: FeeNvmBlockName=Rte_NvmBlock_ThrmlDutyCycle_ThrmlDutyCycle_FltStVal
      FeeBlockConfiguration52: FeeBlockNumber=34, FeeBlockSize=16, FeeBlockName=Fee_Block_DiagMgr_LatchCntrs, FeeBlockConfiguration=17, FeeEEPNumber=1
        Fee
          FeeBlockConfiguration: FeeNvmBlockName=NVM_BLOCK_DIAGMGR_LATCHCNTRS
      FeeBlockConfiguration8: FeeBlockNumber=36, FeeBlockSize=60, FeeBlockName=Deprecated_Block_Dem_CTCStrg, FeeBlockConfiguration=18, FeeEEPNumber=1
        Fee
          FeeBlockConfiguration: FeeNvmBlockName=Deprecated_NVM_BLOCK_DEM_CTCSTRG
      FeeBlockConfiguration9: FeeBlockNumber=38, FeeBlockSize=100, FeeBlockName=Fee_Block_StaMd_TypeHRamBuffer, FeeBlockConfiguration=19, FeeEEPNumber=1
        Fee
          FeeBlockConfiguration: FeeNvmBlockName=Rte_NvmBlock_StaMd_TypeHRamBuffer
      FeeBlockConfiguration47: FeeBlockNumber=40, FeeBlockSize=50, FeeBlockName=Fee_Block_SER_FlashLogA, FeeBlockConfiguration=20, FeeEEPNumber=0
        Fee
          FeeBlockConfiguration: FeeNvmBlockName=NVM_BLOCK_SER_FLASHLOGA
      FeeBlockConfiguration48: FeeBlockNumber=42, FeeBlockSize=50, FeeBlockName=Fee_Block_SER_FlashLogB, FeeBlockConfiguration=21, FeeEEPNumber=0
        Fee
          FeeBlockConfiguration: FeeNvmBlockName=NVM_BLOCK_SER_FLASHLOGB
      FeeBlockConfiguration72: FeeBlockNumber=44, FeeBlockSize=1, FeeBlockName=Fee_Block_SER_SecurityViolation, FeeBlockConfiguration=22, FeeEEPNumber=0
        Fee
          FeeBlockConfiguration: FeeNvmBlockName=NVM_BLOCK_SER_SECURITYVIOLATION
      FeeBlockConfiguration53: FeeBlockNumber=46, FeeBlockSize=5, FeeBlockName=Fee_Block_VehDyn_MotPosReset, FeeBlockConfiguration=23, FeeEEPNumber=1
        Fee
          FeeBlockConfiguration: FeeNvmBlockName=Rte_NvmBlock_VehDyn_MotPosReset
      FeeBlockConfiguration55: FeeBlockNumber=48, FeeBlockSize=11, FeeBlockName=Fee_Block_AuthenticationZone, FeeBlockConfiguration=24, FeeEEPNumber=0
        Fee
          FeeBlockConfiguration: FeeNvmBlockName=NVM_BLOCK_SER_AUTHENTICATIONZONE
      FeeBlockConfiguration56: FeeBlockNumber=50, FeeBlockSize=3, FeeBlockName=Fee_Block_ECUManufacturingDate, FeeBlockConfiguration=25, FeeEEPNumber=0
        Fee
          FeeBlockConfiguration: FeeNvmBlockName=NVM_BLOCK_SER_ECUMANUFACTURINGDATE
      FeeBlockConfiguration57: FeeBlockNumber=52, FeeBlockSize=22, FeeBlockName=Fee_Block_EMCStandardizationLabel, FeeBlockConfiguration=26, FeeEEPNumber=0
        Fee
          FeeBlockConfiguration: FeeNvmBlockName=NVM_BLOCK_SER_EMCSTANDARDIZATIONLABEL
      FeeBlockConfiguration58: FeeBlockNumber=54, FeeBlockSize=13, FeeBlockName=Fee_Block_CustECUSrlNum, FeeBlockConfiguration=27, FeeEEPNumber=0
        Fee
          FeeBlockConfiguration: FeeNvmBlockName=NVM_BLOCK_SER_CUSTECUSRLNUM
      FeeBlockConfiguration59: FeeBlockNumber=56, FeeBlockSize=3, FeeBlockName=Fee_Block_SER_SecurityKey, FeeBlockConfiguration=28, FeeEEPNumber=0
        Fee
          FeeBlockConfiguration: FeeNvmBlockName=NVM_BLOCK_SER_SECURITYKEY
      FeeBlockConfiguration60: FeeBlockNumber=58, FeeBlockSize=1, FeeBlockName=Fee_Block_SrlComInput_VVHTYPEData, FeeBlockConfiguration=29, FeeEEPNumber=0
        Fee
          FeeBlockConfiguration: FeeNvmBlockName=Rte_NvmBlock_SrlComInput_VVHTYPEData
      FeeBlockConfiguration61: FeeBlockNumber=60, FeeBlockSize=1, FeeBlockName=Fee_Block_SrlComInput_ElecIntData, FeeBlockConfiguration=30, FeeEEPNumber=0
        Fee
          FeeBlockConfiguration: FeeNvmBlockName=Rte_NvmBlock_SrlComInput_ElecIntData
      FeeBlockConfiguration62: FeeBlockNumber=62, FeeBlockSize=26, FeeBlockName=Fee_Block_SER_TuningSelect, FeeBlockConfiguration=31, FeeEEPNumber=0
        Fee
          FeeBlockConfiguration: FeeNvmBlockName=NVM_BLOCK_SER_TUNINGSELECT
      FeeBlockConfiguration65: FeeBlockNumber=64, FeeBlockSize=98, FeeBlockName=Deprecated_Block_CmMtrCurr_CurrTempOffset, FeeBlockConfiguration=32, FeeEEPNumber=0
        Fee
          FeeBlockConfiguration: FeeNvmBlockName=Deprecated_NvmBlock_CmMtrCurr_CurrTempOffset
      FeeBlockConfiguration66: FeeBlockNumber=66, FeeBlockSize=30, FeeBlockName=Fee_Block_CmMtrCurr_ShCurrCal, FeeBlockConfiguration=33, FeeEEPNumber=0
        Fee
          FeeBlockConfiguration: FeeNvmBlockName=Rte_NvmBlock_CmMtrCurr_ShCurrCal
      FeeBlockConfiguration67: FeeBlockNumber=68, FeeBlockSize=1026, FeeBlockName=Fee_Block_TrqCanc_CogTrqCal, FeeBlockConfiguration=34, FeeEEPNumber=0
        Fee
          FeeBlockConfiguration: FeeNvmBlockName=Rte_NvmBlock_TrqCanc_CogTrqCal
      FeeBlockConfiguration68: FeeBlockNumber=70, FeeBlockSize=22, FeeBlockName=Fee_Block_TrqCanc_CogTrqRplComp, FeeBlockConfiguration=35, FeeEEPNumber=0
        Fee
          FeeBlockConfiguration: FeeNvmBlockName=Rte_NvmBlock_TrqCanc_CogTrqRplComp
      FeeBlockConfiguration69: FeeBlockNumber=72, FeeBlockSize=8, FeeBlockName=Deprecated_Fee_Block_TrqCmdScl_TorqueCmdSF_Uls_f32, FeeBlockConfiguration=36, FeeEEPNumber=1
        Fee
          FeeBlockConfiguration: FeeNvmBlockName=Deprecated_Rte_NvmBlock_TrqCmdScl_TorqueCmdSF_Uls_f32
      FeeBlockConfiguration64: FeeBlockNumber=74, FeeBlockSize=10, FeeBlockName=Deprecated_Block_AbsHwPos_EOLVehCntrOffset, FeeBlockConfiguration=37, FeeEEPNumber=1
        Fee
          FeeBlockConfiguration: FeeNvmBlockName=Deprecated_NvmBlock_AbsHwPos_EOLVehCntrOffset
      FeeBlockConfiguration70: FeeBlockNumber=76, FeeBlockSize=14, FeeBlockName=Fee_Block_LrnEOT_LearnedEOT, FeeBlockConfiguration=38, FeeEEPNumber=1
        Fee
          FeeBlockConfiguration: FeeNvmBlockName=Rte_NvmBlock_LrnEOT_LearnedEOT
      FeeBlockConfiguration73: FeeBlockNumber=78, FeeBlockSize=206, FeeBlockName=Fee_Block_AvgFricLrn_AvgFricLrnData, FeeBlockConfiguration=39, FeeEEPNumber=1
        Fee
          FeeBlockConfiguration: FeeNvmBlockName=Rte_NvmBlock_AvgFricLrn_AvgFricLrnData
      FeeBlockConfiguration45: FeeBlockNumber=80, FeeBlockSize=96, FeeBlockName=Fee_Block_CmMtrCurr_CurrTempOffset, FeeBlockConfiguration=40, FeeEEPNumber=0
        Fee
          FeeBlockConfiguration: FeeNvmBlockName=Rte_NvmBlock_CmMtrCurr_CurrTempOffset
      FeeBlockConfiguration46: FeeBlockNumber=82, FeeBlockSize=5, FeeBlockName=Deprecated_Fee_Block_AbsHwPos_EOLVehCntrOffset, FeeBlockConfiguration=41, FeeEEPNumber=0
        Fee
          FeeBlockConfiguration: FeeNvmBlockName=Deprecated_Rte_NvmBlock_AbsHwPos_EOLVehCntrOffset
      FeeBlockConfiguration49: FeeBlockNumber=84, FeeBlockSize=1200, FeeBlockName=Fee_Block_FaultLog_FaultLog, FeeBlockConfiguration=42, FeeEEPNumber=1
        Fee
          FeeBlockConfiguration: FeeNvmBlockName=Rte_NvmBlock_FaultLog_FaultLog
      FeeBlockConfiguration71: FeeBlockNumber=86, FeeBlockSize=1151, FeeBlockName=Deprecated_Block_Dem_CTCStrg1, FeeBlockConfiguration=43, FeeEEPNumber=1
        Fee
          FeeBlockConfiguration: FeeNvmBlockName=Deprecated_BLOCK_DEM_CTCSTRG1
      FeeBlockConfiguration74: FeeBlockNumber=88, FeeBlockSize=5, FeeBlockName=Fee_Block_SrlComInput_ShutdownTimeData, FeeBlockConfiguration=44, FeeEEPNumber=1
        Fee
          FeeBlockConfiguration: FeeNvmBlockName=Rte_NvmBlock_SrlComInput_ShutdownTimeData
      FeeBlockConfiguration54: FeeBlockNumber=90, FeeBlockSize=1225, FeeBlockName=Fee_Block_Dem_CTCStrg, FeeBlockConfiguration=45, FeeEEPNumber=1
        Fee
          FeeBlockConfiguration: FeeNvmBlockName=NVM_BLOCK_DEM_CTCSTRG
      FeeBlockConfiguration76: FeeBlockNumber=92, FeeBlockSize=6, FeeBlockName=Fee_Block_AbsHwPos_EOLVehCntrOffset, FeeBlockConfiguration=46, FeeEEPNumber=0
        Fee
          FeeBlockConfiguration: FeeNvmBlockName=Rte_NvmBlock_AbsHwPos_EOLVehCntrOffset
      FeeBlockConfiguration75: FeeBlockNumber=94, FeeBlockSize=4, FeeBlockName=Fee_Block_HwTqCorrln_Ch1CMCLPFSvData, FeeBlockConfiguration=47, FeeEEPNumber=1
        Fee
          FeeBlockConfiguration: FeeNvmBlockName=Rte_NvmBlock_HwTqCorrln_HwTqCorrlnCh1CMCLPFSvData
      FeeBlockConfiguration77: FeeBlockNumber=96, FeeBlockSize=7, FeeBlockName=Deprecated_Fee_Block_Sa_HwTqArbn_HwTqArbnEOLCh1OffsetTrimData, FeeBlockConfiguration=48, FeeEEPNumber=0
        Fee
          FeeBlockConfiguration: FeeNvmBlockName=Deprecated_Rte_NvmBlock_HwTqArbn_HwTqArbnEOLCh1OffsetTrimData
      FeeBlockConfiguration: FeeBlockNumber=98, FeeBlockSize=3, FeeBlockName=Fee_Block_SER_PowerpackConfig, FeeBlockConfiguration=49, FeeEEPNumber=0
        Fee
          FeeBlockConfiguration: FeeNvmBlockName=NVM_BLOCK_SER_POWERPACKCONFIG
      FeeBlockConfiguration1: FeeBlockNumber=100, FeeBlockSize=10, FeeBlockName=Deprecated_Fee_PsaAgArbn_PsaAgArbnLrndOffsData, FeeBlockConfiguration=50, FeeEEPNumber=0
        Fee
          FeeBlockConfiguration: FeeNvmBlockName=Deprecated_Rte_NvmBlock_PsaAgArbn_PsaAgArbnLrndOffsData
      FeeBlockConfiguration78: FeeBlockNumber=102, FeeBlockSize=10, FeeBlockName=Fee_Block_Sa_HwTqArbn_HwTqArbnEOLCh1OffsetTrimData, FeeBlockConfiguration=51, FeeEEPNumber=0
        Fee
          FeeBlockConfiguration: FeeNvmBlockName=Rte_NvmBlock_HwTqArbn_HwTqArbnEOLCh1OffsetTrimData
      FeeBlockConfiguration50: FeeBlockNumber=104, FeeBlockSize=8, FeeBlockName=Fee_Block_TrqCmdScl_TorqueCmdSF_Uls_f32, FeeBlockConfiguration=52, FeeEEPNumber=0
        Fee
          FeeBlockConfiguration: FeeNvmBlockName=Rte_NvmBlock_TrqCmdScl_TorqueCmdSF_Uls_f32
      FeeBlockConfiguration63: FeeBlockNumber=106, FeeBlockSize=10, FeeBlockName=Fee_PsaAgArbn_PsaAgArbnLrndOffsData, FeeBlockConfiguration=53, FeeEEPNumber=1
        Fee
          FeeBlockConfiguration: FeeNvmBlockName=Rte_NvmBlock_PsaAgArbn_PsaAgArbnLrndOffsData
      FeeBlockConfiguration79: FeeBlockNumber=108, FeeBlockSize=4, FeeBlockName=Fee_ActivePull_PullCmpLTComp, FeeBlockConfiguration=54, FeeEEPNumber=1
        Fee
          FeeBlockConfiguration: FeeNvmBlockName=Rte_NvmBlock_ActivePull_PullCmpLTComp_HwNm_f32
  module config FlsTst: implementation-config-variant=VARIANT-PRE-COMPILE  # Configuration of the Flash Test module
    Runtime (FlsTstConfigSet): FlsTstBlockNumberBgnd=3, FlsTstBlockNumberFgnd=0, FlsTstTestCompletedNotification=Appl_FlsTstCompletedNotif
      FlsTstBlockBgndConfigSet
        3 x FlsTstBlock, all with FlsTstBlockBaseAddress=(unset), FlsTstBlockIndex=(unset), FlsTstNumberOfTestedCells=(unset), FlsTstSignatureAddress=(unset), FlsTstTestAlgorithm=FLSTST_64BIT_CRC:
          Cal: FlsTstBlockBaseSymbol=CCT_Range_11_Start, FlsTstBlockSize=131040, FlsTstSignatureSymbol=CCT_Range_11_Address
          App: FlsTstBlockBaseSymbol=CCT_Range_10_Start, FlsTstBlockSize=606192, FlsTstSignatureSymbol=CCT_Range_10_Address
          Boot: FlsTstBlockBaseSymbol=BootCRC_Start, FlsTstBlockSize=49136, FlsTstSignatureSymbol=BootCRC_Address
    FlsTstConfigurationOfOptApiServices:
      FlsTstGetCurrentStateApi = false
      FlsTstGetErrorDetailsApi = false
      FlsTstGetTestResultBgndApi = false
      FlsTstGetTestResultFgndApi = false
      FlsTstGetTestSignatureBgndApi = false
      FlsTstGetTestSignatureFgndApi = false
      FlsTstStartFgndApi = false
      FlsTstSuspendResumeApi = true
      FlsTstTestEccApi = false
      FlsTstVersionInfoApi = false
    FlsTstDemEventParameterRefs:
      FLSTST_E_FLSTST_FAILURE = NTC_Num_FlashCRCMemFault
      FLSTST_E_FLSTST_INFO = 1
      FLSTST_E_SELFTEST_FAILURE = NTC_Num_CPU_CoreInitFlt
      FLSTST_E_SELFTEST_INFO = 8
      FLSTST_E_MPU_FAILURE = NTC_Num_PerDiag_DMAFlt
      FLSTST_E_MPU_INFO = 128
      FLSTST_E_UNEXPECTEDIRQ_FAILURE = NTC_Num_FlashCRCMemFault
      FLSTST_E_UNEXPECTEDIRQ_INFO = 1
      FlsTstDemInclude = Ap_DiagMgr.h
      FailureAPI = NxtrDiagMgr10_ReportNTCStatus
    FlsTstGeneral:
      FlsTstDevErrorDetect = false
      FlsTstNumberOfTestedCellsAtomic = 1
      FlsTstTestCompletedNotificationSupported = true
      FlsTstTestIntervalIdEndValue = 4294967295
      FlsTstTestResultSignature = false
    CommonPublishedInformation: ArMajorVersion=1, ArMinorVersion=2, ArPatchVersion=0, SwMajorVersion=1, SwMinorVersion=0, SwPatchVersion=0, ModuleId=104, VendorId=0
  module config FrqDepDmpnInrtCmp: implementation-config-variant=VARIANT-PRE-COMPILE  # Configuration of the Nexteer FrqDepDmpnInrtCmp module.
    FrqDepDmpnInrtCmpGeneral
    CommonPublishedInformation: ArMajorVersion=3, ArMinorVersion=2, ArPatchVersion=0, SwMajorVersion=0, SwMinorVersion=0, SwPatchVersion=0, ModuleId=0, VendorId=0
  module config Gpt: implementation-config-variant=VARIANT-POST-BUILD, module-description=Gpt_Impl  # Configuration of the Gpt (General Purpose Timer) module.
    Gpt_Runtime (GptChannelConfigSet):
      GptChannelPrescaleClk0 = 79
      GptChannelPrescaleClk1 = 79
      GptMcuVariant = McuModuleConfiguration
      GptMcuClockconfig = McuClockSettingConfig
      GptMainclock = RTICLK1
      GptClockFrequency = 80
      SystemTime_uS (GptChannelConfiguration):
        GptChannelClkSrc = 0
        GptChannelMode = GPT_MODE_CONTINUOUS
        GptChannelPrescale = 0
        GptEnableWakeup = false
        GptNotification = SystemTick
        GptHwChannel = 0
        GptChannelId = 0
        GptResolution = 1
        GptWakeupConfiguration
    GptConfigurationOfOptApiServices:
      GptDeinitApi = true
      GptEnableDisableNotificationApi = true
      GptTimeElapsedApi = true
      GptTimeRemainingApi = true
      GptVersionInfoApi = false
      GptWakeupFunctionalityApi = true
    GptDriverConfiguration:
      GptDevErrorDetect = false
      GptReportWakeupSource = true
      GptCfgWakeupInclude = EcuM_Cbk.h
      GptErrorhook = Det_ReportError
      GptCfgIncludeDet = Det.h
      GptCfgChkUninit = true
      GptCfgChkParamChl = false
      GptCfgChkParamMode = true
      GptCfgChkParamValue = true
      GptCfgChkParamVinfo = true
      GptCfgChkBusy = true
      GptCfgIncludeList = ApplCallbacks.h
      GptCfgChkParamConfig = true
      GptCfgDoParamChk = true
      GptCfgChkParamWakeupchl = false
      GptCfgChkNotifptr = true
      GptCfgDebugReporting = true
      GptCfgChkAlreadyInit = true
      GptCfgChkNotStarted = true
      GptSpecRegAccEnabled = true
      GptSpecRegAccOnlyForWrite = true
      GptSpecRegAccOnlyForPrivModeReg = true
      GptSpecRegAccNotInInit = false
      GptNativeIsr = GPT_ISR_CAT2
      GptIrqHandling = InterruptFunctionSet
  module config HighFreqAssist: implementation-config-variant=VARIANT-PRE-COMPILE  # Configuration of the Nexteer HighFreqAssist module.
    HighFreqAssistGeneral
    CommonPublishedInformation: ArMajorVersion=3, ArMinorVersion=2, ArPatchVersion=0, SwMajorVersion=0, SwMinorVersion=0, SwPatchVersion=0, ModuleId=0, VendorId=0
  module config HiLoadStall: implementation-config-variant=VARIANT-PRE-COMPILE  # Configuration of the Nexteer HiLoadStall module.
    HiLoadStallGeneral
    CommonPublishedInformation: ArMajorVersion=3, ArMinorVersion=2, ArPatchVersion=0, SwMajorVersion=0, SwMinorVersion=0, SwPatchVersion=0, ModuleId=0, VendorId=0
  module config HwPwUp: implementation-config-variant=VARIANT-PRE-COMPILE  # Configuration of the Nexteer HwPwUp module.
    HwPwUpGeneral: HwPwUpPgmSpecMask=0
    CommonPublishedInformation: ArMajorVersion=3, ArMinorVersion=2, ArPatchVersion=0, SwMajorVersion=0, SwMinorVersion=0, SwPatchVersion=0, ModuleId=0, VendorId=0
  module config HystComp: implementation-config-variant=VARIANT-PRE-COMPILE  # Configuration of the Nexteer HystComp module.
    HystCompGeneral
    CommonPublishedInformation: ArMajorVersion=3, ArMinorVersion=2, ArPatchVersion=0, SwMajorVersion=0, SwMinorVersion=0, SwPatchVersion=0, ModuleId=0, VendorId=0
  module config IoHwAb: definition=IoHwAbstraction, implementation-config-variant=VARIANT-PRE-COMPILE, module-description=IoHwAbstraction_Impl  # Configuration of IO HW Abstraction.
    IoHwAbCalSignals
      11 x IoHwAbDiscrete, all with IoHwAbCreateOpDiag=false, IoHwAbDcmAccess=false, IoHwAbCalSourceType=DioChannel, IoHwAbRequirementId=(unset):
        EpsEn: IoHwAbCreateOpSet=false, IoHwAbCreateOpGet=true, IoHwAbDcmDefaultValue=0, IoHwAbDioEntity=ADC1_Ch0
        PwrSwitchEn: IoHwAbCreateOpSet=false, IoHwAbCreateOpGet=true, IoHwAbDioEntity=NHet_Ch8
        FetDrvCntl: IoHwAbCreateOpSet=false, IoHwAbCreateOpGet=true, IoHwAbDioEntity=NHet_Ch4
        FetFlt2Clk: IoHwAbCreateOpSet=true, IoHwAbCreateOpGet=true, IoHwAbDioEntity=NHet_Ch26
        FetFlt1Data: IoHwAbCreateOpSet=false, IoHwAbCreateOpGet=true, IoHwAbDioEntity=NHet_Ch24
        SysFault2: IoHwAbCreateOpSet=true, IoHwAbCreateOpGet=true, IoHwAbDioEntity=NHet_Ch15
        WdMonitor: IoHwAbCreateOpSet=true, IoHwAbCreateOpGet=false, IoHwAbDioEntity=Can3Rx
        FetDrvReset: IoHwAbCreateOpSet=true, IoHwAbCreateOpGet=true, IoHwAbDioEntity=SPI3_NCS1
        WdReset: IoHwAbCreateOpSet=true, IoHwAbCreateOpGet=false, IoHwAbDioEntity=Can3Tx
        TODReset: IoHwAbCreateOpSet=true, IoHwAbCreateOpGet=false, IoHwAbDcmDefaultValue=0, IoHwAbDioEntity=NHet_Ch20
        OvrVoltFdbk: IoHwAbCreateOpSet=false, IoHwAbCreateOpGet=true, IoHwAbDioEntity=NHet_Ch22
    IoHwAbUserDefSignals
      IoHwAbPortConfig (IoHwAbUserDefPort)
        SetFetFlt2ToOutput (IoHwAbUserDefinedOp):
          IoHwAbAccess = Output
          IoHwAbDataType = IoHwAbBoolType
          IoHwAbUnit = None
          IoHwAbRangeMin = (unset)
          IoHwAbRangeMax = (unset)
          IoHwAbResolution = (unset)
          IoHwAbDcmAccess = false
          IoHwAbRequirementId = (unset)
          IoHwAbDcmDefaultValue = 0
      SysFault3 (IoHwAbUserDefPort)
        OP_GET (IoHwAbUserDefinedOp):
          IoHwAbAccess = Input
          IoHwAbDataType = IoHwAbBoolType
          IoHwAbUnit = None
          IoHwAbRangeMin = 0
          IoHwAbRangeMax = (unset)
          IoHwAbResolution = (unset)
          IoHwAbDcmAccess = false
          IoHwAbRequirementId = (unset)
        OP_SET (IoHwAbUserDefinedOp):
          IoHwAbAccess = Output
          IoHwAbDataType = IoHwAbBoolType
          IoHwAbUnit = None
          IoHwAbRangeMin = 0
          IoHwAbRangeMax = (unset)
          IoHwAbResolution = (unset)
          IoHwAbDcmAccess = false
          IoHwAbRequirementId = (unset)
    IoHwAbHandlers
    IoHwAbGeneral:
      IoHwAbDevErrorDetect = true
      IoHwAbDevErrorReport = true
      IoHwAbVersionInfoApi = true
      IoHwAbUseInitFunction = false
      IoHwAbUseRte = true
      IoHwAbUseServicePorts = false
      IoHwAbServiceComponentName = IoHwAbstraction
      IoHwAbErrorhook = Det_ReportError
      IoHwAbCfgIncludeDet = Det.h
      IoHwAbCfgIncludeList = Dio.h
      IoHwAbIrqHandling = SuspendAllInterrupts
      IoHwAbErrorChecks: IoHwAbCfgChkParamPointer=true
      IoHwAbDataTypeSizes:
        IoHwAbDiscreteGroupSize = IOHWAB_UINT8
        IoHwAbCurrentType = IOHWAB_UINT16
        IoHwAbVoltageType = IOHWAB_UINT16
        IoHwAbResistanceType = IOHWAB_UINT16
        IoHwAbSignalDiagnosisType = IOHWAB_UINT16
        IoHwAbPwxPeriodType = IOHWAB_UINT16
        IoHwAbPwxDutyCycleType = IOHWAB_UINT16
    VectorCommonData: BswmdVersion=1.04.06
  module config LmtCod: implementation-config-variant=VARIANT-PRE-COMPILE  # Configuration of the Nexteer LmtCod module.
    LmtCodGeneral
    CommonPublishedInformation: ArMajorVersion=3, ArMinorVersion=2, ArPatchVersion=0, SwMajorVersion=0, SwMinorVersion=0, SwPatchVersion=0, ModuleId=0, VendorId=0
  module config LrnEOT: implementation-config-variant=VARIANT-PRE-COMPILE  # Configuration of the Nexteer LrnEOT module.
    LrnEOTGeneral
    CommonPublishedInformation: ArMajorVersion=3, ArMinorVersion=2, ArPatchVersion=0, SwMajorVersion=0, SwMinorVersion=0, SwPatchVersion=0, ModuleId=0, VendorId=0
  module config MemIf: implementation-config-variant=VARIANT-PRE-COMPILE, module-description=MemIf_Impl  # Configuration of the MemIf (Memory Abstraction Interface) module.
    MemIfGeneral: MemIfDevErrorDetect=true, MemIfVersionInfoApi=true
    MemIfAdditional:
      MemIfCfgChkParamDevIndex = true
      MemIfCfgChkParamVInfo = true
      MemIfDebugReporting = true
      MemIfCfgIncludeDet = Det.h
      MemIfErrorhook = Det_ReportError
      MemIfCfgUseFctApi = true
  module config MtrDrvDiag: implementation-config-variant=VARIANT-PRE-COMPILE  # Configuration of the Nexteer MtrDrvDiag module.
    MtrDrvDiagGeneral
    CommonPublishedInformation: ArMajorVersion=3, ArMinorVersion=2, ArPatchVersion=0, SwMajorVersion=0, SwMinorVersion=0, SwPatchVersion=0, ModuleId=0, VendorId=0
  module config MtrTempEst: implementation-config-variant=VARIANT-PRE-COMPILE  # Configuration of the Nexteer MtrTempEst module.
    MtrTempEstGeneral
    CommonPublishedInformation: ArMajorVersion=3, ArMinorVersion=2, ArPatchVersion=0, SwMajorVersion=0, SwMinorVersion=0, SwPatchVersion=0, ModuleId=0, VendorId=0
  module config MtrVel: implementation-config-variant=VARIANT-PRE-COMPILE  # Configuration of the Nexteer MtrVel module.
    MtrVelGeneral
    CommonPublishedInformation: ArMajorVersion=3, ArMinorVersion=2, ArPatchVersion=0, SwMajorVersion=0, SwMinorVersion=0, SwPatchVersion=0, ModuleId=0, VendorId=0
  module config MtrVel2: implementation-config-variant=VARIANT-PRE-COMPILE  # Configuration of the Nexteer MtrVel2 module.
    MtrVel2General
    CommonPublishedInformation: ArMajorVersion=3, ArMinorVersion=2, ArPatchVersion=0, SwMajorVersion=0, SwMinorVersion=0, SwPatchVersion=0, ModuleId=0, VendorId=0
  module config NvM: implementation-config-variant=VARIANT-LINK-TIME, module-description=NvM_Impl  # Configuration of the NvM (NvRam Manager) module.
    NVM_BLOCK_DIAGMGR_NTCSTRG (NvmBlockDescriptor):
      NvmNvramBlockIdentifier = 2
      NvmDeviceName = Fee
      NvmBlockManagementType = NVM_BLOCK_NATIVE
      NvmBlockUseCrc = false
      NvmBlockCRCType = NVM_CRC16
      NvmBlockUsedCrcType = NVM_NOCRC
      NvmCalcRamBlockCrc = false
      NvmBlockJobPriority = 127
      NvmNvBlockLength = 60
      NvmNvBlockNum = 1
      NvmUseServicePorts = true
      NvmWriteBlockOnce = false
      NvmBlockWriteProt = false
      NvmResistantToChangedSw = true
      NvmSelectBlockForReadall = true
      NvmRamBlockDataAddress = NTCStrgArray_Cnt_str
      NvmRomBlockDataAddress = (unset)
      NvmUseInitCallback = false
      NvmInitBlockCallback = NULL_PTR
      NvmUseJobendCallback = false
      NvmJobendCbkAtReadAll = false
      NvmSingleBlockCallback = NULL_PTR
      NvmRequirementId = (unset)
      NvmTargetBlockReference
        NvmFeeRef: NvmNameOfFeeBlock=FeeBlockConfiguration6
    NvmCommon:
      NvmDevErrorDetect = true
      NvmApiConfigClass = NvmApiConfigClass3
      NvmVersionInfoApi = false
      NvmSetRamBlockStatusApi = true
      NvmDrvModeSwitch = true
      NvmPollingMode = true
      NvmDynamicConfiguration = true
      NvmJobPrioritization = false
      NvmCrcNumOfBytes = 65535
      NvmDatasetSelectionBits = 1
      NvmSizeImmediateJobQueue = 1
      NvmSizeStandardJobQueue = 8
      NvmMaxNoOfWriteRetries = 3
      NvmTotalNumOfNvramBlocks = 2
      NvmCompiledConfigId = 1
      NvmMultiBlockCallback = EcuM_CB_NfyNvMJobEnd
    Nvm_30_CommonVendorParams:
      NvmDebugReporting = true
      NvmCfgIncludeDet = Det.h
      NvmErrorhook = Det_ReportError
      NvmCfgChkStatusUninit = true
      NvmCfgChkRamBlockLengths = false
      NvmCfgChkRomBlockLengths = false
      NvmCfgChkBlockLengthStrict = true
      NvmCfgChkMngmtType = true
      NvmCfgChkBlockProtection = true
      NvmCfgChkBlockPending = false
      NvmCfgChkDoParamChk = true
      NvmCfgChkParamBlockid = true
      NvmCfgChkParamDataIndex = true
      NvmCfgChkParamPointer = true
      NvmCfgIncludeDem = Dem.h
      NvmSeterror = Dem_ReportErrorStatus
      NvmCfgCbkIncludeList = EcuM_Cbk.h
      NvmCfgCbkIncludeList = CDD_Data.h
      NvmCfgCbkIncludeList = Ap_StaMd_Cfg.h
      NvmCfgCbkIncludeList = Ap_DiagMgr.h
      NvmCfgCbkIncludeList = Dem.h
      NvmCfgCbkIncludeList = ApplCallbacks.h
      NvmCfgCbkIncludeList = Ap_DfltConfigData.h
      NvmCfgCbkIncludeList = EPS_DiagSrvcs_SrvcLUTbl.h
      NvmCfgCbkIncludeList = Crc.h
      NvmCfgCbkIncludeList = Cd_NvMProxy.h
      NvmCfgCbkIncludeList = Dem_Lcfg.h
      NvmCfgCbkIncludeList = DiagSvc.h
      NvmMultiblockId = MultiBlockRequest
      NvmServiceComponentName = NvM
      Nvm_UseLongSwcNames = true
      NvmSrvPortInitBlockPrefix = Nvm_RpNotifyInit_
      NvmSrvPortJobEndPrefix = NvM_RpNotifyJobEnd_
      NvmCrcIntBuffer = true
      NvmCrcPreserveValue = true
      NvmKillWriteAllApi = true
      NvmLockSet = SuspendAllInterrupts
    ConfigBlock (NvmConfigBlockDescriptor):
      NvmNvramBlockIdentifier = 1
      NvmDeviceName = Fee
      NvmBlockManagementType = NVM_BLOCK_REDUNDANT
      NvmBlockUseCrc = true
      NvmBlockCRCType = NVM_CRC16
      NvmCalcRamBlockCrc = true
      NvmBlockJobPriority = 127
      NvmNvBlockLength = 2
      NvmNvBlockNum = 2
      NvmUseServicePorts = true
      NvmWriteBlockOnce = false
      NvmBlockWriteProt = false
      NvmResistantToChangedSw = true
      NvmSelectBlockForReadall = true
      NvmRomBlockDataAddress = NULL_PTR
      NvmUseInitCallback = false
      NvmInitBlockCallback = NULL_PTR
      NvmUseJobendCallback = false
      NvmJobendCbkAtReadAll = false
      NvmSingleBlockCallback = (unset)
      NvmRequirementId = (unset)
      NvmTargetBlockReference
        NvmFeeRef: NvmNameOfFeeBlock=FeeBlockConfiguration42
    52 x NvmBlockDescriptor, all with NvmDeviceName=Fee, NvmBlockManagementType=NVM_BLOCK_NATIVE, NvmBlockCRCType=NVM_CRC16, NvmBlockJobPriority=127, NvmNvBlockNum=1, NvmWriteBlockOnce=false, NvmBlockWriteProt=false, NvmResistantToChangedSw=true, NvmUseJobendCallback=false, NvmSingleBlockCallback=NULL_PTR, NvmRequirementId=(unset):
      NVM_BLOCK_EPSDEFEATS: NvmNvramBlockIdentifier=3, NvmBlockUseCrc=false, NvmBlockUsedCrcType=NVM_NOCRC, NvmCalcRamBlockCrc=false, NvmNvBlockLength=4, NvmUseServicePorts=true, NvmSelectBlockForReadall=true, NvmRamBlockDataAddress=CDD_EOLSrlComSvcDft_Cnt_G_b32, NvmRomBlockDataAddress=(unset), NvmUseInitCallback=false, NvmInitBlockCallback=NULL_PTR, NvmJobendCbkAtReadAll=false
        NvmTargetBlockReference
          NvmFeeRef: NvmNameOfFeeBlock=FeeBlockConfiguration7
      Deprecated_NVM_BLOCK_DEM_CTCSTRG: NvmNvramBlockIdentifier=4, NvmBlockUseCrc=false, NvmBlockUsedCrcType=NVM_NOCRC, NvmCalcRamBlockCrc=false, NvmNvBlockLength=60, NvmUseServicePorts=false, NvmSelectBlockForReadall=false, NvmRamBlockDataAddress=(unset), NvmRomBlockDataAddress=(unset), NvmUseInitCallback=false, NvmInitBlockCallback=NULL_PTR, NvmJobendCbkAtReadAll=true
        NvmTargetBlockReference
          NvmFeeRef: NvmNameOfFeeBlock=FeeBlockConfiguration8
      Rte_NvmBlock_StaMd_TypeHRamBuffer: NvmNvramBlockIdentifier=5, NvmBlockUseCrc=false, NvmBlockUsedCrcType=NVM_NOCRC, NvmCalcRamBlockCrc=false, NvmNvBlockLength=100, NvmUseServicePorts=true, NvmSelectBlockForReadall=true, NvmRamBlockDataAddress=TypeHData_Cnt_u08, NvmRomBlockDataAddress=(unset), NvmUseInitCallback=false, NvmInitBlockCallback=NULL_PTR, NvmJobendCbkAtReadAll=false
        NvmTargetBlockReference
          NvmFeeRef: NvmNameOfFeeBlock=FeeBlockConfiguration9
      Rte_NvmBlock_Polarity_Polarity_Cnt_Str: NvmNvramBlockIdentifier=6, NvmBlockUseCrc=true, NvmBlockUsedCrcType=NVM_CRC16, NvmCalcRamBlockCrc=true, NvmNvBlockLength=8, NvmUseServicePorts=true, NvmSelectBlockForReadall=true, NvmRamBlockDataAddress=Rte_Ap_CtrlPolarityBrshlss_Polarity_Cnt_Str, NvmRomBlockDataAddress=(unset), NvmUseInitCallback=false, NvmInitBlockCallback=NULL_PTR, NvmJobendCbkAtReadAll=false
        NvmTargetBlockReference
          NvmFeeRef: NvmNameOfFeeBlock=FeeBlockConfiguration4
      Rte_NvmBlock_CurrParamComp_EOLNomMtrParam: NvmNvramBlockIdentifier=7, NvmBlockUseCrc=false, NvmBlockUsedCrcType=NVM_NOCRC, NvmCalcRamBlockCrc=false, NvmNvBlockLength=8, NvmUseServicePorts=true, NvmSelectBlockForReadall=true, NvmRamBlockDataAddress=Rte_CurrParamComp_EOLNomMtrParam, NvmRomBlockDataAddress=(unset), NvmUseInitCallback=false, NvmInitBlockCallback=NULL_PTR, NvmJobendCbkAtReadAll=false
        NvmTargetBlockReference
          NvmFeeRef: NvmNameOfFeeBlock=FeeBlockConfiguration13
      NVM_BLOCK_CMS_NXTRMEC: NvmNvramBlockIdentifier=8, NvmBlockUseCrc=false, NvmBlockUsedCrcType=NVM_NOCRC, NvmCalcRamBlockCrc=false, NvmNvBlockLength=1, NvmUseServicePorts=true, NvmSelectBlockForReadall=true, NvmRamBlockDataAddress=Nvm_NMEC_Cnt_u8, NvmRomBlockDataAddress=(unset), NvmUseInitCallback=false, NvmInitBlockCallback=NULL_PTR, NvmJobendCbkAtReadAll=false
        NvmTargetBlockReference
          NvmFeeRef: NvmNameOfFeeBlock=FeeBlockConfiguration33
      NVM_BLOCK_CMS_ECUSRLNUM: NvmNvramBlockIdentifier=9, NvmBlockUseCrc=false, NvmBlockUsedCrcType=NVM_NOCRC, NvmCalcRamBlockCrc=false, NvmNvBlockLength=4, NvmUseServicePorts=true, NvmSelectBlockForReadall=true, NvmRamBlockDataAddress=Nvm_EcuSrlNum_Cnt_u8, NvmRomBlockDataAddress=(unset), NvmUseInitCallback=false, NvmInitBlockCallback=NULL_PTR, NvmJobendCbkAtReadAll=false
        NvmTargetBlockReference
          NvmFeeRef: NvmNameOfFeeBlock=FeeBlockConfiguration34
      NVM_BLOCK_CMS_EPSSRLNUM: NvmNvramBlockIdentifier=10, NvmBlockUseCrc=false, NvmBlockUsedCrcType=NVM_NOCRC, NvmCalcRamBlockCrc=false, NvmNvBlockLength=4, NvmUseServicePorts=true, NvmSelectBlockForReadall=true, NvmRamBlockDataAddress=Nvm_EpsSrlNum_Cnt_u8, NvmRomBlockDataAddress=(unset), NvmUseInitCallback=false, NvmInitBlockCallback=NULL_PTR, NvmJobendCbkAtReadAll=false
        NvmTargetBlockReference
          NvmFeeRef: NvmNameOfFeeBlock=FeeBlockConfiguration35
      NVM_BLOCK_CMS_ECUHWPN: NvmNvramBlockIdentifier=11, NvmBlockUseCrc=false, NvmBlockUsedCrcType=NVM_NOCRC, NvmCalcRamBlockCrc=false, NvmNvBlockLength=12, NvmUseServicePorts=true, NvmSelectBlockForReadall=true, NvmRamBlockDataAddress=Nvm_EcuHwPn_Cnt_u8, NvmRomBlockDataAddress=(unset), NvmUseInitCallback=false, NvmInitBlockCallback=NULL_PTR, NvmJobendCbkAtReadAll=false
        NvmTargetBlockReference
          NvmFeeRef: NvmNameOfFeeBlock=FeeBlockConfiguration36
      NVM_BLOCK_CMS_NXTRMANUFSCRATCHPAD: NvmNvramBlockIdentifier=12, NvmBlockUseCrc=false, NvmBlockUsedCrcType=NVM_NOCRC, NvmCalcRamBlockCrc=false, NvmNvBlockLength=64, NvmUseServicePorts=true, NvmSelectBlockForReadall=true, NvmRamBlockDataAddress=Nvm_NxtrManfScrpd_Cnt_u8, NvmRomBlockDataAddress=(unset), NvmUseInitCallback=false, NvmInitBlockCallback=NULL_PTR, NvmJobendCbkAtReadAll=false
        NvmTargetBlockReference
          NvmFeeRef: NvmNameOfFeeBlock=FeeBlockConfiguration37
      NVM_BLOCK_CMS_IGNCNTR: NvmNvramBlockIdentifier=13, NvmBlockUseCrc=false, NvmBlockUsedCrcType=NVM_NOCRC, NvmCalcRamBlockCrc=false, NvmNvBlockLength=2, NvmUseServicePorts=true, NvmSelectBlockForReadall=true, NvmRamBlockDataAddress=Nvm_IgnCntr_Cnt_u16, NvmRomBlockDataAddress=(unset), NvmUseInitCallback=false, NvmInitBlockCallback=NULL_PTR, NvmJobendCbkAtReadAll=false
        NvmTargetBlockReference
          NvmFeeRef: NvmNameOfFeeBlock=FeeBlockConfiguration38
      Rte_NvmBlock_StaMd_CloseCheckData: NvmNvramBlockIdentifier=14, NvmBlockUseCrc=false, NvmBlockUsedCrcType=NVM_NOCRC, NvmCalcRamBlockCrc=false, NvmNvBlockLength=4, NvmUseServicePorts=true, NvmSelectBlockForReadall=true, NvmRamBlockDataAddress=NvMP_CloseCheck_Cnt_u32, NvmRomBlockDataAddress=(unset), NvmUseInitCallback=false, NvmInitBlockCallback=NULL_PTR, NvmJobendCbkAtReadAll=false
        NvmTargetBlockReference
          NvmFeeRef: NvmNameOfFeeBlock=FeeBlockConfiguration39
      Rte_NvmBlock_Sa_DigMSB_DigMSBEOLData: NvmNvramBlockIdentifier=15, NvmBlockUseCrc=false, NvmBlockUsedCrcType=NVM_NOCRC, NvmCalcRamBlockCrc=false, NvmNvBlockLength=4102, NvmUseServicePorts=true, NvmSelectBlockForReadall=true, NvmRamBlockDataAddress=Rte_DigMSB_DigMSBEOLData, NvmRomBlockDataAddress=(unset), NvmUseInitCallback=false, NvmInitBlockCallback=NULL_PTR, NvmJobendCbkAtReadAll=false
        NvmTargetBlockReference
          NvmFeeRef: NvmNameOfFeeBlock=FeeBlockConfiguration44
      NVM_BLOCK_DIAGMGR_BLACKBOX: NvmNvramBlockIdentifier=16, NvmBlockUseCrc=false, NvmBlockUsedCrcType=NVM_NOCRC, NvmCalcRamBlockCrc=false, NvmNvBlockLength=192, NvmUseServicePorts=true, NvmSelectBlockForReadall=true, NvmRamBlockDataAddress=NTCBlackBoxData_Cnt_str, NvmRomBlockDataAddress=(unset), NvmUseInitCallback=false, NvmInitBlockCallback=NULL_PTR, NvmJobendCbkAtReadAll=false
        NvmTargetBlockReference
          NvmFeeRef: NvmNameOfFeeBlock=FeeBlockConfiguration40
      Rte_NvmBlock_BatteryVoltage_OvervoltageData: NvmNvramBlockIdentifier=17, NvmBlockUseCrc=false, NvmBlockUsedCrcType=NVM_NOCRC, NvmCalcRamBlockCrc=false, NvmNvBlockLength=6, NvmUseServicePorts=true, NvmSelectBlockForReadall=true, NvmRamBlockDataAddress=Rte_BatteryVoltage_OvervoltageData, NvmRomBlockDataAddress=(unset), NvmUseInitCallback=false, NvmInitBlockCallback=NULL_PTR, NvmJobendCbkAtReadAll=false
        NvmTargetBlockReference
          NvmFeeRef: NvmNameOfFeeBlock=FeeBlockConfiguration43
      Rte_NvmBlock_ThrmlDutyCycle_ThrmlDutyCycle_FltStVal: NvmNvramBlockIdentifier=18, NvmBlockUseCrc=false, NvmBlockUsedCrcType=NVM_NOCRC, NvmCalcRamBlockCrc=false, NvmNvBlockLength=4, NvmUseServicePorts=true, NvmSelectBlockForReadall=true, NvmRamBlockDataAddress=Rte_ThrmlDutyCycle_ThrmlDutyCycle_FltStVal, NvmRomBlockDataAddress=(unset), NvmUseInitCallback=false, NvmInitBlockCallback=NULL_PTR, NvmJobendCbkAtReadAll=false
        NvmTargetBlockReference
          NvmFeeRef: NvmNameOfFeeBlock=FeeBlockConfiguration51
      NVM_BLOCK_DIAGMGR_LATCHCNTRS: NvmNvramBlockIdentifier=19, NvmBlockUseCrc=false, NvmBlockUsedCrcType=NVM_NOCRC, NvmCalcRamBlockCrc=false, NvmNvBlockLength=16, NvmUseServicePorts=true, NvmSelectBlockForReadall=true, NvmRamBlockDataAddress=LatchCounter_Cnt_u16, NvmRomBlockDataAddress=(unset), NvmUseInitCallback=false, NvmInitBlockCallback=NULL_PTR, NvmJobendCbkAtReadAll=false
        NvmTargetBlockReference
          NvmFeeRef: NvmNameOfFeeBlock=FeeBlockConfiguration52
      NVM_BLOCK_SER_FLASHLOGA: NvmNvramBlockIdentifier=20, NvmBlockUseCrc=false, NvmBlockUsedCrcType=NVM_NOCRC, NvmCalcRamBlockCrc=false, NvmNvBlockLength=50, NvmUseServicePorts=true, NvmSelectBlockForReadall=true, NvmRamBlockDataAddress=FlashLogA_G_str, NvmRomBlockDataAddress=(unset), NvmUseInitCallback=false, NvmInitBlockCallback=NULL_PTR, NvmJobendCbkAtReadAll=false
        NvmTargetBlockReference
          NvmFeeRef: NvmNameOfFeeBlock=FeeBlockConfiguration47
      NVM_BLOCK_SER_FLASHLOGB: NvmNvramBlockIdentifier=21, NvmBlockUseCrc=false, NvmBlockUsedCrcType=NVM_NOCRC, NvmCalcRamBlockCrc=false, NvmNvBlockLength=50, NvmUseServicePorts=true, NvmSelectBlockForReadall=true, NvmRamBlockDataAddress=FlashLogB_G_str, NvmRomBlockDataAddress=(unset), NvmUseInitCallback=false, NvmInitBlockCallback=NULL_PTR, NvmJobendCbkAtReadAll=false
        NvmTargetBlockReference
          NvmFeeRef: NvmNameOfFeeBlock=FeeBlockConfiguration48
      NVM_BLOCK_SER_SECURITYVIOLATION: NvmNvramBlockIdentifier=22, NvmBlockUseCrc=false, NvmBlockUsedCrcType=NVM_NOCRC, NvmCalcRamBlockCrc=false, NvmNvBlockLength=1, NvmUseServicePorts=true, NvmSelectBlockForReadall=true, NvmRamBlockDataAddress=SecurityViolation_Cnt_G_u08, NvmRomBlockDataAddress=(unset), NvmUseInitCallback=false, NvmInitBlockCallback=NULL_PTR, NvmJobendCbkAtReadAll=false
        NvmTargetBlockReference
          NvmFeeRef: NvmNameOfFeeBlock=FeeBlockConfiguration72
      Rte_NvmBlock_VehDyn_MotPosReset: NvmNvramBlockIdentifier=23, NvmBlockUseCrc=false, NvmBlockUsedCrcType=NVM_NOCRC, NvmCalcRamBlockCrc=false, NvmNvBlockLength=5, NvmUseServicePorts=true, NvmSelectBlockForReadall=true, NvmRamBlockDataAddress=Rte_VehDyn_MotPosReset, NvmRomBlockDataAddress=(unset), NvmUseInitCallback=false, NvmInitBlockCallback=NULL_PTR, NvmJobendCbkAtReadAll=false
        NvmTargetBlockReference
          NvmFeeRef: NvmNameOfFeeBlock=FeeBlockConfiguration53
      NVM_BLOCK_SER_AUTHENTICATIONZONE: NvmNvramBlockIdentifier=24, NvmBlockUseCrc=false, NvmBlockUsedCrcType=NVM_NOCRC, NvmCalcRamBlockCrc=false, NvmNvBlockLength=11, NvmUseServicePorts=true, NvmSelectBlockForReadall=true, NvmRamBlockDataAddress=AuthenticationZone_G_str, NvmRomBlockDataAddress=D_AUTHENTICATIONZONEINIT_CNT_STR, NvmUseInitCallback=false, NvmInitBlockCallback=NULL_PTR, NvmJobendCbkAtReadAll=false
        NvmTargetBlockReference
          NvmFeeRef: NvmNameOfFeeBlock=FeeBlockConfiguration55
      NVM_BLOCK_SER_ECUMANUFACTURINGDATE: NvmNvramBlockIdentifier=25, NvmBlockUseCrc=false, NvmBlockUsedCrcType=NVM_NOCRC, NvmCalcRamBlockCrc=false, NvmNvBlockLength=3, NvmUseServicePorts=true, NvmSelectBlockForReadall=true, NvmRamBlockDataAddress=ECUManufacturingDate_G_str, NvmRomBlockDataAddress=D_MANUFDATEINIT_CNT_STR, NvmUseInitCallback=false, NvmInitBlockCallback=NULL_PTR, NvmJobendCbkAtReadAll=false
        NvmTargetBlockReference
          NvmFeeRef: NvmNameOfFeeBlock=FeeBlockConfiguration56
      NVM_BLOCK_SER_EMCSTANDARDIZATIONLABEL: NvmNvramBlockIdentifier=26, NvmBlockUseCrc=false, NvmBlockUsedCrcType=NVM_NOCRC, NvmCalcRamBlockCrc=false, NvmNvBlockLength=22, NvmUseServicePorts=true, NvmSelectBlockForReadall=true, NvmRamBlockDataAddress=EMCStandardizationLabel_G_str, NvmRomBlockDataAddress=D_STDLABELINIT_CNT_STR, NvmUseInitCallback=false, NvmInitBlockCallback=NULL_PTR, NvmJobendCbkAtReadAll=false
        NvmTargetBlockReference
          NvmFeeRef: NvmNameOfFeeBlock=FeeBlockConfiguration57
      NVM_BLOCK_SER_CUSTECUSRLNUM: NvmNvramBlockIdentifier=27, NvmBlockUseCrc=false, NvmBlockUsedCrcType=NVM_NOCRC, NvmCalcRamBlockCrc=false, NvmNvBlockLength=13, NvmUseServicePorts=true, NvmSelectBlockForReadall=true, NvmRamBlockDataAddress=CustECUSrlNum_Cnt_G_u08, NvmRomBlockDataAddress=D_CUSTECUINIT_CNT_U08, NvmUseInitCallback=false, NvmInitBlockCallback=NULL_PTR, NvmJobendCbkAtReadAll=false
        NvmTargetBlockReference
          NvmFeeRef: NvmNameOfFeeBlock=FeeBlockConfiguration58
      NVM_BLOCK_SER_SECURITYKEY: NvmNvramBlockIdentifier=28, NvmBlockUseCrc=false, NvmBlockUsedCrcType=NVM_NOCRC, NvmCalcRamBlockCrc=false, NvmNvBlockLength=3, NvmUseServicePorts=true, NvmSelectBlockForReadall=true, NvmRamBlockDataAddress=SecurityKey_Cnt_G_u08, NvmRomBlockDataAddress=D_SECURITYKEYINIT_CNT_U08, NvmUseInitCallback=false, NvmInitBlockCallback=NULL_PTR, NvmJobendCbkAtReadAll=false
        NvmTargetBlockReference
          NvmFeeRef: NvmNameOfFeeBlock=FeeBlockConfiguration59
      Rte_NvmBlock_SrlComInput_VVHTYPEData: NvmNvramBlockIdentifier=29, NvmBlockUseCrc=false, NvmBlockUsedCrcType=NVM_NOCRC, NvmCalcRamBlockCrc=false, NvmNvBlockLength=1, NvmUseServicePorts=true, NvmSelectBlockForReadall=true, NvmRamBlockDataAddress=Rte_SrlComInput_VVHTYPEData, NvmRomBlockDataAddress=(unset), NvmUseInitCallback=false, NvmInitBlockCallback=NULL_PTR, NvmJobendCbkAtReadAll=false
        NvmTargetBlockReference
          NvmFeeRef: NvmNameOfFeeBlock=FeeBlockConfiguration60
      Rte_NvmBlock_SrlComInput_ElecIntData: NvmNvramBlockIdentifier=30, NvmBlockUseCrc=false, NvmBlockUsedCrcType=NVM_NOCRC, NvmCalcRamBlockCrc=false, NvmNvBlockLength=1, NvmUseServicePorts=true, NvmSelectBlockForReadall=true, NvmRamBlockDataAddress=Rte_SrlComInput_ElecIntData, NvmRomBlockDataAddress=(unset), NvmUseInitCallback=false, NvmInitBlockCallback=NULL_PTR, NvmJobendCbkAtReadAll=false
        NvmTargetBlockReference
          NvmFeeRef: NvmNameOfFeeBlock=FeeBlockConfiguration61
      NVM_BLOCK_SER_TUNINGSELECT: NvmNvramBlockIdentifier=31, NvmBlockUseCrc=true, NvmBlockUsedCrcType=NVM_CRC16, NvmCalcRamBlockCrc=false, NvmNvBlockLength=24, NvmUseServicePorts=true, NvmSelectBlockForReadall=true, NvmRamBlockDataAddress=TuningSelect_G_str, NvmRomBlockDataAddress=D_TUNINGSELECTINIT_CNT_STR, NvmUseInitCallback=false, NvmInitBlockCallback=NULL_PTR, NvmJobendCbkAtReadAll=false
        NvmTargetBlockReference
          NvmFeeRef: NvmNameOfFeeBlock=FeeBlockConfiguration62
      Deprecated_NvmBlock_CmMtrCurr_CurrTempOffset: NvmNvramBlockIdentifier=32, NvmBlockUseCrc=false, NvmBlockUsedCrcType=NVM_NOCRC, NvmCalcRamBlockCrc=false, NvmNvBlockLength=98, NvmUseServicePorts=false, NvmSelectBlockForReadall=false, NvmRamBlockDataAddress=(unset), NvmRomBlockDataAddress=(unset), NvmUseInitCallback=false, NvmInitBlockCallback=NULL_PTR, NvmJobendCbkAtReadAll=true
        NvmTargetBlockReference
          NvmFeeRef: NvmNameOfFeeBlock=FeeBlockConfiguration65
      Rte_NvmBlock_CmMtrCurr_ShCurrCal: NvmNvramBlockIdentifier=33, NvmBlockUseCrc=false, NvmBlockUsedCrcType=NVM_NOCRC, NvmCalcRamBlockCrc=false, NvmNvBlockLength=28, NvmUseServicePorts=true, NvmSelectBlockForReadall=true, NvmRamBlockDataAddress=Rte_CmMtrCurr_ShCurrCal, NvmRomBlockDataAddress=(unset), NvmUseInitCallback=false, NvmInitBlockCallback=NULL_PTR, NvmJobendCbkAtReadAll=false
        NvmTargetBlockReference
          NvmFeeRef: NvmNameOfFeeBlock=FeeBlockConfiguration66
      Rte_NvmBlock_TrqCanc_CogTrqCal: NvmNvramBlockIdentifier=34, NvmBlockUseCrc=false, NvmBlockUsedCrcType=NVM_NOCRC, NvmCalcRamBlockCrc=false, NvmNvBlockLength=1024, NvmUseServicePorts=true, NvmSelectBlockForReadall=true, NvmRamBlockDataAddress=Rte_TrqCanc_CogTrqCal, NvmRomBlockDataAddress=(unset), NvmUseInitCallback=false, NvmInitBlockCallback=NULL_PTR, NvmJobendCbkAtReadAll=false
        NvmTargetBlockReference
          NvmFeeRef: NvmNameOfFeeBlock=FeeBlockConfiguration67
      Rte_NvmBlock_TrqCanc_CogTrqRplComp: NvmNvramBlockIdentifier=35, NvmBlockUseCrc=false, NvmBlockUsedCrcType=NVM_NOCRC, NvmCalcRamBlockCrc=false, NvmNvBlockLength=18, NvmUseServicePorts=true, NvmSelectBlockForReadall=true, NvmRamBlockDataAddress=Rte_TrqCanc_CogTrqRplComp, NvmRomBlockDataAddress=(unset), NvmUseInitCallback=false, NvmInitBlockCallback=NULL_PTR, NvmJobendCbkAtReadAll=false
        NvmTargetBlockReference
          NvmFeeRef: NvmNameOfFeeBlock=FeeBlockConfiguration68
      Deprecated_Rte_NvmBlock_TrqCmdScl_TorqueCmdSF_Uls_f32: NvmNvramBlockIdentifier=36, NvmBlockUseCrc=false, NvmBlockUsedCrcType=NVM_NOCRC, NvmCalcRamBlockCrc=false, NvmNvBlockLength=4, NvmUseServicePorts=false, NvmSelectBlockForReadall=false, NvmRamBlockDataAddress=(unset), NvmRomBlockDataAddress=(unset), NvmUseInitCallback=false, NvmInitBlockCallback=NULL_PTR, NvmJobendCbkAtReadAll=true
        NvmTargetBlockReference
          NvmFeeRef: NvmNameOfFeeBlock=FeeBlockConfiguration69
      Deprecated_NvmBlock_AbsHwPos_EOLVehCntrOffset: NvmNvramBlockIdentifier=37, NvmBlockUseCrc=false, NvmBlockUsedCrcType=NVM_NOCRC, NvmCalcRamBlockCrc=false, NvmNvBlockLength=10, NvmUseServicePorts=false, NvmSelectBlockForReadall=false, NvmRamBlockDataAddress=(unset), NvmRomBlockDataAddress=(unset), NvmUseInitCallback=false, NvmInitBlockCallback=NULL_PTR, NvmJobendCbkAtReadAll=true
        NvmTargetBlockReference
          NvmFeeRef: NvmNameOfFeeBlock=FeeBlockConfiguration64
      Rte_NvmBlock_LrnEOT_LearnedEOT: NvmNvramBlockIdentifier=38, NvmBlockUseCrc=false, NvmBlockUsedCrcType=NVM_NOCRC, NvmCalcRamBlockCrc=false, NvmNvBlockLength=10, NvmUseServicePorts=true, NvmSelectBlockForReadall=true, NvmRamBlockDataAddress=Rte_LrnEOT_LearnedEOT, NvmRomBlockDataAddress=(unset), NvmUseInitCallback=false, NvmInitBlockCallback=NULL_PTR, NvmJobendCbkAtReadAll=false
        NvmTargetBlockReference
          NvmFeeRef: NvmNameOfFeeBlock=FeeBlockConfiguration70
      Rte_NvmBlock_AvgFricLrn_AvgFricLrnData: NvmNvramBlockIdentifier=39, NvmBlockUseCrc=false, NvmBlockUsedCrcType=NVM_NOCRC, NvmCalcRamBlockCrc=false, NvmNvBlockLength=203, NvmUseServicePorts=true, NvmSelectBlockForReadall=true, NvmRamBlockDataAddress=Rte_AvgFricLrn_AvgFricLrnData, NvmRomBlockDataAddress=(unset), NvmUseInitCallback=false, NvmInitBlockCallback=NULL_PTR, NvmJobendCbkAtReadAll=false
        NvmTargetBlockReference
          NvmFeeRef: NvmNameOfFeeBlock=FeeBlockConfiguration73
      Rte_NvmBlock_CmMtrCurr_CurrTempOffset: NvmNvramBlockIdentifier=40, NvmBlockUseCrc=false, NvmBlockUsedCrcType=NVM_NOCRC, NvmCalcRamBlockCrc=false, NvmNvBlockLength=96, NvmUseServicePorts=true, NvmSelectBlockForReadall=true, NvmRamBlockDataAddress=Rte_CmMtrCurr_CurrTempOffset, NvmRomBlockDataAddress=(unset), NvmUseInitCallback=false, NvmInitBlockCallback=NULL_PTR, NvmJobendCbkAtReadAll=false
        NvmTargetBlockReference
          NvmFeeRef: NvmNameOfFeeBlock=FeeBlockConfiguration45
      Deprecated_Rte_NvmBlock_AbsHwPos_EOLVehCntrOffset: NvmNvramBlockIdentifier=41, NvmBlockUseCrc=false, NvmBlockUsedCrcType=NVM_NOCRC, NvmCalcRamBlockCrc=false, NvmNvBlockLength=5, NvmUseServicePorts=false, NvmSelectBlockForReadall=false, NvmRamBlockDataAddress=(unset), NvmRomBlockDataAddress=(unset), NvmUseInitCallback=false, NvmInitBlockCallback=NULL_PTR, NvmJobendCbkAtReadAll=true
        NvmTargetBlockReference
          NvmFeeRef: NvmNameOfFeeBlock=FeeBlockConfiguration46
      Rte_NvmBlock_FaultLog_FaultLog: NvmNvramBlockIdentifier=42, NvmBlockUseCrc=false, NvmBlockUsedCrcType=NVM_NOCRC, NvmCalcRamBlockCrc=false, NvmNvBlockLength=1200, NvmUseServicePorts=true, NvmSelectBlockForReadall=true, NvmRamBlockDataAddress=Rte_FaultLog_FaultLog, NvmRomBlockDataAddress=(unset), NvmUseInitCallback=false, NvmInitBlockCallback=NULL_PTR, NvmJobendCbkAtReadAll=false
        NvmTargetBlockReference
          NvmFeeRef: NvmNameOfFeeBlock=FeeBlockConfiguration49
      Deprecated_BLOCK_DEM_CTCSTRG1: NvmNvramBlockIdentifier=43, NvmBlockUseCrc=false, NvmBlockUsedCrcType=NVM_NOCRC, NvmCalcRamBlockCrc=false, NvmNvBlockLength=1151, NvmUseServicePorts=false, NvmSelectBlockForReadall=false, NvmRamBlockDataAddress=(unset), NvmRomBlockDataAddress=(unset), NvmUseInitCallback=false, NvmInitBlockCallback=NULL_PTR, NvmJobendCbkAtReadAll=true
        NvmTargetBlockReference
          NvmFeeRef: NvmNameOfFeeBlock=FeeBlockConfiguration71
      Rte_NvmBlock_SrlComInput_ShutdownTimeData: NvmNvramBlockIdentifier=44, NvmBlockUseCrc=false, NvmBlockUsedCrcType=NVM_NOCRC, NvmCalcRamBlockCrc=false, NvmNvBlockLength=5, NvmUseServicePorts=true, NvmSelectBlockForReadall=true, NvmRamBlockDataAddress=Rte_SrlComInput_ShutdownTimeData, NvmRomBlockDataAddress=(unset), NvmUseInitCallback=false, NvmInitBlockCallback=NULL_PTR, NvmJobendCbkAtReadAll=false
        NvmTargetBlockReference
          NvmFeeRef: NvmNameOfFeeBlock=FeeBlockConfiguration74
      NVM_BLOCK_DEM_CTCSTRG: NvmNvramBlockIdentifier=45, NvmBlockUseCrc=false, NvmBlockUsedCrcType=NVM_NOCRC, NvmCalcRamBlockCrc=false, NvmNvBlockLength=1225, NvmRomBlockDataAddress=(unset), NvmJobendCbkAtReadAll=true, NvmRamBlockDataAddress=Dem_NvData, NvmInitBlockCallback=Dem_NvDataInit, NvmSelectBlockForReadall=true, NvmUseServicePorts=false, NvmUseInitCallback=true
        NvmTargetBlockReference
          NvmFeeRef: NvmNameOfFeeBlock=FeeBlockConfiguration54
      Rte_NvmBlock_AbsHwPos_EOLVehCntrOffset: NvmNvramBlockIdentifier=46, NvmBlockUseCrc=false, NvmBlockUsedCrcType=NVM_NOCRC, NvmCalcRamBlockCrc=false, NvmNvBlockLength=6, NvmUseServicePorts=true, NvmSelectBlockForReadall=true, NvmRamBlockDataAddress=Rte_AbsHwPos_EOLVehCntrOffset, NvmRomBlockDataAddress=(unset), NvmUseInitCallback=false, NvmInitBlockCallback=NULL_PTR, NvmJobendCbkAtReadAll=false
        NvmTargetBlockReference
          NvmFeeRef: NvmNameOfFeeBlock=FeeBlockConfiguration76
      Rte_NvmBlock_HwTqCorrln_HwTqCorrlnCh1CMCLPFSvData: NvmNvramBlockIdentifier=47, NvmBlockUseCrc=false, NvmBlockUsedCrcType=NVM_NOCRC, NvmCalcRamBlockCrc=false, NvmNvBlockLength=4, NvmUseServicePorts=true, NvmSelectBlockForReadall=true, NvmRamBlockDataAddress=Rte_HwTqCorrln_HwTqCorrlnCh1CMCLPFSvData, NvmRomBlockDataAddress=(unset), NvmUseInitCallback=false, NvmInitBlockCallback=NULL_PTR, NvmJobendCbkAtReadAll=false
        NvmTargetBlockReference
          NvmFeeRef: NvmNameOfFeeBlock=FeeBlockConfiguration75
      Deprecated_Rte_NvmBlock_HwTqArbn_HwTqArbnEOLCh1OffsetTrimData: NvmNvramBlockIdentifier=48, NvmBlockUseCrc=false, NvmBlockUsedCrcType=NVM_NOCRC, NvmCalcRamBlockCrc=false, NvmNvBlockLength=5, NvmUseServicePorts=false, NvmSelectBlockForReadall=false, NvmRamBlockDataAddress=(unset), NvmRomBlockDataAddress=(unset), NvmUseInitCallback=false, NvmInitBlockCallback=NULL_PTR, NvmJobendCbkAtReadAll=true
        NvmTargetBlockReference
          NvmFeeRef: NvmNameOfFeeBlock=FeeBlockConfiguration77
      NVM_BLOCK_SER_POWERPACKCONFIG: NvmNvramBlockIdentifier=49, NvmBlockUseCrc=false, NvmBlockUsedCrcType=NVM_NOCRC, NvmCalcRamBlockCrc=false, NvmNvBlockLength=3, NvmUseServicePorts=true, NvmSelectBlockForReadall=true, NvmRamBlockDataAddress=PowerPackConfig_G_str, NvmRomBlockDataAddress=D_POWERPACKCONFIGINIT_CNT_STR, NvmUseInitCallback=false, NvmInitBlockCallback=NULL_PTR, NvmJobendCbkAtReadAll=false
        NvmTargetBlockReference
          NvmFeeRef: NvmNameOfFeeBlock=Fee/FeeBlockConfiguration
      Deprecated_Rte_NvmBlock_PsaAgArbn_PsaAgArbnLrndOffsData: NvmNvramBlockIdentifier=50, NvmBlockUseCrc=false, NvmBlockUsedCrcType=NVM_NOCRC, NvmCalcRamBlockCrc=false, NvmNvBlockLength=10, NvmUseServicePorts=false, NvmSelectBlockForReadall=false, NvmRamBlockDataAddress=(unset), NvmRomBlockDataAddress=(unset), NvmUseInitCallback=false, NvmInitBlockCallback=NULL_PTR, NvmJobendCbkAtReadAll=true
        NvmTargetBlockReference
          NvmFeeRef: NvmNameOfFeeBlock=FeeBlockConfiguration1
      Rte_NvmBlock_HwTqArbn_HwTqArbnEOLCh1OffsetTrimData: NvmNvramBlockIdentifier=51, NvmBlockUseCrc=false, NvmBlockUsedCrcType=NVM_NOCRC, NvmCalcRamBlockCrc=false, NvmNvBlockLength=5, NvmUseServicePorts=true, NvmSelectBlockForReadall=true, NvmRamBlockDataAddress=Rte_HwTqArbn_HwTqArbnEOLCh1OffsetTrimData, NvmRomBlockDataAddress=(unset), NvmUseInitCallback=false, NvmInitBlockCallback=NULL_PTR, NvmJobendCbkAtReadAll=false
        NvmTargetBlockReference
          NvmFeeRef: NvmNameOfFeeBlock=FeeBlockConfiguration78
      Rte_NvmBlock_TrqCmdScl_TorqueCmdSF_Uls_f32: NvmNvramBlockIdentifier=52, NvmBlockUseCrc=false, NvmBlockUsedCrcType=NVM_NOCRC, NvmCalcRamBlockCrc=false, NvmNvBlockLength=4, NvmUseServicePorts=true, NvmSelectBlockForReadall=true, NvmRamBlockDataAddress=Rte_TrqCmdScl_TorqueCmdSF_Uls_f32, NvmRomBlockDataAddress=(unset), NvmUseInitCallback=false, NvmInitBlockCallback=NULL_PTR, NvmJobendCbkAtReadAll=false
        NvmTargetBlockReference
          NvmFeeRef: NvmNameOfFeeBlock=FeeBlockConfiguration50
      Rte_NvmBlock_PsaAgArbn_PsaAgArbnLrndOffsData: NvmNvramBlockIdentifier=53, NvmBlockUseCrc=false, NvmBlockUsedCrcType=NVM_NOCRC, NvmCalcRamBlockCrc=false, NvmNvBlockLength=10, NvmUseServicePorts=true, NvmSelectBlockForReadall=true, NvmRamBlockDataAddress=Rte_PsaAgArbn_PsaAgArbnLrndOffsData, NvmRomBlockDataAddress=(unset), NvmUseInitCallback=false, NvmInitBlockCallback=NULL_PTR, NvmJobendCbkAtReadAll=false
        NvmTargetBlockReference
          NvmFeeRef: NvmNameOfFeeBlock=FeeBlockConfiguration63
      Rte_NvmBlock_ActivePull_PullCmpLTComp_HwNm_f32: NvmNvramBlockIdentifier=54, NvmBlockUseCrc=false, NvmBlockUsedCrcType=NVM_NOCRC, NvmCalcRamBlockCrc=false, NvmNvBlockLength=4, NvmUseServicePorts=true, NvmSelectBlockForReadall=true, NvmRamBlockDataAddress=Rte_ActivePull_PullCmpLTComp_HwNm_f32, NvmRomBlockDataAddress=(unset), NvmUseInitCallback=false, NvmInitBlockCallback=NULL_PTR, NvmJobendCbkAtReadAll=false
        NvmTargetBlockReference
          NvmFeeRef: NvmNameOfFeeBlock=FeeBlockConfiguration79
  module config Os: implementation-config-variant=VARIANT-PRE-COMPILE, module-description=Os_Impl  # Configuration of the Os (Operating System) module.
    Rte_Al_TE_Task_100ms_10_0_100ms (OsAlarm): OsAlarmAccessingApplication=Ap_0, OsAlarmAccessingApplication=Ap_6, OsAlarmCounterRef=SystemTimer
      OsAlarmAction
        OsAlarmActivateTask: OsAlarmActivateTaskRef=Task_100ms_10
    OSDEFAULTAPPMODE (OsAppMode): OsAppModeId=(unset)
    Ap_0 (OsApplication):
      OsTrusted = true
      OsAppGenerateStub = false
      OsApplicationProtectionRegionSizeNoInitData = 0
      OsApplicationProtectionRegionSizeInitData = 0
      OsApplicationMPUArea4Size = 0
      OsApplicationMPUArea4Access = 0
      OsApplicationMPUArea6Size = 0
      OsApplicationMPUArea6Access = 0
      OsApplicationMPUArea8Size = 0
      OsApplicationMPUArea8Access = 0
      OsApplicationMPUArea9Size = 0
      OsApplicationMPUArea9Access = 0
      OsApplicationMPUArea10Size = 0
      OsApplicationMPUArea10Access = 0
      OsApplicationMPUArea11Size = 0
      OsApplicationMPUArea11Access = 0
      OsApplicationMPUArea4Start = 0
      OsApplicationMPUArea6Start = 0
      OsApplicationMPUArea{8..11}Start = 0
      OsAppAlarmRef = Al_Task_SchM_100ms_0
      OsAppAlarmRef = Al_Task_SchM_4ms_0
      OsAppIsrRef = Isr_MtrCtrl
      OsAppIsrRef = Isr_ESMH
      OsAppIsrRef = Isr_ESML
      OsAppIsrRef = FlsTst_CrcIrq
      OsAppTaskRef = Task_Bkgnd
      OsAppTaskRef = Task_SchM_4ms_0
      OsAppTaskRef = Task_SchM_100ms_0
      OsApplicationHooks: OsAppErrorHook=false, OsAppShutdownHook=false, OsAppStartupHook=false
      23 x OsApplicationTrustedFunction:
        OsApplicationTrustedFunction14: OsTrustedFunctionName=TWrapS_XcpWriteAp0, OsApplicationParams=void, OsApplicationReturnType=void
        OsApplicationTrustedFunction15: OsTrustedFunctionName=TWrapS_CallFblStart, OsApplicationParams=void, OsApplicationReturnType=void
        OsApplicationTrustedFunction16: OsTrustedFunctionName=TWrapS_Adc_Init, OsApplicationParams=void, OsApplicationReturnType=void
        OsApplicationTrustedFunction17: OsTrustedFunctionName=TWrapS_Adc2_Init1, OsApplicationParams=void, OsApplicationReturnType=void
        OsApplicationTrustedFunction18: OsTrustedFunctionName=TWrapS_PwmCdd_Init, OsApplicationParams=void, OsApplicationReturnType=void
        OsApplicationTrustedFunction19: OsTrustedFunctionName=TWrapS_StaMd_Init0, OsApplicationParams=void, OsApplicationReturnType=void
        OsApplicationTrustedFunction20: OsTrustedFunctionName=TWrapS_Wdg_TMS570LS3x_Init, OsApplicationParams=void, OsApplicationReturnType=void
        OsApplicationTrustedFunction21: OsTrustedFunctionName=TWrapS_WdgM_Init, OsApplicationParams=void, OsApplicationReturnType=void
        OsApplicationTrustedFunction22: OsTrustedFunctionName=TWrapS_NvMProxy_Init, OsApplicationParams=void, OsApplicationReturnType=void
        OsApplicationTrustedFunction23: OsTrustedFunctionName=TWrapS_FeeIf_Init, OsApplicationParams=void, OsApplicationReturnType=void
        OsApplicationTrustedFunction24: OsTrustedFunctionName=TWrapS_Fee_MainFunction, OsApplicationParams=void, OsApplicationReturnType=void
        OsApplicationTrustedFunction25: OsTrustedFunctionName=TWrapS_Fee_Read, OsApplicationParams=uint16 BlockNumber,uint16 BlockOffset,uint8* DataBufferPtr,uint16 Length, OsApplicationReturnType=Std_ReturnType
        OsApplicationTrustedFunction26: OsTrustedFunctionName=TWrapS_Fee_Write, OsApplicationParams=uint16 BlockNumber,uint8* DataBufferPtr, OsApplicationReturnType=Std_ReturnType
        OsApplicationTrustedFunction27: OsTrustedFunctionName=TWrapS_Fee_EraseImmediateBlock, OsApplicationParams=uint16 BlockNumber, OsApplicationReturnType=Std_ReturnType
        OsApplicationTrustedFunction28: OsTrustedFunctionName=TWrapS_Fee_InvalidateBlock, OsApplicationParams=uint16 BlockNumber, OsApplicationReturnType=Std_ReturnType
        OsApplicationTrustedFunction29: OsTrustedFunctionName=TWrapS_Fee_Cancel, OsApplicationParams=void, OsApplicationReturnType=void
        OsApplicationTrustedFunction30: OsTrustedFunctionName=TWrapS_Fee_GetStatus, OsApplicationParams=void, OsApplicationReturnType=uint8
        OsApplicationTrustedFunction31: OsTrustedFunctionName=TWrapS_Fee_GetJobResult, OsApplicationParams=void, OsApplicationReturnType=uint8
        OsApplicationTrustedFunction33: OsTrustedFunctionName=TWrapS_uDiagVIM_RednRpdShtdn, OsApplicationParams=void, OsApplicationReturnType=void
        OsApplicationTrustedFunction34: OsTrustedFunctionName=TWrapS_uDiagECC_RednRpdShtdn, OsApplicationParams=void, OsApplicationReturnType=void
        OsApplicationTrustedFunction: OsTrustedFunctionName=TWrapS_Dma_InvalidateSlowADCGroup, OsApplicationParams=void, OsApplicationReturnType=void
        OsApplicationTrustedFunction1: OsTrustedFunctionName=TWrapS_ProcessF0FF, OsApplicationParams=void, OsApplicationReturnType=void
        OsApplicationTrustedFunction2: OsTrustedFunctionName=TWrapS_TI_Fee_SuspendResumeErase, OsApplicationParams=uint8 Command, OsApplicationReturnType=void
    SystemTimer (OsCounter): OsCounterMaxAllowedValue=2147483647, OsCounterMinCycle=1, OsCounterTicksPerBase=1, OsCounterType=SOFTWARE, OsSecondsPerTick=1234567890
    Rte_Ev_Run_HwPwUp_HwPwUp_Trns1 (OsEvent)
    Isr_MtrCtrl (OsIsr):
      OsIsrCategory = CATEGORY_1
      OsIsrEnableNesting = false
      OsIsrAnalysisPriority = 0
      OsIsrComputationTime = 0
      OsIsrPeriod = 0
      OsIsrDeadline = 0
      OsIsrProtectionRegionSizeNoInitData = 0
      OsIsrProtectionRegionSizeInitData = 0
      OsIsrNonTrustFctStackSize = 0
      OsIsrInterruptTarget = IRQ
      OsIsrInterruptSource = INTR40
      OsIsrInterruptPriority
        NON_AUTO: OsIsrInterruptPriority=2
      OsIsrUseSpecialFunctionName
        FALSE
    OsOS:
      OsScalabilityClass = SC3
      OsStackMonitoring = true
      OsOSStackUsageMeasurement = AUTO
      OsStatus = EXTENDED
      OsUseGetServiceId = true
      OsUseParameterAccess = true
      OsUseResScheduler = true
      OsOSUseGeneratedFastAlarm = true
      OsOSThumbMode = true
      OsOSFPUSupport = true
      OsOSORTIDebugSupport = false
      OsOSTypeHeaderInclude = false
      OsOSCpuFrequency = 80
      OsOSAbortStackSize = 252
      OsOSAPIStackSize = 508
      OsOSTimerClockDivider = 80
      OsOSTickTime = 1000
      OsOSSupervisorStackSize = 508
      OsOSIRQMaxNesting = 6
      OsOSIRQStackOffset = 508
      OsOSUserConfigurationVersion = 0
      OsOSSystemTimer = UserDefined
      OsOSErrorInfoLevel = STANDARD
      OsOSOSInternalChecks = Additional
      OsOSCompiler = TI
      OsOSORTIDebugLevel = ORTI_20
      OsHooks: OsErrorHook=true, OsPostTaskHook=false, OsPreTaskHook=false, OsProtectionHook=true, OsShutdownHook=true, OsStartupHook=true
      OsOSSCHEDULE
        AUTO
      OsOSCC
        AUTO
      OsOSProtectionHookReaction
        Selected: OsOSSHUTDOWN=true
      OsOSSystemTimerIntPrio
        NON_AUTO: OsOSSystemTimerIntPrio=3
      OsOSMemoryProtection
        TRUE: OsOSMPUCodeRegionBase=0, OsOSMPUCodeRegionSize=786432, OsOSIRQHandlerStackSize=1020, OsOSOSDataSize=1024, OsOSGlobalSharedMemRegionSize=16384
      OsOSRESETHandler
        AUTO
      OsOSUDEFHandler
        NON_AUTO: OsOSUDEFHandler=_undefinst
      OsOSFIQHandler
        NON_AUTO: OsOSFIQHandler=_fiqhandler
      OS_MEM_AREA_GIOA (OsOSPeripheralRegion)
        Region:
          OsOSStartAddress = 4294425600
          OsOSEndAddress = 4294425855
          OsOSIdentifier = OS_MEM_AREA_GIOA
          OsOSACCESSING_APPLICATION = Ap_0
          OsOSACCESSING_APPLICATION = Ap_6
          OsOSACCESSING_APPLICATION = Ap_{9..11}
      OsOSTimingMeasurement
        FALSE
      OsOSAPIOptimization
        Manual:
          OsOSActivateTask = true
          OsOSTerminateTask = true
          OsOSChainTask = true
          OsOSSchedule = true
          OsOSGetTaskID = true
          OsOSGetTaskState = true
          OsOSDisableAllInterrupts = true
          OsOSEnableAllInterrupts = true
          OsOSSuspendOSInterrupts = true
          OsOSResumeOSInterrupts = true
          OsOSSuspendAllInterrupts = true
          OsOSResumeAllInterrupts = true
          OsOSGetResource = true
          OsOSReleaseResource = true
          OsOSSetEvent = true
          OsOSClearEvent = true
          OsOSGetEvent = true
          OsOSWaitEvent = true
          OsOSGetAlarmBase = true
          OsOSGetAlarm = true
          OsOSSetRelAlarm = true
          OsOSSetAbsAlarm = true
          OsOSCancelAlarm = true
          OsOSGetActiveApplicationMode = true
          OsOSIncrementCounter = true
          OsOSStartCOM = true
          OsOSStopCOM = true
          OsOSSendMessage = true
          OsOSReceiveMessage = true
          OsOSGetMessageStatus = true
          OsOSInitMessage = true
          OsOSGetCOMApplicationMode = true
          OsOSStartScheduleTableAbs = true
          OsOSStartScheduleTableRel = true
          OsOSStopScheduleTable = true
          OsOSNextScheduleTable = true
          OsOSGetScheduleTableStatus = true
          OsOSStartScheduleTableSynchron = true
          OsOSSyncScheduleTable = true
          OsOSSetScheduleTableAsync = true
          OsOSGetApplicationID = true
          OsOSGetISRID = true
          OsOSCallTrustedFunction = true
          OsOSCallNonTrustedFunction = true
          OsOSCheckISRMemoryAccess = true
          OsOSCheckTaskMemoryAccess = true
          OsOSCheckObjectAccess = true
          OsOSCheckObjectOwnership = true
          OsOSTerminateApplication = true
          OsOSGetTaskMaxExecutionTime = true
          OsOSGetISRMaxExecutionTime = true
          OsOSGetTaskMaxBlockingTime = true
          OsOSGetISRMaxBlockingTime = true
          OsOSGetTaskMinInterArrivalTime = true
          OsOSGetISRMinInterArrivalTime = true
      32 x OsOSPeripheralRegion:
        OS_MEM_AREA_GIOB
          Region:
            OsOSStartAddress = 4294425600
            OsOSEndAddress = 4294425855
            OsOSIdentifier = OS_MEM_AREA_GIOB
            OsOSACCESSING_APPLICATION = Ap_0
            OsOSACCESSING_APPLICATION = Ap_6
            OsOSACCESSING_APPLICATION = Ap_{9..11}
        OS_MEM_AREA_CAN1
          Region:
            OsOSStartAddress = 4294433792
            OsOSEndAddress = 4294434303
            OsOSIdentifier = OS_MEM_AREA_CAN1
            OsOSACCESSING_APPLICATION = Ap_0
            OsOSACCESSING_APPLICATION = Ap_6
            OsOSACCESSING_APPLICATION = Ap_{9..11}
        OS_MEM_AREA_CAN2
          Region:
            OsOSStartAddress = 4294434304
            OsOSEndAddress = 4294434815
            OsOSIdentifier = OS_MEM_AREA_CAN2
            OsOSACCESSING_APPLICATION = Ap_0
            OsOSACCESSING_APPLICATION = Ap_6
            OsOSACCESSING_APPLICATION = Ap_{9..11}
        OS_MEM_AREA_CAN3
          Region:
            OsOSStartAddress = 4294434816
            OsOSEndAddress = 4294435327
            OsOSIdentifier = OS_MEM_AREA_CAN3
            OsOSACCESSING_APPLICATION = Ap_0
            OsOSACCESSING_APPLICATION = Ap_6
            OsOSACCESSING_APPLICATION = Ap_{9..11}
        OS_MEM_AREA_LIN
          Region:
            OsOSStartAddress = 4294435840
            OsOSEndAddress = 4294436095
            OsOSIdentifier = OS_MEM_AREA_LIN
            OsOSACCESSING_APPLICATION = Ap_0
            OsOSACCESSING_APPLICATION = Ap_6
            OsOSACCESSING_APPLICATION = Ap_{9..11}
        OS_MEM_AREA_SCI
          Region:
            OsOSStartAddress = 4294436096
            OsOSEndAddress = 4294436351
            OsOSIdentifier = OS_MEM_AREA_SCI
            OsOSACCESSING_APPLICATION = Ap_0
            OsOSACCESSING_APPLICATION = Ap_6
            OsOSACCESSING_APPLICATION = Ap_{9..11}
        OS_MEM_AREA_IIC
          Region:
            OsOSStartAddress = 4294431744
            OsOSEndAddress = 4294431999
            OsOSIdentifier = OS_MEM_AREA_IIC
            OsOSACCESSING_APPLICATION = Ap_0
            OsOSACCESSING_APPLICATION = Ap_6
            OsOSACCESSING_APPLICATION = Ap_{9..11}
        OS_MEM_AREA_SPI1
          Region:
            OsOSStartAddress = 4294439936
            OsOSEndAddress = 4294440447
            OsOSIdentifier = OS_MEM_AREA_SPI1
            OsOSACCESSING_APPLICATION = Ap_0
            OsOSACCESSING_APPLICATION = Ap_6
            OsOSACCESSING_APPLICATION = Ap_{9..11}
        OS_MEM_AREA_SPI2
          Region:
            OsOSStartAddress = 4294440448
            OsOSEndAddress = 4294440959
            OsOSIdentifier = OS_MEM_AREA_SPI2
            OsOSACCESSING_APPLICATION = Ap_0
            OsOSACCESSING_APPLICATION = Ap_6
            OsOSACCESSING_APPLICATION = Ap_{9..11}
        OS_MEM_AREA_SPI3
          Region:
            OsOSStartAddress = 4294440960
            OsOSEndAddress = 4294441471
            OsOSIdentifier = OS_MEM_AREA_SPI3
            OsOSACCESSING_APPLICATION = Ap_0
            OsOSACCESSING_APPLICATION = Ap_6
            OsOSACCESSING_APPLICATION = Ap_{9..11}
        OS_MEM_AREA_SPI4
          Region:
            OsOSStartAddress = 4294441472
            OsOSEndAddress = 4294441983
            OsOSIdentifier = OS_MEM_AREA_SPI4
            OsOSACCESSING_APPLICATION = Ap_0
            OsOSACCESSING_APPLICATION = Ap_6
            OsOSACCESSING_APPLICATION = Ap_{9..11}
        OS_MEM_AREA_SPI5
          Region:
            OsOSStartAddress = 4294441984
            OsOSEndAddress = 4294442495
            OsOSIdentifier = OS_MEM_AREA_SPI5
            OsOSACCESSING_APPLICATION = Ap_0
            OsOSACCESSING_APPLICATION = Ap_6
            OsOSACCESSING_APPLICATION = Ap_{9..11}
        OS_MEM_AREA_NHET1
          Region:
            OsOSStartAddress = 4294424576
            OsOSEndAddress = 4294424831
            OsOSIdentifier = OS_MEM_AREA_NHET1
            OsOSACCESSING_APPLICATION = Ap_0
            OsOSACCESSING_APPLICATION = Ap_6
            OsOSACCESSING_APPLICATION = Ap_{9..11}
        OS_MEM_AREA_NHET2
          Region:
            OsOSStartAddress = 4294424832
            OsOSEndAddress = 4294425087
            OsOSIdentifier = OS_MEM_AREA_NHET2
            OsOSACCESSING_APPLICATION = Ap_0
            OsOSACCESSING_APPLICATION = Ap_6
            OsOSACCESSING_APPLICATION = Ap_{9..11}
        OS_MEM_AREA_SYS
          Region:
            OsOSStartAddress = 4294967040
            OsOSEndAddress = 4294967295
            OsOSIdentifier = OS_MEM_AREA_SYS
            OsOSACCESSING_APPLICATION = Ap_0
            OsOSACCESSING_APPLICATION = Ap_6
            OsOSACCESSING_APPLICATION = Ap_{9..11}
        OS_MEM_AREA_ADC1
          Region:
            OsOSStartAddress = 4294426624
            OsOSEndAddress = 4294427135
            OsOSIdentifier = OS_MEM_AREA_ADC1
            OsOSACCESSING_APPLICATION = Ap_0
            OsOSACCESSING_APPLICATION = Ap_6
            OsOSACCESSING_APPLICATION = Ap_{9..11}
        OS_MEM_AREA_ADC2
          Region:
            OsOSStartAddress = 4294427136
            OsOSEndAddress = 4294427647
            OsOSIdentifier = OS_MEM_AREA_ADC2
            OsOSACCESSING_APPLICATION = Ap_0
            OsOSACCESSING_APPLICATION = Ap_6
            OsOSACCESSING_APPLICATION = Ap_{9..11}
        OS_MEM_AREA_RTP
          Region:
            OsOSStartAddress = 4294965760
            OsOSEndAddress = 4294966015
            OsOSIdentifier = OS_MEM_AREA_RTP
            OsOSACCESSING_APPLICATION = Ap_0
            OsOSACCESSING_APPLICATION = Ap_6
            OsOSACCESSING_APPLICATION = Ap_{9..11}
        OS_MEM_AREA_DMM
          Region:
            OsOSStartAddress = 4294964992
            OsOSEndAddress = 4294965247
            OsOSIdentifier = OS_MEM_AREA_DMM
            OsOSACCESSING_APPLICATION = Ap_0
            OsOSACCESSING_APPLICATION = Ap_6
            OsOSACCESSING_APPLICATION = Ap_{9..11}
        OS_MEM_AREA_IOMM
          Region:
            OsOSStartAddress = 4294961664
            OsOSEndAddress = 4294962175
            OsOSIdentifier = OS_MEM_AREA_IOMM
            OsOSACCESSING_APPLICATION = Ap_0
            OsOSACCESSING_APPLICATION = Ap_6
            OsOSACCESSING_APPLICATION = Ap_{9..11}
        OS_MEM_AREA_RTI
          Region:
            OsOSStartAddress = 4294966272
            OsOSEndAddress = 4294966527
            OsOSIdentifier = OS_MEM_AREA_RTI
            OsOSACCESSING_APPLICATION = Ap_0
            OsOSACCESSING_APPLICATION = Ap_6
            OsOSACCESSING_APPLICATION = Ap_{9..11}
        OS_MEM_AREA_ESMEPSR
          Region:
            OsOSStartAddress = 4294964516
            OsOSEndAddress = 4294964519
            OsOSIdentifier = OS_MEM_AREA_ESMEPSR
            OsOSACCESSING_APPLICATION = Ap_0
            OsOSACCESSING_APPLICATION = Ap_6
            OsOSACCESSING_APPLICATION = Ap_{9..11}
        OS_MEM_AREA_VIM
          Region:
            OsOSStartAddress = 4294966816
            OsOSEndAddress = 4294966859
            OsOSIdentifier = OS_MEM_AREA_VIM
            OsOSACCESSING_APPLICATION = Ap_0
            OsOSACCESSING_APPLICATION = Ap_6
            OsOSACCESSING_APPLICATION = Ap_{9..11}
        OS_MEM_AREA_ESMEKR
          Region:
            OsOSStartAddress = 4294964536
            OsOSEndAddress = 4294964545
            OsOSIdentifier = OS_MEM_AREA_ESMEKR
            OsOSACCESSING_APPLICATION = Ap_0
            OsOSACCESSING_APPLICATION = Ap_6
            OsOSACCESSING_APPLICATION = Ap_{9..11}
        OS_MEM_AREA_SPI_REG1
          Region:
            OsOSStartAddress = 4294439936
            OsOSEndAddress = 4294440447
            OsOSIdentifier = OS_MEM_AREA_SPI_REG1
            OsOSACCESSING_APPLICATION = Ap_0
            OsOSACCESSING_APPLICATION = Ap_6
            OsOSACCESSING_APPLICATION = Ap_{9..11}
        OS_MEM_AREA_SPI_REG3
          Region:
            OsOSStartAddress = 4294440960
            OsOSEndAddress = 4294441471
            OsOSIdentifier = OS_MEM_AREA_SPI_REG3
            OsOSACCESSING_APPLICATION = Ap_0
            OsOSACCESSING_APPLICATION = Ap_6
            OsOSACCESSING_APPLICATION = Ap_{9..11}
        OS_MEM_AREA_SPI_REG5
          Region:
            OsOSStartAddress = 4294441984
            OsOSEndAddress = 4294442495
            OsOSIdentifier = OS_MEM_AREA_SPI_REG5
            OsOSACCESSING_APPLICATION = Ap_0
            OsOSACCESSING_APPLICATION = Ap_6
            OsOSACCESSING_APPLICATION = Ap_{9..11}
        OS_MEM_AREA_SPI_RAM1
          Region:
            OsOSStartAddress = 4279107584
            OsOSEndAddress = 4279238655
            OsOSIdentifier = OS_MEM_AREA_SPI_RAM1
            OsOSACCESSING_APPLICATION = Ap_0
            OsOSACCESSING_APPLICATION = Ap_6
            OsOSACCESSING_APPLICATION = Ap_{9..11}
        OS_MEM_AREA_SPI_RAM3
          Region:
            OsOSStartAddress = 4278976512
            OsOSEndAddress = 4279107583
            OsOSIdentifier = OS_MEM_AREA_SPI_RAM3
            OsOSACCESSING_APPLICATION = Ap_0
            OsOSACCESSING_APPLICATION = Ap_6
            OsOSACCESSING_APPLICATION = Ap_{9..11}
        OS_MEM_AREA_SPI_RAM5
          Region:
            OsOSStartAddress = 4278845440
            OsOSEndAddress = 4278976511
            OsOSIdentifier = OS_MEM_AREA_SPI_RAM5
            OsOSACCESSING_APPLICATION = Ap_0
            OsOSACCESSING_APPLICATION = Ap_6
            OsOSACCESSING_APPLICATION = Ap_{9..11}
        OS_MEM_AREA_SYSECR
          Region:
            OsOSStartAddress = 4294967264
            OsOSEndAddress = 4294967267
            OsOSIdentifier = OS_MEM_AREA_SYSECR
            OsOSACCESSING_APPLICATION = Ap_0
            OsOSACCESSING_APPLICATION = Ap_6
            OsOSACCESSING_APPLICATION = Ap_{9..11}
        OS_MEM_AREA_FLASH
          Region:
            OsOSStartAddress = 4294471680
            OsOSEndAddress = 4294472708
            OsOSIdentifier = OS_MEM_AREA_FLASH
            OsOSACCESSING_APPLICATION = Ap_0
            OsOSACCESSING_APPLICATION = Ap_6
            OsOSACCESSING_APPLICATION = Ap_{9..11}
    RES_SCHEDULER (OsResource): OsResourceProperty=STANDARD
    Task_SchM_10ms_6 (OsTask):
      OsTaskActivation = 1
      OsTaskPriority = 4
      OsTaskSchedule = FULL
      OsTaskTYPE = EXTENDED
      OsTaskNotUsingSchedule = false
      OsTaskComputationTime = 0
      OsTaskPeriod = 0
      OsTaskDeadline = 0
      OsTaskStackSize = 1020
      OsTaskProtectionRegionSizeNoInitData = 0
      OsTaskProtectionRegionSizeInitData = 0
      OsTaskNonTrustFctStackSize = 0
      OsTaskAccessingApplication = Ap_0
      OsTaskAccessingApplication = Ap_6
    OsImplementationInformation: OsVectorOilVersion=3.2, OsVectorImplementationName=TMS570LS3x.i32, OsBswmdStyleVersion=2
    OsCom:
      OsComErrorHook = false
      OsComUseGetServiceId = false
      OsComUseParameterAccess = false
      OsComStartComExtension = false
      OsComUseCOM = false
      OsComStatus = COMSTANDARD
    VectorCommonData: BswmdVersion=5.07.00
    20 x OsAlarm, all with OsAlarmAccessingApplication=Ap_6, OsAlarmCounterRef=SystemTimer:
      Rte_Al_TE_Task_100ms_9_0_100ms: OsAlarmAccessingApplication=Ap_0
        OsAlarmAction
          OsAlarmActivateTask: OsAlarmActivateTaskRef=Task_100ms_9
      Rte_Al_TE_Task_10ms_9_0_10ms: OsAlarmAccessingApplication=Ap_0
        OsAlarmAction
          OsAlarmActivateTask: OsAlarmActivateTaskRef=Task_10ms_9
      Rte_Al_TE_Task_2ms_10_0_2ms: OsAlarmAccessingApplication=Ap_0
        OsAlarmAction
          OsAlarmActivateTask: OsAlarmActivateTaskRef=Task_2ms_10
      Rte_Al_TE_Task_2ms_9_0_2ms: OsAlarmAccessingApplication=Ap_0
        OsAlarmAction
          OsAlarmActivateTask: OsAlarmActivateTaskRef=Task_2ms_9
      Rte_Al_TE_Task_4ms_10_0_4ms: OsAlarmAccessingApplication=Ap_0
        OsAlarmAction
          OsAlarmActivateTask: OsAlarmActivateTaskRef=Task_4ms_10
      Al_Task_SchM_100ms_0: OsAlarmAccessingApplication=Ap_0
        OsAlarmAction
          OsAlarmActivateTask: OsAlarmActivateTaskRef=Task_SchM_100ms_0
        OsAlarmAutostart:
          OsAlarmAlarmTime = 1
          OsAlarmAutostartType = RELATIVE
          OsAlarmCycleTime = 100
          OsAlarmStaticAlarm = false
          OsAlarmAlarmUnit = MSEC
          OsAlarmAppModeRef = OSDEFAULTAPPMODE
      Al_Task_SchM_100ms_6: OsAlarmAccessingApplication=Ap_0
        OsAlarmAction
          OsAlarmActivateTask: OsAlarmActivateTaskRef=Task_SchM_100ms_6
        OsAlarmAutostart:
          OsAlarmAlarmTime = 1
          OsAlarmAutostartType = RELATIVE
          OsAlarmCycleTime = 100
          OsAlarmStaticAlarm = false
          OsAlarmAlarmUnit = MSEC
          OsAlarmAppModeRef = OSDEFAULTAPPMODE
      Al_Task_SchM_10ms_6: OsAlarmAccessingApplication=Ap_0
        OsAlarmAction
          OsAlarmActivateTask: OsAlarmActivateTaskRef=Task_SchM_10ms_6
        OsAlarmAutostart:
          OsAlarmAlarmTime = 1
          OsAlarmAutostartType = RELATIVE
          OsAlarmCycleTime = 10
          OsAlarmStaticAlarm = false
          OsAlarmAlarmUnit = MSEC
          OsAlarmAppModeRef = OSDEFAULTAPPMODE
      Al_Task_SchM_4ms_0: OsAlarmAccessingApplication=Ap_0
        OsAlarmAction
          OsAlarmActivateTask: OsAlarmActivateTaskRef=Task_SchM_4ms_0
        OsAlarmAutostart:
          OsAlarmAlarmTime = 1
          OsAlarmAutostartType = RELATIVE
          OsAlarmCycleTime = 4
          OsAlarmStaticAlarm = false
          OsAlarmAlarmUnit = MSEC
          OsAlarmAppModeRef = OSDEFAULTAPPMODE
      Rte_Al_TE_Task_4ms_9_0_4ms: OsAlarmAccessingApplication=Ap_0
        OsAlarmAction
          OsAlarmActivateTask: OsAlarmActivateTaskRef=Task_4ms_9
      Rte_Al_TE_Task_100ms_11_0_100ms
        OsAlarmAction
          OsAlarmActivateTask: OsAlarmActivateTaskRef=Task_100ms_11
      Rte_Al_TE_Task_10ms_6_0_10ms
        OsAlarmAction
          OsAlarmSetEvent: OsAlarmSetEventRef=Rte_Ev_Cyclic_Task_10ms_6_0_10ms, OsAlarmSetEventTaskRef=Task_10ms_6
      Rte_Al_TE_Task_2ms_11_0_2ms
        OsAlarmAction
          OsAlarmActivateTask: OsAlarmActivateTaskRef=Task_2ms_11
      Rte_Al_TE_Task_100ms_6_0_100ms
        OsAlarmAction
          OsAlarmActivateTask: OsAlarmActivateTaskRef=Task_100ms_6
      Rte_Al_TE_Task_10ms_11_0_10ms
        OsAlarmAction
          OsAlarmActivateTask: OsAlarmActivateTaskRef=Task_10ms_11
      Rte_Al_TE_Task_2ms_6_0_2ms
        OsAlarmAction
          OsAlarmActivateTask: OsAlarmActivateTaskRef=Task_2ms_6
      Rte_Al_TE_Task_10ms_10a_0_10ms
        OsAlarmAction
          OsAlarmActivateTask: OsAlarmActivateTaskRef=Task_10ms_10a
      Rte_Al_TE_Task_10ms_10b_0_10ms
        OsAlarmAction
          OsAlarmSetEvent: OsAlarmSetEventRef=Rte_Ev_Cyclic_Task_10ms_10b_0_10ms, OsAlarmSetEventTaskRef=Task_10ms_10b
      Rte_Al_TE_SrlComDriver_SrlComDriver_Per1
        OsAlarmAction
          OsAlarmSetEvent: OsAlarmSetEventRef=Rte_Ev_Run_SrlComDriver_SrlComDriver_Per1, OsAlarmSetEventTaskRef=Task_10ms_6
      Rte_Al_TE_Task_10ms_10b_0_5ms
        OsAlarmAction
          OsAlarmSetEvent: OsAlarmSetEventRef=Rte_Ev_Cyclic_Task_10ms_10b_0_5ms, OsAlarmSetEventTaskRef=Task_10ms_10b
    4 x OsApplication, all with OsTrusted=false, OsApplicationMPUArea4Size=0, OsApplicationMPUArea4Access=0, OsApplicationMPUArea6Size=0, OsApplicationMPUArea6Access=0, OsApplicationMPUArea8Size=268435456, OsApplicationMPUArea8Access=4864, OsApplicationMPUArea9Size=0, OsApplicationMPUArea9Access=0, OsApplicationMPUArea10Size=0, OsApplicationMPUArea10Access=0, OsApplicationMPUArea11Size=0, OsApplicationMPUArea11Access=0, OsApplicationMPUArea4Start=0, OsApplicationMPUArea6Start=0, OsApplicationMPUArea8Start=4026531840, OsApplicationMPUArea9Start=0, OsApplicationMPUArea10Start=0, OsApplicationMPUArea11Start=0:
      Ap_6: OsAppGenerateStub=true, OsApplicationProtectionRegionSizeNoInitData=16384, OsApplicationProtectionRegionSizeInitData=16384, OsApplicationNonTrusted_Function=NtWrapS_XcpWriteAp6, OsApplicationNonTrusted_Function=NtWrapS_Dem_ClearDTC, OsApplicationNonTrusted_Function=NtWrapS_SrlComDriver_SCom_ElecIntStart, OsApplicationNonTrusted_Function=NtWrapS_SrlComDriver_SCom_ElecIntStop, OsApplicationNonTrusted_Function=NtWrapS_SrlComDriver_SCom_SendMsgOnChange, OsAppAlarmRef=Al_Task_SchM_100ms_6, OsAppAlarmRef=Al_Task_SchM_10ms_6, OsAppAlarmRef=Rte_Al_TE_Task_10ms_6_0_10ms, OsAppAlarmRef=Rte_Al_TE_Task_100ms_6_0_100ms, OsAppAlarmRef=Rte_Al_TE_Task_2ms_6_0_2ms, OsAppAlarmRef=Rte_Al_TE_SrlComDriver_SrlComDriver_Per1, OsAppCounterRef=SystemTimer, OsAppIsrRef=CanIsr_0, OsAppIsrRef=Gpt_IsrInt0, OsAppResourceRef=RES_SCHEDULER, OsAppTaskRef=Task_SchM_100ms_6, OsAppTaskRef=Task_SchM_10ms_6, OsAppTaskRef=Task_SchM_Init_6, OsAppTaskRef=Task_SchM_Trns_6, OsAppTaskRef=Task_10ms_6, OsAppTaskRef=Task_100ms_6, OsAppTaskRef=Task_2ms_6, OsAppTaskRef=Task_Init_6, OsAppTaskRef=Task_Trns_6
        OsApplicationHooks: OsAppErrorHook=false, OsAppShutdownHook=false, OsAppStartupHook=false
        135 x OsApplicationTrustedFunction, all with OsApplicationReturnType=Std_ReturnType:
          Rte_TrustedCall_Ap_ActivePull_SystemTime_DtrmnElapsedTime_mS_u32: OsTrustedFunctionName=Rte_TrustedCall_Ap_ActivePull_SystemTime_DtrmnElapsedTime_mS_u32, OsApplicationParams=UInt32 InitialTime, UInt32 *ElapsedTime
          Rte_TrustedCall_Ap_ActivePull_SystemTime_GetSystemTime_mS_u32: OsTrustedFunctionName=Rte_TrustedCall_Ap_ActivePull_SystemTime_GetSystemTime_mS_u32, OsApplicationParams=UInt32 *CurrentTime
          Rte_TrustedCall_Ap_AvgFricLrn_FltInjection_SCom_FltInjection: OsTrustedFunctionName=Rte_TrustedCall_Ap_AvgFricLrn_FltInjection_SCom_FltInjection, OsApplicationParams=Float *SignalPath_Uls_f32, FltInjectionLocType LocationKey_Cnt_enum
          Rte_TrustedCall_Ap_AvgFricLrn_SystemTime_DtrmnElapsedTime_mS_u32: OsTrustedFunctionName=Rte_TrustedCall_Ap_AvgFricLrn_SystemTime_DtrmnElapsedTime_mS_u32, OsApplicationParams=UInt32 InitialTime, UInt32 *ElapsedTime
          Rte_TrustedCall_Ap_AvgFricLrn_SystemTime_GetSystemTime_mS_u32: OsTrustedFunctionName=Rte_TrustedCall_Ap_AvgFricLrn_SystemTime_GetSystemTime_mS_u32, OsApplicationParams=UInt32 *CurrentTime
          Rte_TrustedCall_Ap_BVDiag_SystemTime_DtrmnElapsedTime_mS_u16: OsTrustedFunctionName=Rte_TrustedCall_Ap_BVDiag_SystemTime_DtrmnElapsedTime_mS_u16, OsApplicationParams=UInt32 InitialTime, UInt16 *ElapsedTime
          Rte_TrustedCall_Ap_BVDiag_SystemTime_GetSystemTime_mS_u32: OsTrustedFunctionName=Rte_TrustedCall_Ap_BVDiag_SystemTime_GetSystemTime_mS_u32, OsApplicationParams=UInt32 *CurrentTime
          Rte_TrustedCall_Ap_BatteryVoltage_FltInjection_SCom_FltInjection: OsTrustedFunctionName=Rte_TrustedCall_Ap_BatteryVoltage_FltInjection_SCom_FltInjection, OsApplicationParams=Float *SignalPath_Uls_f32, FltInjectionLocType LocationKey_Cnt_enum
          Rte_TrustedCall_Ap_LrnEOT_SystemTime_DtrmnElapsedTime_mS_u16: OsTrustedFunctionName=Rte_TrustedCall_Ap_LrnEOT_SystemTime_DtrmnElapsedTime_mS_u16, OsApplicationParams=UInt32 InitialTime, UInt16 *ElapsedTime
          Rte_TrustedCall_Ap_LrnEOT_SystemTime_GetSystemTime_mS_u32: OsTrustedFunctionName=Rte_TrustedCall_Ap_LrnEOT_SystemTime_GetSystemTime_mS_u32, OsApplicationParams=UInt32 *CurrentTime
          Rte_TrustedCall_Sa_BkCpPc_SystemTime_DtrmnElapsedTime_mS_u16: OsTrustedFunctionName=Rte_TrustedCall_Sa_BkCpPc_SystemTime_DtrmnElapsedTime_mS_u16, OsApplicationParams=UInt32 InitialTime, UInt16 *ElapsedTime
          Rte_TrustedCall_Sa_BkCpPc_SystemTime_GetSystemTime_mS_u32: OsTrustedFunctionName=Rte_TrustedCall_Sa_BkCpPc_SystemTime_GetSystemTime_mS_u32, OsApplicationParams=UInt32 *CurrentTime
          Rte_TrustedCall_Ap_AbsHwPos_EOLVehCntrOffset_GetErrorStatus: OsTrustedFunctionName=Rte_TrustedCall_Ap_AbsHwPos_EOLVehCntrOffset_GetErrorStatus, OsApplicationParams=NvM_RequestResultType *ErrorStatus
          Rte_TrustedCall_Ap_AbsHwPos_EOLVehCntrOffset_WriteBlock: OsTrustedFunctionName=Rte_TrustedCall_Ap_AbsHwPos_EOLVehCntrOffset_WriteBlock, OsApplicationParams=const NvM_DestPtr *DstPtr
          Rte_TrustedCall_Ap_ChkPtAp10_ChkPtAp10_100msEnd_CP_CheckpointReached: OsTrustedFunctionName=Rte_TrustedCall_Ap_ChkPtAp10_ChkPtAp10_100msEnd_CP_CheckpointReached, OsApplicationParams=void
          Rte_TrustedCall_Ap_ChkPtAp10_ChkPtAp10_100msStart_CP_CheckpointReached: OsTrustedFunctionName=Rte_TrustedCall_Ap_ChkPtAp10_ChkPtAp10_100msStart_CP_CheckpointReached, OsApplicationParams=void
          Rte_TrustedCall_Ap_ChkPtAp10_ChkPtAp10_2msEnd_CP_CheckpointReached: OsTrustedFunctionName=Rte_TrustedCall_Ap_ChkPtAp10_ChkPtAp10_2msEnd_CP_CheckpointReached, OsApplicationParams=void
          Rte_TrustedCall_Ap_ChkPtAp10_ChkPtAp10_2msStart_CP_CheckpointReached: OsTrustedFunctionName=Rte_TrustedCall_Ap_ChkPtAp10_ChkPtAp10_2msStart_CP_CheckpointReached, OsApplicationParams=void
          Rte_TrustedCall_Ap_ChkPtAp10_ChkPtAp10_4msEnd_CP_CheckpointReached: OsTrustedFunctionName=Rte_TrustedCall_Ap_ChkPtAp10_ChkPtAp10_4msEnd_CP_CheckpointReached, OsApplicationParams=void
          Rte_TrustedCall_Ap_ChkPtAp10_ChkPtAp10_4msStart_CP_CheckpointReached: OsTrustedFunctionName=Rte_TrustedCall_Ap_ChkPtAp10_ChkPtAp10_4msStart_CP_CheckpointReached, OsApplicationParams=void
          Rte_TrustedCall_Ap_CurrParamComp_EOLNomMtrParamBlk_WriteBlock: OsTrustedFunctionName=Rte_TrustedCall_Ap_CurrParamComp_EOLNomMtrParamBlk_WriteBlock, OsApplicationParams=const NvM_DestPtr *DstPtr
          Rte_TrustedCall_Ap_StaMd_CloseCheckData_GetErrorStatus: OsTrustedFunctionName=Rte_TrustedCall_Ap_StaMd_CloseCheckData_GetErrorStatus, OsApplicationParams=NvM_RequestResultType *ErrorStatus
          Rte_TrustedCall_Ap_StaMd_CloseCheckData_WriteBlock: OsTrustedFunctionName=Rte_TrustedCall_Ap_StaMd_CloseCheckData_WriteBlock, OsApplicationParams=const NvM_DestPtr *DstPtr
          Rte_TrustedCall_Ap_StaMd_TOD_OP_SET: OsTrustedFunctionName=Rte_TrustedCall_Ap_StaMd_TOD_OP_SET, OsApplicationParams=IoHwAb_BoolType signal
          Rte_TrustedCall_Ap_StaMd_TypeHData_WriteBlock: OsTrustedFunctionName=Rte_TrustedCall_Ap_StaMd_TypeHData_WriteBlock, OsApplicationParams=const NvM_DestPtr *DstPtr
          Rte_TrustedCall_Ap_TrqCanc_EOLCogTrqCanc_WriteBlock: OsTrustedFunctionName=Rte_TrustedCall_Ap_TrqCanc_EOLCogTrqCanc_WriteBlock, OsApplicationParams=const NvM_DestPtr *DstPtr
          Rte_TrustedCall_Ap_TrqCanc_EOLCogTrqRplComp_WriteBlock: OsTrustedFunctionName=Rte_TrustedCall_Ap_TrqCanc_EOLCogTrqRplComp_WriteBlock, OsApplicationParams=const NvM_DestPtr *DstPtr
          Rte_TrustedCall_Ap_TrqCmdScl_TrqCmdScl_WriteBlock: OsTrustedFunctionName=Rte_TrustedCall_Ap_TrqCmdScl_TrqCmdScl_WriteBlock, OsApplicationParams=const NvM_DestPtr *DstPtr
          Rte_TrustedCall_NtWrap_C_LrnEOT_Scom_ResetEOT: OsTrustedFunctionName=Rte_TrustedCall_NtWrap_C_LrnEOT_Scom_ResetEOT, OsApplicationParams=void
          Rte_TrustedCall_Sa_CmMtrCurr_EOLCurrTempOffset_WriteBlock: OsTrustedFunctionName=Rte_TrustedCall_Sa_CmMtrCurr_EOLCurrTempOffset_WriteBlock, OsApplicationParams=const NvM_DestPtr *DstPtr
          Rte_TrustedCall_Sa_CmMtrCurr_EOLShCurrCal_SetRamBlockStatus: OsTrustedFunctionName=Rte_TrustedCall_Sa_CmMtrCurr_EOLShCurrCal_SetRamBlockStatus, OsApplicationParams=Boolean RamBlockStatus
          Rte_TrustedCall_Sa_CmMtrCurr_EOLShCurrCal_WriteBlock: OsTrustedFunctionName=Rte_TrustedCall_Sa_CmMtrCurr_EOLShCurrCal_WriteBlock, OsApplicationParams=const NvM_DestPtr *DstPtr
          Rte_TrustedCall_Sa_MtrDrvDiag_FetDrvReset_OP_SET: OsTrustedFunctionName=Rte_TrustedCall_Sa_MtrDrvDiag_FetDrvReset_OP_SET, OsApplicationParams=IoHwAb_BoolType signal
          Rte_TrustedCall_Sa_MtrDrvDiag_FetFlt1Data_OP_GET: OsTrustedFunctionName=Rte_TrustedCall_Sa_MtrDrvDiag_FetFlt1Data_OP_GET, OsApplicationParams=IoHwAb_BoolType *signal
          Rte_TrustedCall_Sa_MtrDrvDiag_FetFlt2Clk_OP_GET: OsTrustedFunctionName=Rte_TrustedCall_Sa_MtrDrvDiag_FetFlt2Clk_OP_GET, OsApplicationParams=IoHwAb_BoolType *signal
          Rte_TrustedCall_Sa_MtrDrvDiag_FetFlt2Clk_OP_SET: OsTrustedFunctionName=Rte_TrustedCall_Sa_MtrDrvDiag_FetFlt2Clk_OP_SET, OsApplicationParams=IoHwAb_BoolType signal
          Rte_TrustedCall_Sa_MtrDrvDiag_IoHwAbPortConfig_SetFetFlt2ToOutput: OsTrustedFunctionName=Rte_TrustedCall_Sa_MtrDrvDiag_IoHwAbPortConfig_SetFetFlt2ToOutput, OsApplicationParams=IoHwAb_BoolType signal
          Rte_TrustedCall_Sa_OvrVoltMon_phyOvrVoltFdbk_OP_GET: OsTrustedFunctionName=Rte_TrustedCall_Sa_OvrVoltMon_phyOvrVoltFdbk_OP_GET, OsApplicationParams=IoHwAb_BoolType *signal
          Rte_TrustedCall_Sa_ShtdnMech_FetDrvReset_OP_GET: OsTrustedFunctionName=Rte_TrustedCall_Sa_ShtdnMech_FetDrvReset_OP_GET, OsApplicationParams=IoHwAb_BoolType *signal
          Rte_TrustedCall_Sa_ShtdnMech_SysFault2_OP_GET: OsTrustedFunctionName=Rte_TrustedCall_Sa_ShtdnMech_SysFault2_OP_GET, OsApplicationParams=IoHwAb_BoolType *signal
          Rte_TrustedCall_Sa_ShtdnMech_SysFault3_OP_GET: OsTrustedFunctionName=Rte_TrustedCall_Sa_ShtdnMech_SysFault3_OP_GET, OsApplicationParams=IoHwAb_BoolType *signal
          Rte_TrustedCall_Sa_TmprlMon2_WdMonitor_OP_SET: OsTrustedFunctionName=Rte_TrustedCall_Sa_TmprlMon2_WdMonitor_OP_SET, OsApplicationParams=IoHwAb_BoolType signal
          Rte_TrustedCall_Sa_TmprlMon_FetDrvCntl_OP_GET: OsTrustedFunctionName=Rte_TrustedCall_Sa_TmprlMon_FetDrvCntl_OP_GET, OsApplicationParams=IoHwAb_BoolType *signal
          Rte_TrustedCall_Sa_TmprlMon_PwrSwitchEn_OP_GET: OsTrustedFunctionName=Rte_TrustedCall_Sa_TmprlMon_PwrSwitchEn_OP_GET, OsApplicationParams=IoHwAb_BoolType *signal
          Rte_TrustedCall_Sa_TmprlMon_SysFault2_OP_GET: OsTrustedFunctionName=Rte_TrustedCall_Sa_TmprlMon_SysFault2_OP_GET, OsApplicationParams=IoHwAb_BoolType *signal
          Rte_TrustedCall_Sa_TmprlMon_SysFault2_OP_SET: OsTrustedFunctionName=Rte_TrustedCall_Sa_TmprlMon_SysFault2_OP_SET, OsApplicationParams=IoHwAb_BoolType signal
          Rte_TrustedCall_Sa_TmprlMon_SysFault3_OP_GET: OsTrustedFunctionName=Rte_TrustedCall_Sa_TmprlMon_SysFault3_OP_GET, OsApplicationParams=IoHwAb_BoolType *signal
          Rte_TrustedCall_Sa_TmprlMon_SysFault3_OP_SET: OsTrustedFunctionName=Rte_TrustedCall_Sa_TmprlMon_SysFault3_OP_SET, OsApplicationParams=IoHwAb_BoolType signal
          Rte_TrustedCall_Sa_TmprlMon_WdMonitor_OP_SET: OsTrustedFunctionName=Rte_TrustedCall_Sa_TmprlMon_WdMonitor_OP_SET, OsApplicationParams=IoHwAb_BoolType signal
          Rte_TrustedCall_Sa_TmprlMon_WdReset_OP_SET: OsTrustedFunctionName=Rte_TrustedCall_Sa_TmprlMon_WdReset_OP_SET, OsApplicationParams=IoHwAb_BoolType signal
          Rte_TrustedCall_Ap_VehPwrMd_SystemTime_DtrmnElapsedTime_mS_u16: OsTrustedFunctionName=Rte_TrustedCall_Ap_VehPwrMd_SystemTime_DtrmnElapsedTime_mS_u16, OsApplicationParams=UInt32 InitialTime, UInt16 *ElapsedTime
          Rte_TrustedCall_Ap_VehPwrMd_SystemTime_GetSystemTime_mS_u32: OsTrustedFunctionName=Rte_TrustedCall_Ap_VehPwrMd_SystemTime_GetSystemTime_mS_u32, OsApplicationParams=UInt32 *CurrentTime
          Rte_TrustedCall_Ap_AvgFricLrn_AvgFricLrnData_WriteBlock: OsTrustedFunctionName=Rte_TrustedCall_Ap_AvgFricLrn_AvgFricLrnData_WriteBlock, OsApplicationParams=const NvM_DestPtr *DstPtr
          Rte_TrustedCall_Ap_BatteryVoltage_OvervoltageData_SetRamBlockStatus: OsTrustedFunctionName=Rte_TrustedCall_Ap_BatteryVoltage_OvervoltageData_SetRamBlockStatus, OsApplicationParams=Boolean RamBlockStatus
          Rte_TrustedCall_Ap_BatteryVoltage_OvervoltageData_WriteBlock: OsTrustedFunctionName=Rte_TrustedCall_Ap_BatteryVoltage_OvervoltageData_WriteBlock, OsApplicationParams=const NvM_DestPtr *DstPtr
          Rte_TrustedCall_Ap_ChkPtAp9_ChkPtAp9_100msEnd_CP_CheckpointReached: OsTrustedFunctionName=Rte_TrustedCall_Ap_ChkPtAp9_ChkPtAp9_100msEnd_CP_CheckpointReached, OsApplicationParams=void
          Rte_TrustedCall_Ap_ChkPtAp9_ChkPtAp9_100msStart_CP_CheckpointReached: OsTrustedFunctionName=Rte_TrustedCall_Ap_ChkPtAp9_ChkPtAp9_100msStart_CP_CheckpointReached, OsApplicationParams=void
          Rte_TrustedCall_Ap_ChkPtAp9_ChkPtAp9_10msEnd_CP_CheckpointReached: OsTrustedFunctionName=Rte_TrustedCall_Ap_ChkPtAp9_ChkPtAp9_10msEnd_CP_CheckpointReached, OsApplicationParams=void
          Rte_TrustedCall_Ap_ChkPtAp9_ChkPtAp9_10msStart_CP_CheckpointReached: OsTrustedFunctionName=Rte_TrustedCall_Ap_ChkPtAp9_ChkPtAp9_10msStart_CP_CheckpointReached, OsApplicationParams=void
          Rte_TrustedCall_Ap_ChkPtAp9_ChkPtAp9_2msEnd_CP_CheckpointReached: OsTrustedFunctionName=Rte_TrustedCall_Ap_ChkPtAp9_ChkPtAp9_2msEnd_CP_CheckpointReached, OsApplicationParams=void
          Rte_TrustedCall_Ap_ChkPtAp9_ChkPtAp9_2msStart_CP_CheckpointReached: OsTrustedFunctionName=Rte_TrustedCall_Ap_ChkPtAp9_ChkPtAp9_2msStart_CP_CheckpointReached, OsApplicationParams=void
          Rte_TrustedCall_Ap_ChkPtAp9_ChkPtAp9_4msEnd_CP_CheckpointReached: OsTrustedFunctionName=Rte_TrustedCall_Ap_ChkPtAp9_ChkPtAp9_4msEnd_CP_CheckpointReached, OsApplicationParams=void
          Rte_TrustedCall_Ap_ChkPtAp9_ChkPtAp9_4msStart_CP_CheckpointReached: OsTrustedFunctionName=Rte_TrustedCall_Ap_ChkPtAp9_ChkPtAp9_4msStart_CP_CheckpointReached, OsApplicationParams=void
          Rte_TrustedCall_Ap_LrnEOT_LearnedEOTData_SetRamBlockStatus: OsTrustedFunctionName=Rte_TrustedCall_Ap_LrnEOT_LearnedEOTData_SetRamBlockStatus, OsApplicationParams=Boolean RamBlockStatus
          Rte_TrustedCall_Ap_LrnEOT_LearnedEOTData_WriteBlock: OsTrustedFunctionName=Rte_TrustedCall_Ap_LrnEOT_LearnedEOTData_WriteBlock, OsApplicationParams=const NvM_DestPtr *DstPtr
          Rte_TrustedCall_Ap_ThrmlDutyCycle_ThrmlDutyCycle_FltStVar_GetErrorStatus: OsTrustedFunctionName=Rte_TrustedCall_Ap_ThrmlDutyCycle_ThrmlDutyCycle_FltStVar_GetErrorStatus, OsApplicationParams=NvM_RequestResultType *ErrorStatus
          Rte_TrustedCall_Ap_ThrmlDutyCycle_ThrmlDutyCycle_FltStVar_SetRamBlockStatus: OsTrustedFunctionName=Rte_TrustedCall_Ap_ThrmlDutyCycle_ThrmlDutyCycle_FltStVar_SetRamBlockStatus, OsApplicationParams=Boolean RamBlockStatus
          Rte_TrustedCall_Ap_VehPwrMd_EpsEn_OP_GET: OsTrustedFunctionName=Rte_TrustedCall_Ap_VehPwrMd_EpsEn_OP_GET, OsApplicationParams=IoHwAb_BoolType *signal
          Rte_TrustedCall_Ap_ChkPtAp11_ChkPtAp11_100msEnd_CP_CheckpointReached: OsTrustedFunctionName=Rte_TrustedCall_Ap_ChkPtAp11_ChkPtAp11_100msEnd_CP_CheckpointReached, OsApplicationParams=void
          Rte_TrustedCall_Ap_ChkPtAp11_ChkPtAp11_100msStart_CP_CheckpointReached: OsTrustedFunctionName=Rte_TrustedCall_Ap_ChkPtAp11_ChkPtAp11_100msStart_CP_CheckpointReached, OsApplicationParams=void
          Rte_TrustedCall_Ap_ChkPtAp11_ChkPtAp11_10msEnd_CP_CheckpointReached: OsTrustedFunctionName=Rte_TrustedCall_Ap_ChkPtAp11_ChkPtAp11_10msEnd_CP_CheckpointReached, OsApplicationParams=void
          Rte_TrustedCall_Ap_ChkPtAp11_ChkPtAp11_10msStart_CP_CheckpointReached: OsTrustedFunctionName=Rte_TrustedCall_Ap_ChkPtAp11_ChkPtAp11_10msStart_CP_CheckpointReached, OsApplicationParams=void
          Rte_TrustedCall_Ap_ChkPtAp11_ChkPtAp11_2msEnd_CP_CheckpointReached: OsTrustedFunctionName=Rte_TrustedCall_Ap_ChkPtAp11_ChkPtAp11_2msEnd_CP_CheckpointReached, OsApplicationParams=void
          Rte_TrustedCall_Ap_ChkPtAp11_ChkPtAp11_2msStart_CP_CheckpointReached: OsTrustedFunctionName=Rte_TrustedCall_Ap_ChkPtAp11_ChkPtAp11_2msStart_CP_CheckpointReached, OsApplicationParams=void
          Rte_TrustedCall_Ap_Return_FltInjection_SCom_FltInjection: OsTrustedFunctionName=Rte_TrustedCall_Ap_Return_FltInjection_SCom_FltInjection, OsApplicationParams=Float *SignalPath_Uls_f32, FltInjectionLocType LocationKey_Cnt_enum
          Rte_TrustedCall_Ap_SignlCondn_FaultInjection_SCom_FltInjection: OsTrustedFunctionName=Rte_TrustedCall_Ap_SignlCondn_FaultInjection_SCom_FltInjection, OsApplicationParams=Float *SignalPath_Uls_f32, FltInjectionLocType LocationKey_Cnt_enum
          Rte_TrustedCall_Ap_VehDyn_SystemTime_DtrmnElapsedTime_mS_u32: OsTrustedFunctionName=Rte_TrustedCall_Ap_VehDyn_SystemTime_DtrmnElapsedTime_mS_u32, OsApplicationParams=UInt32 InitialTime, UInt32 *ElapsedTime
          Rte_TrustedCall_Ap_VehDyn_SystemTime_GetSystemTime_mS_u32: OsTrustedFunctionName=Rte_TrustedCall_Ap_VehDyn_SystemTime_GetSystemTime_mS_u32, OsApplicationParams=UInt32 *CurrentTime
          Rte_TrustedCall_NtWrap_C_CmMtrCurr_SCom_CalGain: OsTrustedFunctionName=Rte_TrustedCall_NtWrap_C_CmMtrCurr_SCom_CalGain, OsApplicationParams=void
          Rte_TrustedCall_NtWrap_C_CmMtrCurr_SCom_CalOffset: OsTrustedFunctionName=Rte_TrustedCall_NtWrap_C_CmMtrCurr_SCom_CalOffset, OsApplicationParams=void
          Rte_TrustedCall_NtWrap_C_CmMtrCurr_SCom_SetMtrCurrCals: OsTrustedFunctionName=Rte_TrustedCall_NtWrap_C_CmMtrCurr_SCom_SetMtrCurrCals, OsApplicationParams=const PhaseCurrCal_DataType *ShCurrCalPtr
          Rte_TrustedCall_Sa_CDDInterface9_CDDPorts_ClearPhsReasSum: OsTrustedFunctionName=Rte_TrustedCall_Sa_CDDInterface9_CDDPorts_ClearPhsReasSum, OsApplicationParams=UInt16 DataAccessBfr_Cnt_T_u16
          Rte_TrustedCall_Sa_TmprlMon_SystemTime_DtrmnElapsedTime_mS_u16: OsTrustedFunctionName=Rte_TrustedCall_Sa_TmprlMon_SystemTime_DtrmnElapsedTime_mS_u16, OsApplicationParams=UInt32 InitialTime, UInt16 *ElapsedTime
          Rte_TrustedCall_Sa_TmprlMon_SystemTime_GetSystemTime_mS_u32: OsTrustedFunctionName=Rte_TrustedCall_Sa_TmprlMon_SystemTime_GetSystemTime_mS_u32, OsApplicationParams=UInt32 *CurrentTime
          Rte_TrustedCall_NtWrap_C_IoHwAb_Adc_ResetAdcEnable: OsTrustedFunctionName=Rte_TrustedCall_NtWrap_C_IoHwAb_Adc_ResetAdcEnable, OsApplicationParams=void
          Rte_TrustedCall_NtWrap_C_ActivePull_SCom_SetLTComp: OsTrustedFunctionName=Rte_TrustedCall_NtWrap_C_ActivePull_SCom_SetLTComp, OsApplicationParams=Float LTComp_HwNm_f32
          Rte_TrustedCall_NtWrap_C_ActivePull_SCom_SetSTComp: OsTrustedFunctionName=Rte_TrustedCall_NtWrap_C_ActivePull_SCom_SetSTComp, OsApplicationParams=Float STComp_HwNm_f32
          Rte_TrustedCall_NtWrap_C_AvgFricLrn_SCom_InitLearnedTables: OsTrustedFunctionName=Rte_TrustedCall_NtWrap_C_AvgFricLrn_SCom_InitLearnedTables, OsApplicationParams=void
          Rte_TrustedCall_NtWrap_C_AvgFricLrn_SCom_ResetToZero: OsTrustedFunctionName=Rte_TrustedCall_NtWrap_C_AvgFricLrn_SCom_ResetToZero, OsApplicationParams=void
          Rte_TrustedCall_NtWrap_C_AvgFricLrn_SCom_SetEOLFric: OsTrustedFunctionName=Rte_TrustedCall_NtWrap_C_AvgFricLrn_SCom_SetEOLFric, OsApplicationParams=Float EOLFric_HwNm_f32
          Rte_TrustedCall_NtWrap_C_AvgFricLrn_SCom_SetOffsetOutputDefeat: OsTrustedFunctionName=Rte_TrustedCall_NtWrap_C_AvgFricLrn_SCom_SetOffsetOutputDefeat, OsApplicationParams=Boolean DefeatOffsetOutput_Cnt_lgc
          Rte_TrustedCall_NtWrap_C_AvgFricLrn_SCom_SetSelect: OsTrustedFunctionName=Rte_TrustedCall_NtWrap_C_AvgFricLrn_SCom_SetSelect, OsApplicationParams=Boolean EnableFricLearning_Cnt_lgc, Boolean EnableOffsetOutput_Cnt_lgc, UInt8 OpMode_Uls_u08
          Rte_TrustedCall_NtWrap_C_BatteryVoltage_SCom_ClearTransOvData: OsTrustedFunctionName=Rte_TrustedCall_NtWrap_C_BatteryVoltage_SCom_ClearTransOvData, OsApplicationParams=void
          Rte_TrustedCall_Ap_ChkPtAp10_ChkPtAp10_10msaEnd_CP_CheckpointReached: OsTrustedFunctionName=Rte_TrustedCall_Ap_ChkPtAp10_ChkPtAp10_10msaEnd_CP_CheckpointReached, OsApplicationParams=void
          Rte_TrustedCall_Ap_ChkPtAp10_ChkPtAp10_10msaStart_CP_CheckpointReached: OsTrustedFunctionName=Rte_TrustedCall_Ap_ChkPtAp10_ChkPtAp10_10msaStart_CP_CheckpointReached, OsApplicationParams=void
          Rte_TrustedCall_Ap_ChkPtAp10_ChkPtAp10_10msbEnd_CP_CheckpointReached: OsTrustedFunctionName=Rte_TrustedCall_Ap_ChkPtAp10_ChkPtAp10_10msbEnd_CP_CheckpointReached, OsApplicationParams=void
          Rte_TrustedCall_Ap_ChkPtAp10_ChkPtAp10_10msbStart_CP_CheckpointReached: OsTrustedFunctionName=Rte_TrustedCall_Ap_ChkPtAp10_ChkPtAp10_10msbStart_CP_CheckpointReached, OsApplicationParams=void
          Rte_TrustedCall_Ap_SrlComInput_EpsEn_OP_GET: OsTrustedFunctionName=Rte_TrustedCall_Ap_SrlComInput_EpsEn_OP_GET, OsApplicationParams=IoHwAb_BoolType *signal
          Rte_TrustedCall_Ap_SrlComOutput_EpsEn_OP_GET: OsTrustedFunctionName=Rte_TrustedCall_Ap_SrlComOutput_EpsEn_OP_GET, OsApplicationParams=IoHwAb_BoolType *signal
          Rte_TrustedCall_Cd_SrlComDriver_SystemTime_GetSystemTime_mS_u32: OsTrustedFunctionName=Rte_TrustedCall_Cd_SrlComDriver_SystemTime_GetSystemTime_mS_u32, OsApplicationParams=UInt32 *CurrentTime
          Rte_TrustedCall_Cd_SrlComDriver_SystemTime_DtrmnElapsedTime_mS_u16: OsTrustedFunctionName=Rte_TrustedCall_Cd_SrlComDriver_SystemTime_DtrmnElapsedTime_mS_u16, OsApplicationParams=UInt32 InitialTime, UInt16 *ElapsedTime
          Rte_TrustedCall_Ap_SrlComOutput_IndStatusETATDA2_GetIndicatorStatus: OsTrustedFunctionName=Rte_TrustedCall_Ap_SrlComOutput_IndStatusETATDA2_GetIndicatorStatus, OsApplicationParams=Dem_IndicatorStatusType *IndicatorStatus
          Rte_TrustedCall_Ap_VehDyn_NVM_VehDynReset_Srv_WriteBlock: OsTrustedFunctionName=Rte_TrustedCall_Ap_VehDyn_NVM_VehDynReset_Srv_WriteBlock, OsApplicationParams=const NvM_DestPtr *DstPtr
          Rte_TrustedCall_NtWrap_C_VehDyn_SCom_ResetCenter: OsTrustedFunctionName=Rte_TrustedCall_NtWrap_C_VehDyn_SCom_ResetCenter, OsApplicationParams=void
          Rte_TrustedCall_Ap_SrlComInput_VHHTYPE_WriteBlock: OsTrustedFunctionName=Rte_TrustedCall_Ap_SrlComInput_VHHTYPE_WriteBlock, OsApplicationParams=const NvM_DestPtr *DstPtr
          Rte_TrustedCall_Ap_SrlComInput_ElecInt_WriteBlock: OsTrustedFunctionName=Rte_TrustedCall_Ap_SrlComInput_ElecInt_WriteBlock, OsApplicationParams=const NvM_DestPtr *DstPtr
          Rte_TrustedCall_NtWrap_C_SrlComDriver_SCom_ElecIntStart: OsTrustedFunctionName=Rte_TrustedCall_NtWrap_C_SrlComDriver_SCom_ElecIntStart, OsApplicationParams=void
          Rte_TrustedCall_NtWrap_C_SrlComDriver_SCom_ElecIntStop: OsTrustedFunctionName=Rte_TrustedCall_NtWrap_C_SrlComDriver_SCom_ElecIntStop, OsApplicationParams=void
          Rte_TrustedCall_Ap_CustBattDiag_EpsEn_OP_GET: OsTrustedFunctionName=Rte_TrustedCall_Ap_CustBattDiag_EpsEn_OP_GET, OsApplicationParams=IoHwAb_BoolType *signal
          Rte_TrustedCall_Ap_CustBattDiag_SystemTime_DtrmnElapsedTime_mS_u16: OsTrustedFunctionName=Rte_TrustedCall_Ap_CustBattDiag_SystemTime_DtrmnElapsedTime_mS_u16, OsApplicationParams=UInt32 InitialTime, UInt16 *ElapsedTime
          Rte_TrustedCall_Ap_CustBattDiag_SystemTime_DtrmnElapsedTime_mS_u32: OsTrustedFunctionName=Rte_TrustedCall_Ap_CustBattDiag_SystemTime_DtrmnElapsedTime_mS_u32, OsApplicationParams=UInt32 InitialTime, UInt32 *ElapsedTime
          Rte_TrustedCall_Ap_CustBattDiag_SystemTime_GetSystemTime_mS_u32: OsTrustedFunctionName=Rte_TrustedCall_Ap_CustBattDiag_SystemTime_GetSystemTime_mS_u32, OsApplicationParams=UInt32 *CurrentTime
          Rte_TrustedCall_Ap_FaultLog_SystemTime_GetSystemTime_mS_u32: OsTrustedFunctionName=Rte_TrustedCall_Ap_FaultLog_SystemTime_GetSystemTime_mS_u32, OsApplicationParams=UInt32 *CurrentTime
          Rte_TrustedCall_Ap_SrlComInput_ShutdownTime_WriteBlock: OsTrustedFunctionName=Rte_TrustedCall_Ap_SrlComInput_ShutdownTime_WriteBlock, OsApplicationParams=const NvM_DestPtr *DstPtr
          Rte_TrustedCall_Sa_HwTqCorrln_HwTqCorrlnCh1CMCLPFSvBlk_SetRamBlockStatus: OsTrustedFunctionName=Rte_TrustedCall_Sa_HwTqCorrln_HwTqCorrlnCh1CMCLPFSvBlk_SetRamBlockStatus, OsApplicationParams=Boolean RamBlockStatus
          Rte_TrustedCall_Sa_HwTqArbn_HwTqArbnEOLCh1OffsetTrim_WriteBlock: OsTrustedFunctionName=Rte_TrustedCall_Sa_HwTqArbn_HwTqArbnEOLCh1OffsetTrim_WriteBlock, OsApplicationParams=const NvM_DestPtr *DstPtr
          Rte_TrustedCall_Ap_CtrlPolarityBrshlss_Polarity_WriteBlock: OsTrustedFunctionName=Rte_TrustedCall_Ap_CtrlPolarityBrshlss_Polarity_WriteBlock, OsApplicationParams=const NvM_DestPtr *DstPtr
          Rte_TrustedCall_Ap_PsaAgArbn_PsaAgArbnLrndOffsBlk_GetErrorStatus: OsTrustedFunctionName=Rte_TrustedCall_Ap_PsaAgArbn_PsaAgArbnLrndOffsBlk_GetErrorStatus, OsApplicationParams=NvM_RequestResultType *ErrorStatus
          Rte_TrustedCall_Ap_PsaAgArbn_PsaAgArbnLrndOffsBlk_SetRamBlockStatus: OsTrustedFunctionName=Rte_TrustedCall_Ap_PsaAgArbn_PsaAgArbnLrndOffsBlk_SetRamBlockStatus, OsApplicationParams=Boolean RamBlockStatus
          Rte_TrustedCall_Ap_PsaAgArbn_PsaAgArbnLrndOffsBlk_WriteBlock: OsTrustedFunctionName=Rte_TrustedCall_Ap_PsaAgArbn_PsaAgArbnLrndOffsBlk_WriteBlock, OsApplicationParams=const NvM_DestPtr *DstPtr
          Rte_TrustedCall_Cd_SrlComDriver_IS_DAT_DIRA_Get: OsTrustedFunctionName=Rte_TrustedCall_Cd_SrlComDriver_IS_DAT_DIRA_Get, OsApplicationParams=IS_DAT_DIRA_Msg *IsDatDira
          Rte_TrustedCall_Cd_SrlComDriver_IS_DYN_DAE_Get: OsTrustedFunctionName=Rte_TrustedCall_Cd_SrlComDriver_IS_DYN_DAE_Get, OsApplicationParams=IS_DYN_DAE_Msg *IsDynDae
          Rte_TrustedCall_Cd_SrlComDriver_IS_DYN_VOL_Get: OsTrustedFunctionName=Rte_TrustedCall_Cd_SrlComDriver_IS_DYN_VOL_Get, OsApplicationParams=IS_DYN_VOL_MsgBase *IsDynVolBase, IS_DYN_VOL_MsgAdd *IsDynVolAdd
          Rte_TrustedCall_Cd_SrlComDriver_IS_SUPV_DIRA_Get: OsTrustedFunctionName=Rte_TrustedCall_Cd_SrlComDriver_IS_SUPV_DIRA_Get, OsApplicationParams=IS_SUPV_DIRA_Msg *IsSupvDira
          Rte_TrustedCall_NtWrap_C_SrlComDriver_SCom_SendMsgOnChange: OsTrustedFunctionName=Rte_TrustedCall_NtWrap_C_SrlComDriver_SCom_SendMsgOnChange, OsApplicationParams=void
          Rte_TrustedCall_Ap_DiagSvc_IS_DYN_DAE_Get: OsTrustedFunctionName=Rte_TrustedCall_Ap_DiagSvc_IS_DYN_DAE_Get, OsApplicationParams=IS_DYN_DAE_Msg *IsDynDae
          Rte_TrustedCall_Ap_DiagSvc_IS_SUPV_DIRA_Get: OsTrustedFunctionName=Rte_TrustedCall_Ap_DiagSvc_IS_SUPV_DIRA_Get, OsApplicationParams=IS_SUPV_DIRA_Msg *IsSupvDira
          Rte_TrustedCall_Ap_PSASH_SystemTime_DtrmnElapsedTime_mS_u32: OsTrustedFunctionName=Rte_TrustedCall_Ap_PSASH_SystemTime_DtrmnElapsedTime_mS_u32, OsApplicationParams=UInt32 InitialTime, UInt32 *ElapsedTime
          Rte_TrustedCall_Ap_PSASH_SystemTime_GetSystemTime_mS_u32: OsTrustedFunctionName=Rte_TrustedCall_Ap_PSASH_SystemTime_GetSystemTime_mS_u32, OsApplicationParams=UInt32 *CurrentTime
          Rte_TrustedCall_NtWrap_C_SrlComDriver_SCom_GetBusOffCounter: OsTrustedFunctionName=Rte_TrustedCall_NtWrap_C_SrlComDriver_SCom_GetBusOffCounter, OsApplicationParams=UInt16 *BusOffCounter_Cnt_T_u16
          Rte_TrustedCall_Ap_ActivePull_FaultInjection_SCom_FltInjection: OsTrustedFunctionName=Rte_TrustedCall_Ap_ActivePull_FaultInjection_SCom_FltInjection, OsApplicationParams=Float *SignalPath_Uls_f32, FltInjectionLocType LocationKey_Cnt_enum
          Rte_TrustedCall_Ap_ActivePull_PullCmpLTComp_SetRamBlockStatus: OsTrustedFunctionName=Rte_TrustedCall_Ap_ActivePull_PullCmpLTComp_SetRamBlockStatus, OsApplicationParams=Boolean RamBlockStatus
          Rte_TrustedCall_Ap_VehDyn_NVM_VehDynReset_Srv_GetErrorStatus: OsTrustedFunctionName=Rte_TrustedCall_Ap_VehDyn_NVM_VehDynReset_Srv_GetErrorStatus, OsApplicationParams=NvM_RequestResultType *ErrorStatus
          Rte_TrustedCall_Ap_DemIf_SystemTime_DtrmnElapsedTime_mS_u16: OsTrustedFunctionName=Rte_TrustedCall_Ap_DemIf_SystemTime_DtrmnElapsedTime_mS_u16, OsApplicationParams=UInt32 InitialTime, UInt16 *ElapsedTime
          Rte_TrustedCall_Ap_DemIf_SystemTime_GetSystemTime_mS_u32: OsTrustedFunctionName=Rte_TrustedCall_Ap_DemIf_SystemTime_GetSystemTime_mS_u32, OsApplicationParams=UInt32 *CurrentTime
      Ap_9: OsAppGenerateStub=false, OsApplicationProtectionRegionSizeNoInitData=4096, OsApplicationProtectionRegionSizeInitData=4096, OsApplicationNonTrusted_Function=NtWrapS_XcpWriteAp9, OsApplicationNonTrusted_Function=NtWrapS_ActivePull_SCom_SetLTComp, OsApplicationNonTrusted_Function=NtWrapS_ActivePull_SCom_SetSTComp, OsApplicationNonTrusted_Function=NtWrapS_AvgFricLrn_SCom_ResetToZero, OsApplicationNonTrusted_Function=NtWrapS_AvgFricLrn_SCom_InitLearnedTables, OsApplicationNonTrusted_Function=NtWrapS_AvgFricLrn_SCom_SetSelect, OsApplicationNonTrusted_Function=NtWrapS_AvgFricLrn_SCom_SetOffsetOutputDefeat, OsApplicationNonTrusted_Function=NtWrapS_AvgFricLrn_SCom_SetEOLFric, OsApplicationNonTrusted_Function=NtWrapS_BatteryVoltage_SCom_ClearTransOvData, OsApplicationNonTrusted_Function=NtWrapS_IoHwAb_Adc_ResetAdcEnable, OsApplicationNonTrusted_Function=NtWrapS_LrnEOT_Scom_ResetEOT, OsApplicationNonTrusted_Function=NtWrapS_VehDyn_SCom_ResetCenter, OsAppAlarmRef=Rte_Al_TE_Task_100ms_9_0_100ms, OsAppAlarmRef=Rte_Al_TE_Task_10ms_9_0_10ms, OsAppAlarmRef=Rte_Al_TE_Task_2ms_9_0_2ms, OsAppAlarmRef=Rte_Al_TE_Task_4ms_9_0_4ms, OsAppIsrRef=Isr_OvervoltThresh, OsAppTaskRef=Task_2ms_9, OsAppTaskRef=Task_Init_9, OsAppTaskRef=Task_10ms_9, OsAppTaskRef=Task_Trns_9, OsAppTaskRef=Task_4ms_9, OsAppTaskRef=Task_100ms_9
        OsApplicationHooks: OsAppErrorHook=false, OsAppShutdownHook=false, OsAppStartupHook=false
      Ap_10: OsAppGenerateStub=false, OsApplicationProtectionRegionSizeNoInitData=8192, OsApplicationProtectionRegionSizeInitData=8192, OsApplicationNonTrusted_Function=NtWrapS_XcpWriteAp10, OsApplicationNonTrusted_Function=NtWrapS_AbsHwPos_SCom_CustClrTrim, OsApplicationNonTrusted_Function=NtWrapS_AbsHwPos_SCom_CustSetTrim, OsApplicationNonTrusted_Function=NtWrapS_AbsHwPos_SCom_NxtClearTrim, OsApplicationNonTrusted_Function=NtWrapS_AbsHwPos_SCom_NxtSetTrim, OsApplicationNonTrusted_Function=NtWrapS_AstLmt_Scom_ManualTrqCmd, OsApplicationNonTrusted_Function=NtWrapS_Polarity_SCom_SetPolarity, OsApplicationNonTrusted_Function=NtWrapS_SCom_EOLNomMtrParam_Set, OsApplicationNonTrusted_Function=NtWrapS_SrlComInput_SCom_ManualVehSpd, OsApplicationNonTrusted_Function=NtWrapS_SrlComInput_SCom_ResetTimers, OsApplicationNonTrusted_Function=NtWrapS_SrlComInput_SCom_VehSpdControl, OsApplicationNonTrusted_Function=NtWrapS_TrqCanc_Scom_SetCogTrqCal, OsApplicationNonTrusted_Function=NtWrapS_TrqCmdScl_SCom_Set, OsApplicationNonTrusted_Function=NtWrapS_HwTqArbn_SCom_ClrTrqTrim, OsApplicationNonTrusted_Function=NtWrapS_HwTqArbn_SCom_SetTrqTrim, OsApplicationNonTrusted_Function=NtWrapS_HwTqArbn_SCom_WriteData, OsApplicationNonTrusted_Function=NtWrapS_PsaAgArbn_SCom_PsaAaCmd, OsAppAlarmRef=Rte_Al_TE_Task_100ms_10_0_100ms, OsAppAlarmRef=Rte_Al_TE_Task_2ms_10_0_2ms, OsAppAlarmRef=Rte_Al_TE_Task_4ms_10_0_4ms, OsAppAlarmRef=Rte_Al_TE_Task_10ms_10a_0_10ms, OsAppAlarmRef=Rte_Al_TE_Task_10ms_10b_0_10ms, OsAppAlarmRef=Rte_Al_TE_Task_10ms_10b_0_5ms, OsAppTaskRef=Task_100ms_10, OsAppTaskRef=Task_2ms_10, OsAppTaskRef=Task_4ms_10, OsAppTaskRef=Task_Init_10, OsAppTaskRef=Task_Trns_10, OsAppTaskRef=Task_10ms_10a, OsAppTaskRef=Task_10ms_10b
        OsApplicationHooks: OsAppErrorHook=false, OsAppShutdownHook=false, OsAppStartupHook=false
      Ap_11: OsAppGenerateStub=false, OsApplicationProtectionRegionSizeNoInitData=1024, OsApplicationProtectionRegionSizeInitData=1024, OsApplicationNonTrusted_Function=NtWrapS_XcpWriteAp11, OsApplicationNonTrusted_Function=NtWrapS_CmMtrCurr_SCom_CalGain, OsApplicationNonTrusted_Function=NtWrapS_CmMtrCurr_SCom_CalOffset, OsApplicationNonTrusted_Function=NtWrapS_CmMtrCurr_SCom_SetMtrCurrCals, OsAppAlarmRef=Rte_Al_TE_Task_100ms_11_0_100ms, OsAppAlarmRef=Rte_Al_TE_Task_2ms_11_0_2ms, OsAppAlarmRef=Rte_Al_TE_Task_10ms_11_0_10ms, OsAppTaskRef=Task_2ms_11, OsAppTaskRef=Task_Trns_11, OsAppTaskRef=Task_100ms_11, OsAppTaskRef=Task_10ms_11, OsAppTaskRef=Task_Init_11a, OsAppTaskRef=Task_Init_11b
        OsApplicationHooks: OsAppErrorHook=false, OsAppShutdownHook=false, OsAppStartupHook=false
    40 x OsEvent:
      Rte_Ev_Run_ePWM2_ePWM2_Trns2
      Rte_Ev_MS_Task_Trns_10: OsEventMask=4
      Rte_Ev_MS_Task_Trns_9: OsEventMask=4
      Rte_Ev_OnEntry_Task_Trns_10_StaMd_SystemState_Mode_DISABLE
      Rte_Ev_OnEntry_Task_Trns_10_StaMd_SystemState_Mode_OFF
      Rte_Ev_OnEntry_Task_Trns_10_StaMd_SystemState_Mode_OPERATE
      Rte_Ev_OnEntry_Task_Trns_10_StaMd_SystemState_Mode_WARMINIT
      Rte_Ev_OnEntry_Task_Trns_9_StaMd9_SystemState9_Mode_DISABLE
      Rte_Ev_OnEntry_Task_Trns_9_StaMd9_SystemState9_Mode_OFF
      Rte_Ev_OnEntry_Task_Trns_9_StaMd9_SystemState9_Mode_OPERATE
      Rte_Ev_OnEntry_Task_Trns_9_StaMd9_SystemState9_Mode_WARMINIT
      Rte_Ev_MS_Task_Trns_11: OsEventMask=4
      Rte_Ev_MS_Task_Trns_6: OsEventMask=4
      Rte_Ev_OnEntry_Task_Trns_6_StaMd6_SystemState6_Mode_OFF
      Rte_Ev_OnExit_Task_Trns_6_StaMd6_SystemState6_Mode_OFF
      Rte_Ev_Run_DiagMgr11_DiagMgr11_Trns
      Rte_Ev_Run_DiagMgr9_DiagMgr9_Trns
      Rte_Ev_Run_RteErrata11_RteErrata11_Trns
      Rte_Ev_Run_RteErrata6_RteErrata6_Trns
      Rte_Ev_Cyclic_Task_10ms_10b_0_10ms
      Rte_Ev_Cyclic_Task_10ms_6_0_10ms
      Rte_Ev_Run_SrlComDriver_SrlComDriver_Per1
      Rte_Ev_Run_SrlComInput_SrlComInput_MsgIsDat4V2Bsi_552
      Rte_Ev_Run_SrlComInput_SrlComInput_MsgIsDatAbr_50D
      Rte_Ev_Run_SrlComInput_SrlComInput_MsgIsDatBsi_3F2
      Rte_Ev_Run_SrlComInput_SrlComInput_MsgIsDatBsi_412
      Rte_Ev_Run_SrlComInput_SrlComInput_MsgIsDatBsi_432
      Rte_Ev_Run_SrlComInput_SrlComInput_MsgIsDatBsi_572
      Rte_Ev_Run_SrlComInput_SrlComInput_MsgIsDyn2Cmm_348
      Rte_Ev_Run_SrlComInput_SrlComInput_MsgIsDyn2Fre_3CD
      Rte_Ev_Run_SrlComInput_SrlComInput_MsgIsDynAas_2EB
      Rte_Ev_Run_SrlComInput_SrlComInput_MsgIsDynAbr_38D
      Rte_Ev_Run_SrlComInput_SrlComInput_MsgIsDynCds_34D
      Rte_Ev_Run_SrlComInput_SrlComInput_MsgIsDynCmm_208
      Rte_Ev_Run_SrlComInput_SrlComInput_MsgIsDynCmm_388
      Rte_Ev_Run_SrlComInput_SrlComInput_MsgIsDynVol_305
      Rte_Ev_Run_SrlComInput_SrlComInput_MsgIsInteElectronBsi_092
      Rte_Ev_Run_SrlComInput_SrlComInput_MsgProtoHs1DynUcf_5CD
      Rte_Ev_Cyclic_Task_10ms_10b_0_5ms
      Rte_Ev_OnExit_Task_Trns_10_StaMd_SystemState_Mode_OFF
    6 x OsIsr, all with OsIsrAnalysisPriority=0, OsIsrComputationTime=0, OsIsrPeriod=0, OsIsrDeadline=0, OsIsrProtectionRegionSizeNoInitData=0, OsIsrProtectionRegionSizeInitData=0:
      CanIsr_0: OsIsrCategory=CATEGORY_2, OsIsrEnableNesting=true, OsIsrNonTrustFctStackSize=508, OsIsrInterruptTarget=IRQ, OsIsrInterruptSource=INTR16
        OsIsrInterruptPriority
          NON_AUTO: OsIsrInterruptPriority=16
        OsIsrUseSpecialFunctionName
          FALSE
      Isr_ESMH: OsIsrCategory=CATEGORY_1, OsIsrEnableNesting=false, OsIsrNonTrustFctStackSize=0, OsIsrInterruptTarget=FIQ, OsIsrInterruptSource=INTR0
        OsIsrInterruptPriority
          NON_AUTO: OsIsrInterruptPriority=0
        OsIsrUseSpecialFunctionName
          FALSE
      Gpt_IsrInt0: OsIsrCategory=CATEGORY_2, OsIsrEnableNesting=true, OsIsrNonTrustFctStackSize=0, OsIsrInterruptTarget=IRQ, OsIsrInterruptSource=INTR2
        OsIsrInterruptPriority
          NON_AUTO: OsIsrInterruptPriority=4
        OsIsrUseSpecialFunctionName
          FALSE
      Isr_ESML: OsIsrCategory=CATEGORY_2, OsIsrEnableNesting=false, OsIsrNonTrustFctStackSize=0, OsIsrInterruptTarget=IRQ, OsIsrInterruptSource=INTR20
        OsIsrInterruptPriority
          NON_AUTO: OsIsrInterruptPriority=20
        OsIsrUseSpecialFunctionName
          FALSE
      FlsTst_CrcIrq: OsIsrCategory=CATEGORY_2, OsIsrEnableNesting=false, OsIsrNonTrustFctStackSize=0, OsIsrInterruptTarget=IRQ, OsIsrInterruptSource=INTR19
        OsIsrInterruptPriority
          NON_AUTO: OsIsrInterruptPriority=19
        OsIsrUseSpecialFunctionName
          FALSE
      Isr_OvervoltThresh: OsIsrCategory=CATEGORY_2, OsIsrEnableNesting=true, OsIsrNonTrustFctStackSize=0, OsIsrInterruptTarget=IRQ, OsIsrInterruptSource=INTR31
        OsIsrInterruptPriority
          NON_AUTO: OsIsrInterruptPriority=31
        OsIsrUseSpecialFunctionName
          FALSE
    30 x OsTask, all with OsTaskActivation=1, OsTaskSchedule=FULL, OsTaskComputationTime=0, OsTaskPeriod=0, OsTaskDeadline=0, OsTaskProtectionRegionSizeNoInitData=0, OsTaskProtectionRegionSizeInitData=0:
      Task_Bkgnd: OsTaskPriority=0, OsTaskTYPE=BASIC, OsTaskNotUsingSchedule=true, OsTaskStackSize=1020, OsTaskNonTrustFctStackSize=0
        OsTaskAutostart: OsTaskAppModeRef=OSDEFAULTAPPMODE
      Task_SchM_4ms_0: OsTaskPriority=80, OsTaskTYPE=BASIC, OsTaskNotUsingSchedule=false, OsTaskStackSize=1020, OsTaskNonTrustFctStackSize=0
      Task_SchM_Init_6: OsTaskPriority=1, OsTaskTYPE=BASIC, OsTaskNotUsingSchedule=false, OsTaskStackSize=2044, OsTaskNonTrustFctStackSize=0, OsTaskAccessingApplication=Ap_0
        OsTaskAutostart: OsTaskAppModeRef=OSDEFAULTAPPMODE
      Task_100ms_10: OsTaskPriority=32, OsTaskTYPE=BASIC, OsTaskNotUsingSchedule=false, OsTaskStackSize=1020, OsTaskNonTrustFctStackSize=0, OsTaskAccessingApplication=Ap_0, OsTaskAccessingApplication=Ap_11, OsTaskAccessingApplication=Ap_6, OsTaskAccessingApplication=Ap_9
      Task_100ms_9: OsTaskPriority=33, OsTaskTYPE=BASIC, OsTaskNotUsingSchedule=false, OsTaskStackSize=1020, OsTaskNonTrustFctStackSize=0, OsTaskAccessingApplication=Ap_0, OsTaskAccessingApplication=Ap_11, OsTaskAccessingApplication=Ap_6, OsTaskAccessingApplication=Ap_10
      Task_10ms_9: OsTaskPriority=44, OsTaskTYPE=BASIC, OsTaskNotUsingSchedule=false, OsTaskStackSize=1020, OsTaskNonTrustFctStackSize=0, OsTaskAccessingApplication=Ap_0, OsTaskAccessingApplication=Ap_6, OsTaskAccessingApplication=Ap_10, OsTaskAccessingApplication=Ap_11
      Task_2ms_10: OsTaskPriority=62, OsTaskTYPE=BASIC, OsTaskNotUsingSchedule=false, OsTaskStackSize=1020, OsTaskNonTrustFctStackSize=124, OsTaskAccessingApplication=Ap_0, OsTaskAccessingApplication=Ap_11, OsTaskAccessingApplication=Ap_6, OsTaskAccessingApplication=Ap_9
      Task_2ms_9: OsTaskPriority=63, OsTaskTYPE=BASIC, OsTaskNotUsingSchedule=false, OsTaskStackSize=1020, OsTaskNonTrustFctStackSize=0, OsTaskAccessingApplication=Ap_0, OsTaskAccessingApplication=Ap_11, OsTaskAccessingApplication=Ap_6, OsTaskAccessingApplication=Ap_10
      Task_4ms_10: OsTaskPriority=52, OsTaskTYPE=BASIC, OsTaskNotUsingSchedule=false, OsTaskStackSize=1020, OsTaskNonTrustFctStackSize=0, OsTaskAccessingApplication=Ap_0, OsTaskAccessingApplication=Ap_6, OsTaskAccessingApplication=Ap_9
      Task_4ms_9: OsTaskPriority=53, OsTaskTYPE=BASIC, OsTaskNotUsingSchedule=false, OsTaskStackSize=1020, OsTaskNonTrustFctStackSize=0, OsTaskAccessingApplication=Ap_0, OsTaskAccessingApplication=Ap_6, OsTaskAccessingApplication=Ap_10, OsTaskAccessingApplication=Ap_11
      Task_Init_10: OsTaskPriority=72, OsTaskTYPE=BASIC, OsTaskNotUsingSchedule=false, OsTaskStackSize=1020, OsTaskNonTrustFctStackSize=0, OsTaskAccessingApplication=Ap_0, OsTaskAccessingApplication=Ap_11, OsTaskAccessingApplication=Ap_6, OsTaskAccessingApplication=Ap_9
      Task_Init_9: OsTaskPriority=73, OsTaskTYPE=BASIC, OsTaskNotUsingSchedule=false, OsTaskStackSize=1020, OsTaskNonTrustFctStackSize=0, OsTaskAccessingApplication=Ap_0, OsTaskAccessingApplication=Ap_11, OsTaskAccessingApplication=Ap_6, OsTaskAccessingApplication=Ap_10
      Task_Trns_10: OsTaskPriority=12, OsTaskTYPE=EXTENDED, OsTaskNotUsingSchedule=false, OsTaskStackSize=1020, OsTaskNonTrustFctStackSize=0, OsTaskAccessingApplication=Ap_0, OsTaskAccessingApplication=Ap_11, OsTaskAccessingApplication=Ap_6, OsTaskAccessingApplication=Ap_9, OsTaskEventRef=Rte_Ev_Run_HwPwUp_HwPwUp_Trns1, OsTaskEventRef=Rte_Ev_MS_Task_Trns_10, OsTaskEventRef=Rte_Ev_OnEntry_Task_Trns_10_StaMd_SystemState_Mode_DISABLE, OsTaskEventRef=Rte_Ev_OnEntry_Task_Trns_10_StaMd_SystemState_Mode_OFF, OsTaskEventRef=Rte_Ev_OnEntry_Task_Trns_10_StaMd_SystemState_Mode_OPERATE, OsTaskEventRef=Rte_Ev_OnEntry_Task_Trns_10_StaMd_SystemState_Mode_WARMINIT, OsTaskEventRef=Rte_Ev_OnExit_Task_Trns_10_StaMd_SystemState_Mode_OFF
      Task_SchM_100ms_0: OsTaskPriority=2, OsTaskTYPE=BASIC, OsTaskNotUsingSchedule=false, OsTaskStackSize=1020, OsTaskNonTrustFctStackSize=0, OsTaskAccessingApplication=Ap_0
      Task_SchM_100ms_6: OsTaskPriority=3, OsTaskTYPE=BASIC, OsTaskNotUsingSchedule=false, OsTaskStackSize=1020, OsTaskNonTrustFctStackSize=0, OsTaskAccessingApplication=Ap_0
      Task_Trns_9: OsTaskPriority=13, OsTaskTYPE=EXTENDED, OsTaskNotUsingSchedule=false, OsTaskStackSize=508, OsTaskNonTrustFctStackSize=0, OsTaskAccessingApplication=Ap_0, OsTaskAccessingApplication=Ap_6, OsTaskAccessingApplication=Ap_10, OsTaskAccessingApplication=Ap_11, OsTaskEventRef=Rte_Ev_MS_Task_Trns_9, OsTaskEventRef=Rte_Ev_OnEntry_Task_Trns_9_StaMd9_SystemState9_Mode_DISABLE, OsTaskEventRef=Rte_Ev_OnEntry_Task_Trns_9_StaMd9_SystemState9_Mode_OFF, OsTaskEventRef=Rte_Ev_OnEntry_Task_Trns_9_StaMd9_SystemState9_Mode_OPERATE, OsTaskEventRef=Rte_Ev_OnEntry_Task_Trns_9_StaMd9_SystemState9_Mode_WARMINIT, OsTaskEventRef=Rte_Ev_Run_DiagMgr9_DiagMgr9_Trns, OsTaskEventRef=Rte_Ev_Run_ePWM2_ePWM2_Trns2
      Task_SchM_Trns_6: OsTaskPriority=14, OsTaskTYPE=BASIC, OsTaskNotUsingSchedule=false, OsTaskStackSize=508, OsTaskNonTrustFctStackSize=0, OsTaskAccessingApplication=Ap_0, OsTaskAccessingApplication=Ap_6, OsTaskAccessingApplication=Ap_10
      Task_100ms_11: OsTaskPriority=31, OsTaskTYPE=BASIC, OsTaskNotUsingSchedule=false, OsTaskStackSize=1020, OsTaskNonTrustFctStackSize=0, OsTaskAccessingApplication=Ap_10, OsTaskAccessingApplication=Ap_6, OsTaskAccessingApplication=Ap_9
      Task_10ms_6: OsTaskPriority=42, OsTaskTYPE=EXTENDED, OsTaskNotUsingSchedule=false, OsTaskStackSize=4092, OsTaskNonTrustFctStackSize=508, OsTaskAccessingApplication=Ap_6, OsTaskAccessingApplication=Ap_10, OsTaskAccessingApplication=Ap_11, OsTaskAccessingApplication=Ap_9, OsTaskEventRef=Rte_Ev_Cyclic_Task_10ms_6_0_10ms, OsTaskEventRef=Rte_Ev_Run_SrlComDriver_SrlComDriver_Per1
      Task_2ms_11: OsTaskPriority=61, OsTaskTYPE=BASIC, OsTaskNotUsingSchedule=false, OsTaskStackSize=1020, OsTaskNonTrustFctStackSize=0, OsTaskAccessingApplication=Ap_10, OsTaskAccessingApplication=Ap_6, OsTaskAccessingApplication=Ap_9
      Task_Trns_11: OsTaskPriority=11, OsTaskTYPE=EXTENDED, OsTaskNotUsingSchedule=false, OsTaskStackSize=508, OsTaskNonTrustFctStackSize=0, OsTaskAccessingApplication=Ap_10, OsTaskAccessingApplication=Ap_6, OsTaskAccessingApplication=Ap_9, OsTaskEventRef=Rte_Ev_MS_Task_Trns_11, OsTaskEventRef=Rte_Ev_Run_DiagMgr11_DiagMgr11_Trns, OsTaskEventRef=Rte_Ev_Run_RteErrata11_RteErrata11_Trns
      Task_100ms_6: OsTaskPriority=30, OsTaskTYPE=BASIC, OsTaskNotUsingSchedule=false, OsTaskStackSize=1020, OsTaskNonTrustFctStackSize=0, OsTaskAccessingApplication=Ap_10, OsTaskAccessingApplication=Ap_11, OsTaskAccessingApplication=Ap_6, OsTaskAccessingApplication=Ap_9
      Task_2ms_6: OsTaskPriority=60, OsTaskTYPE=BASIC, OsTaskNotUsingSchedule=false, OsTaskStackSize=1020, OsTaskNonTrustFctStackSize=0, OsTaskAccessingApplication=Ap_11, OsTaskAccessingApplication=Ap_6, OsTaskAccessingApplication=Ap_10, OsTaskAccessingApplication=Ap_9
      Task_Init_6: OsTaskPriority=70, OsTaskTYPE=BASIC, OsTaskNotUsingSchedule=false, OsTaskStackSize=1020, OsTaskNonTrustFctStackSize=0, OsTaskAccessingApplication=Ap_10, OsTaskAccessingApplication=Ap_11, OsTaskAccessingApplication=Ap_6, OsTaskAccessingApplication=Ap_9
      Task_Trns_6: OsTaskPriority=10, OsTaskTYPE=EXTENDED, OsTaskNotUsingSchedule=false, OsTaskStackSize=508, OsTaskNonTrustFctStackSize=0, OsTaskAccessingApplication=Ap_10, OsTaskAccessingApplication=Ap_11, OsTaskAccessingApplication=Ap_6, OsTaskAccessingApplication=Ap_9, OsTaskEventRef=Rte_Ev_MS_Task_Trns_6, OsTaskEventRef=Rte_Ev_OnEntry_Task_Trns_6_StaMd6_SystemState6_Mode_OFF, OsTaskEventRef=Rte_Ev_OnExit_Task_Trns_6_StaMd6_SystemState6_Mode_OFF, OsTaskEventRef=Rte_Ev_Run_RteErrata6_RteErrata6_Trns
      Task_10ms_11: OsTaskPriority=40, OsTaskTYPE=BASIC, OsTaskNotUsingSchedule=false, OsTaskStackSize=1020, OsTaskNonTrustFctStackSize=0, OsTaskAccessingApplication=Ap_10, OsTaskAccessingApplication=Ap_6, OsTaskAccessingApplication=Ap_9
      Task_Init_11a: OsTaskPriority=74, OsTaskTYPE=BASIC, OsTaskNotUsingSchedule=false, OsTaskStackSize=508, OsTaskNonTrustFctStackSize=0, OsTaskAccessingApplication=Ap_10, OsTaskAccessingApplication=Ap_6, OsTaskAccessingApplication=Ap_9
      Task_Init_11b: OsTaskPriority=71, OsTaskTYPE=BASIC, OsTaskNotUsingSchedule=false, OsTaskStackSize=1020, OsTaskNonTrustFctStackSize=0, OsTaskAccessingApplication=Ap_10, OsTaskAccessingApplication=Ap_6, OsTaskAccessingApplication=Ap_9
      Task_10ms_10a: OsTaskPriority=43, OsTaskTYPE=BASIC, OsTaskNotUsingSchedule=false, OsTaskStackSize=1020, OsTaskNonTrustFctStackSize=508, OsTaskAccessingApplication=Ap_11, OsTaskAccessingApplication=Ap_6, OsTaskAccessingApplication=Ap_9
      Task_10ms_10b: OsTaskPriority=41, OsTaskTYPE=EXTENDED, OsTaskNotUsingSchedule=false, OsTaskStackSize=1020, OsTaskNonTrustFctStackSize=508, OsTaskAccessingApplication=Ap_11, OsTaskAccessingApplication=Ap_6, OsTaskAccessingApplication=Ap_9, OsTaskEventRef=Rte_Ev_Cyclic_Task_10ms_10b_0_10ms, OsTaskEventRef=Rte_Ev_Run_SrlComInput_SrlComInput_MsgIsDat4V2Bsi_552, OsTaskEventRef=Rte_Ev_Run_SrlComInput_SrlComInput_MsgIsDatAbr_50D, OsTaskEventRef=Rte_Ev_Run_SrlComInput_SrlComInput_MsgIsDatBsi_3F2, OsTaskEventRef=Rte_Ev_Run_SrlComInput_SrlComInput_MsgIsDatBsi_412, OsTaskEventRef=Rte_Ev_Run_SrlComInput_SrlComInput_MsgIsDatBsi_432, OsTaskEventRef=Rte_Ev_Run_SrlComInput_SrlComInput_MsgIsDatBsi_572, OsTaskEventRef=Rte_Ev_Run_SrlComInput_SrlComInput_MsgIsDyn2Cmm_348, OsTaskEventRef=Rte_Ev_Run_SrlComInput_SrlComInput_MsgIsDyn2Fre_3CD, OsTaskEventRef=Rte_Ev_Run_SrlComInput_SrlComInput_MsgIsDynAas_2EB, OsTaskEventRef=Rte_Ev_Run_SrlComInput_SrlComInput_MsgIsDynAbr_38D, OsTaskEventRef=Rte_Ev_Run_SrlComInput_SrlComInput_MsgIsDynCds_34D, OsTaskEventRef=Rte_Ev_Run_SrlComInput_SrlComInput_MsgIsDynCmm_208, OsTaskEventRef=Rte_Ev_Run_SrlComInput_SrlComInput_MsgIsDynCmm_388, OsTaskEventRef=Rte_Ev_Run_SrlComInput_SrlComInput_MsgIsDynVol_305, OsTaskEventRef=Rte_Ev_Run_SrlComInput_SrlComInput_MsgIsInteElectronBsi_092, OsTaskEventRef=Rte_Ev_Run_SrlComInput_SrlComInput_MsgProtoHs1DynUcf_5CD, OsTaskEventRef=Rte_Ev_Cyclic_Task_10ms_10b_0_5ms
  module config OvrVoltMon: implementation-config-variant=VARIANT-PRE-COMPILE  # Configuration of the Nexteer OvrVoltMon module.
    OvrVoltMonGeneral
    CommonPublishedInformation: ArMajorVersion=3, ArMinorVersion=2, ArPatchVersion=0, SwMajorVersion=0, SwMinorVersion=0, SwPatchVersion=0, ModuleId=0, VendorId=0
  module config PeakCurrEst: implementation-config-variant=VARIANT-PRE-COMPILE  # Configuration of the Nexteer PeakCurrEst module.
    PeakCurrEstGeneral
    CommonPublishedInformation: ArMajorVersion=3, ArMinorVersion=2, ArPatchVersion=0, SwMajorVersion=0, SwMinorVersion=0, SwPatchVersion=0, ModuleId=0, VendorId=0
